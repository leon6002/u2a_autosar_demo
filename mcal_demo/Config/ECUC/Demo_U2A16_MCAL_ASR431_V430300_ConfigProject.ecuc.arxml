AUTOSAR XML (schema 00049)
package /ActiveEcuC
  ecuc value collection ActiveEcuC: ecuc-values=[Fls, Gpt, Wdg, Os, Port, Mcu, EcuM, Can]
  module config Fls: implementation-config-variant=VARIANT-POST-BUILD-LOADABLE, module-description=Fls_Impl
    FlsConfigSet:
      FlsAcErase = 0
      FlsAcWrite = 0
      FlsCallCycle = 0.005
      FlsDefaultMode = MEMIF_MODE_SLOW
      FlsMaxReadFastMode = 512
      FlsMaxReadNormalMode = 256
      FlsMaxWriteFastMode = 4
      FlsMaxWriteNormalMode = 4
      FlsProtection = 0
      FlsSectorList
        FlsSector: FlsNumberOfSectors=128, FlsPageSize=4, FlsSectorSize=4096, FlsSectorStartaddress=0
    FlsGeneral:
      FlsAcLoadOnJobStart = false
      FlsBaseAddress = 0
      FlsBlankCheckApi = true
      FlsCancelApi = true
      FlsCompareApi = false
      FlsCriticalSectionProtection = true
      FlsDeInitApi = true
      FlsDevErrorDetect = false
      FlsDeviceName = R7F702300BFABA
      FlsDriverIndex = 0
      FlsEccCheck = true
      FlsEnableClkImmediateValue = false
      FlsEraseVerificationEnabled = false
      FlsGetJobResultApi = true
      FlsGetStatusApi = true
      FlsInterruptConsistencyCheck = false
      FlsIsrCategory = CAT2
      FlsReadImmediateApi = false
      FlsResumeApi = false
      FlsRuntimeErrorDetect = true
      FlsSetModeApi = true
      FlsShiftPEModeTime = 0
      FlsSuspendApi = false
      FlsTimeoutMonitoringEnable = false
      FlsTimeoutSupervisionEnabled = false
      FlsTotalSize = 524288
      FlsUseInterrupts = false
      FlsVersionCheckExternalModules = false
      FlsVersionInfoApi = false
      FlsWriteVerificationEnabled = false
      FlsCpuFrequencyImmediateValue = 400
      FlsCpuFrequency = McuClockSettingConfig
      FlsDataFlash:
        FlsDFAuthID{0..7} = 4294967295
        FlsDFBCAreaBaseAddress = 4282384384
        FlsDFBaseAddress_FACI0 = 4280287232
        FlsDFBaseAddress_FACI1 = 4280549376
        FlsDFBlockSize = 4096
        FlsDFOneEEPSize = 256
        FlsDFTotalBlocks = 128
    FlsPublishedInformation:
      FlsAcLocationErase = 0
      FlsAcLocationWrite = 0
      FlsAcSizeErase = 0
      FlsAcSizeWrite = 0
      FlsBlankCheckTime = 0.0176
      FlsCancelTime = 0.000022
      FlsEraseTime = 0.2387
      FlsErasedValue = 4294967295
      FlsExpectedHwId = NULL
      FlsSpecifiedEraseCycles = 125000
      FlsSuspendTime = 0.00033
      FlsWriteTime = 0.00154
  module config Gpt: implementation-config-variant=VARIANT-POST-BUILD-LOADABLE, module-description=Gpt_Impl
    GptChannelConfigSet
      GptChannelConfiguration_TAUJ0I0 (GptChannelConfiguration):
        GptChannelId = 0
        GptChannelMode = GPT_CH_MODE_CONTINUOUS
        GptChannelSelection = TAUJ0I0
        GptChannelTickFrequency = 1000
        GptChannelTickValueMax = 65535
        GptEnableWakeup = false
        GptChannelClk = CK0
        GptNotification = GptNotification_1ms
        GptChannelClkSrcRef = GptClockReferencePoint
      GptTauUnit_TAUJ0 (GptTauUnit):
        GptTauPrescalerCk0 = PCLK_DIVBY_2_POWOF_07
        GptTauPrescalerCk1 = PCLK_DIVBY_2_POWOF_00
        GptTauPrescalerCk2 = PCLK_DIVBY_2_POWOF_00
        GptTauPrescalerCk3BaudRate = 2
        GptTauPrescalerCk3Pre = PCLK_DIVBY_2_POWOF_00
        GptTauUnitSelection = TAUJ0
    GptConfigurationOfOptApiServices:
      GptDeinitApi = true
      GptEnableDisableNotificationApi = true
      GptGetPredefTimerValueApi = false
      GptTimeElapsedApi = true
      GptTimeRemainingApi = true
      GptVersionInfoApi = false
      GptWakeupFunctionalityApi = false
    GptDriverConfiguration:
      GptAlreadyInitDetCheck = true
      GptClearPendingInterrupts = true
      GptCriticalSectionProtection = true
      GptDevErrorDetect = false
      GptDeviceName = R7F702300BFABA
      GptInterruptConsistencyCheck = false
      GptIsrCategory = CAT2
      GptPeNumber = 0
      GptPredefTimer100us32bitEnable = false
      GptPredefTimer1usEnablingGrade = GPT_PREDEF_TIMER_1US_16_24_32BIT_ENABLED
      GptReportWakeupSource = false
      GptVersionCheckExternalModules = false
      GptClockReferencePoint: GptClockReference=McuClockReferencePoint
      GptTaujClockReferencePoint:
        GptEnableTauj01ClockImmediateValue = false
        GptEnableTauj23ClockImmediateValue = false
        GptTauj01ClockReference = McuHighSpeedPeriClk
        GptTauj23ClockReference = McuTAUJClk
  module config Wdg: implementation-config-variant=VARIANT-POST-BUILD-LOADABLE, module-description=Wdg_Impl
    WdgGeneral:
      WdgActivationCodeMode = WDG_FIXED_ACTIVATION_CODE_MODE
      WdgArbitraryTimingInterruptMode = false
      WdgCriticalSectionProtection = false
      WdgDevErrorDetect = true
      WdgDeviceName = R7F702300BFABA
      WdgDisableAllowed = true
      WdgECMInterruptConsistencyCheck = false
      WdgEnableClkImmediateValue = false
      WdgEnableDelayTimerStart = false
      WdgErrorModeSetting = WDG_RESET_MODE
      WdgErrorOutputMask = false
      WdgFEINTDisableAllowed = false
      WdgIndex = 0
      WdgInitialTimeout = 5
      WdgInterruptConsistencyCheck = false
      WdgIsrCategory = CAT2
      WdgMaxTimeout = 10
      WdgRunArea = ROM
      WdgSelectWDTBUnit = WDTB0
      WdgTriggerLocation = NULL
      WdgVACSupport = false
      WdgVersionCheckExternalModules = false
      WdgVersionInfoApi = false
      WdgClockRefImmediateValue = WDTBTCKI_312_5KHZ
      WdgClockRef = McuWDTClk
    WdgPublishedInformation: WdgTriggerMode=WDG_WINDOW
    WdgSettingsConfig: WdgDefaultMode=WDGIF_OFF_MODE
      WdgSettingsFast: WdgClkSettingsFast=WDGCLK_DIVBY_2POWOF_9
      WdgSettingsOff
      WdgSettingsSlow: WdgClkSettingsSlow=WDGCLK_DIVBY_2POWOF_16
  module config Os: implementation-config-variant=VARIANT-PRE-COMPILE
    OsAppMode
    OsOS: OsStackMonitoring=(unset), OsStatus=(unset), OsUseGetServiceId=(unset), OsUseParameterAccess=(unset), OsUseResScheduler=true
      OsHooks: OsErrorHook=(unset), OsPostTaskHook=(unset), OsPreTaskHook=(unset), OsShutdownHook=(unset), OsStartupHook=(unset)
    OsCounter: OsCounterMaxAllowedValue=(unset), OsCounterMinCycle=(unset), OsCounterTicksPerBase=(unset), OsCounterType=(unset), OsSecondsPerTick=0.0001
  module config Port: implementation-config-variant=VARIANT-POST-BUILD, module-description=Port_Impl
    PortGeneral:
      PortCriticalSectionProtection = true
      PortDevErrorDetect = false
      PortDeviceName = R7F702300BFABA
      PortEcmErrorInApi = true
      PortJTAGForDebugging = true
      PortMaxMode = 8
      PortSetPinDefaultDirectionApi = true
      PortSetPinDirectionApi = true
      PortSetPinModeApi = true
      PortSetToDioAltModeApi = true
      PortUnlockSequenceCount = 50
      PortVersionCheckExternalModules = false
      PortVersionInfoApi = false
    PortConfigSet
      PortContainer: PortNumberOfPortPins=1
        PortPin:
          PortPinDirection = PORT_PIN_OUT
          PortPinDirectionChangeable = false
          PortPinId = 1
          PortPinInitialMode = PORT_PIN_MODE_DIO
          PortPinLevelValue = PORT_PIN_LEVEL_LOW
          PortPinMode = PORT_PIN_MODE_DIO
          PortPinModeChangeable = false
      PortGroup3
        PortPin2_CAN2TX_CAN_1_TX (PortPin2):
          PortBiDirectionControl = false
          PortDriveStrengthControl = DRIVE_STRENGTH_TYPE_1_SUPP_PDSC_PUCC
          PortInputBufferControl = false
          PortInputSelection = INPUT_BUFFER_TYPE_SCH1
          PortIpControl = false
          PortOpenDrainControl = OUTPUT_BUFFER_TYPE_PUSHPULL_SUPP_PODC_PODCE
          PortOutputLevelInversion = false
          PortPinDioAltModeChangeable = false
          PortPinDirection = PORT_PIN_OUT
          PortPinDirectionChangeable = false
          PortPinInitialMode = CAN2TX_ALT2_OUT_SUPP_PFC_PFCE_PFCAE_PMCSR
          PortPinLevelValue = PORT_PIN_LEVEL_LOW
          PortPinModeChangeable = false
          PortPinSafeStateControl = false
          PortPinSafeStateTrigger = ERROROUTZ0
          PortPullDownOption = false
          PortPullUpOption = false
        PortPin3_CAN2RX_CAN_1_RX (PortPin3):
          PortBiDirectionControl = false
          PortDriveStrengthControl = DRIVE_STRENGTH_TYPE_1_SUPP_PDSC_PUCC
          PortInputBufferControl = false
          PortInputSelection = INPUT_BUFFER_TYPE_SCH1
          PortIpControl = false
          PortOpenDrainControl = OUTPUT_BUFFER_TYPE_PUSHPULL_SUPP_PODC_PODCE
          PortOutputLevelInversion = false
          PortPinDioAltModeChangeable = false
          PortPinDirection = PORT_PIN_IN
          PortPinDirectionChangeable = false
          PortPinInitialMode = CAN2RX_INTP2_ALT2_IN_SUPP_PFC_PFCE_PFCAE_PMCSR
          PortPinLevelValue = PORT_PIN_LEVEL_LOW
          PortPinModeChangeable = false
          PortPinSafeStateControl = false
          PortPinSafeStateTrigger = ERROROUTZ0
          PortPullDownOption = false
          PortPullUpOption = false
        PortPin4_CAN7TX_CAN_2_TX (PortPin4):
          PortBiDirectionControl = false
          PortDriveStrengthControl = DRIVE_STRENGTH_TYPE_1_SUPP_PDSC_PUCC
          PortInputBufferControl = false
          PortInputSelection = INPUT_BUFFER_TYPE_SCH1
          PortIpControl = false
          PortOpenDrainControl = OUTPUT_BUFFER_TYPE_PUSHPULL_SUPP_PODC_PODCE
          PortOutputLevelInversion = false
          PortPinDioAltModeChangeable = false
          PortPinDirection = PORT_PIN_OUT
          PortPinDirectionChangeable = false
          PortPinInitialMode = CAN7TX_ALT2_OUT_SUPP_PFC_PFCE_PFCAE_PMCSR
          PortPinLevelValue = PORT_PIN_LEVEL_LOW
          PortPinModeChangeable = false
          PortPinSafeStateControl = false
          PortPinSafeStateTrigger = ERROROUTZ0
          PortPullDownOption = false
          PortPullUpOption = false
        PortPin5_CAN7RX_CAN_2_RX (PortPin5):
          PortBiDirectionControl = false
          PortDriveStrengthControl = DRIVE_STRENGTH_TYPE_1_SUPP_PDSC_PUCC
          PortInputBufferControl = false
          PortInputSelection = INPUT_BUFFER_TYPE_SCH1
          PortIpControl = false
          PortOpenDrainControl = OUTPUT_BUFFER_TYPE_PUSHPULL_SUPP_PODC_PODCE
          PortOutputLevelInversion = false
          PortPinDioAltModeChangeable = false
          PortPinDirection = PORT_PIN_IN
          PortPinDirectionChangeable = false
          PortPinInitialMode = CAN7RX_INTP7_ALT2_IN_SUPP_PFC_PFCE_PFCAE_PMCSR
          PortPinLevelValue = PORT_PIN_LEVEL_LOW
          PortPinModeChangeable = false
          PortPinSafeStateControl = false
          PortPinSafeStateTrigger = ERROROUTZ0
          PortPullDownOption = false
          PortPullUpOption = false
        PortPin6:
          PortBiDirectionControl = false
          PortDriveStrengthControl = DRIVE_STRENGTH_TYPE_1_SUPP_PDSC_PUCC
          PortInputBufferControl = false
          PortInputSelection = INPUT_BUFFER_TYPE_SCH1
          PortIpControl = false
          PortOpenDrainControl = OUTPUT_BUFFER_TYPE_PUSHPULL_SUPP_PODC_PODCE
          PortOutputLevelInversion = false
          PortPinDioAltModeChangeable = false
          PortPinDirection = PORT_PIN_IN
          PortPinDirectionChangeable = false
          PortPinInitialMode = DIO_SUPP_PFC_PFCE_PFCAE_PFCEAE_PMCSR
          PortPinLevelValue = PORT_PIN_LEVEL_LOW
          PortPinModeChangeable = false
          PortPinSafeStateControl = false
          PortPinSafeStateTrigger = ERROROUTZ0
          PortPullDownOption = false
          PortPullUpOption = false
        PortPin7:
          PortBiDirectionControl = false
          PortDriveStrengthControl = DRIVE_STRENGTH_TYPE_1_SUPP_PDSC_PUCC
          PortInputBufferControl = false
          PortInputSelection = INPUT_BUFFER_TYPE_SCH1
          PortIpControl = false
          PortOpenDrainControl = OUTPUT_BUFFER_TYPE_PUSHPULL_SUPP_PODC_PODCE
          PortOutputLevelInversion = false
          PortPinDioAltModeChangeable = false
          PortPinDirection = PORT_PIN_IN
          PortPinDirectionChangeable = false
          PortPinInitialMode = DIO_SUPP_PFC_PFCE_PFCAE_PFCEAE_PMCSR
          PortPinLevelValue = PORT_PIN_LEVEL_LOW
          PortPinModeChangeable = false
          PortPinSafeStateControl = false
          PortPinSafeStateTrigger = ERROROUTZ0
          PortPullDownOption = false
          PortPullUpOption = false
        PortPin8:
          PortBiDirectionControl = false
          PortDriveStrengthControl = DRIVE_STRENGTH_TYPE_1_SUPP_PDSC_PUCC
          PortInputBufferControl = false
          PortInputSelection = INPUT_BUFFER_TYPE_SCH1
          PortIpControl = false
          PortOpenDrainControl = OUTPUT_BUFFER_TYPE_PUSHPULL_SUPP_PODC_PODCE
          PortOutputLevelInversion = false
          PortPinDioAltModeChangeable = false
          PortPinDirection = PORT_PIN_IN
          PortPinDirectionChangeable = false
          PortPinInitialMode = DIO_SUPP_PFC_PFCE_PFCAE_PFCEAE_PMCSR
          PortPinLevelValue = PORT_PIN_LEVEL_LOW
          PortPinModeChangeable = false
          PortPinSafeStateControl = false
          PortPinSafeStateTrigger = ERROROUTZ0
          PortPullDownOption = false
          PortPullUpOption = false
      PortGroupJtag0
        PortPin0:
          PortBiDirectionControl = false
          PortDriveStrengthControl = DRIVE_STRENGTH_TYPE_1_SUPP_PDSC_PUCC
          PortInputBufferControl = true
          PortInputSelection = INPUT_BUFFER_TYPE_SCH1
          PortOpenDrainControl = OUTPUT_BUFFER_TYPE_PUSHPULL_SUPP_PODC_PODCE
          PortOutputLevelInversion = false
          PortPinDioAltModeChangeable = false
          PortPinDirection = PORT_PIN_IN
          PortPinDirectionChangeable = false
          PortPinInitialMode = DIO_SUPP_PFC_PFCE_PFCAE_PFCEAE_PMCSR
          PortPinLevelValue = PORT_PIN_LEVEL_LOW
          PortPinModeChangeable = false
          PortPullDownOption = false
          PortPullUpOption = true
        PortPin1:
          PortBiDirectionControl = false
          PortDriveStrengthControl = DRIVE_STRENGTH_TYPE_1_SUPP_PDSC_PUCC
          PortInputBufferControl = false
          PortInputSelection = INPUT_BUFFER_TYPE_SCH1
          PortOpenDrainControl = OUTPUT_BUFFER_TYPE_PUSHPULL_SUPP_PODC_PODCE
          PortOutputLevelInversion = false
          PortPinDioAltModeChangeable = false
          PortPinDirection = PORT_PIN_IN
          PortPinDirectionChangeable = false
          PortPinInitialMode = DIO_SUPP_PFC_PFCE_PFCAE_PFCEAE_PMCSR
          PortPinLevelValue = PORT_PIN_LEVEL_LOW
          PortPinModeChangeable = false
          PortPullDownOption = false
          PortPullUpOption = false
        PortPin2:
          PortBiDirectionControl = false
          PortDriveStrengthControl = DRIVE_STRENGTH_TYPE_1_SUPP_PDSC_PUCC
          PortInputBufferControl = true
          PortInputSelection = INPUT_BUFFER_TYPE_SCH1
          PortOpenDrainControl = OUTPUT_BUFFER_TYPE_PUSHPULL_SUPP_PODC_PODCE
          PortOutputLevelInversion = false
          PortPinDioAltModeChangeable = false
          PortPinDirection = PORT_PIN_IN
          PortPinDirectionChangeable = false
          PortPinInitialMode = DIO_SUPP_PFC_PFCE_PFCAE_PFCEAE_PMCSR
          PortPinLevelValue = PORT_PIN_LEVEL_LOW
          PortPinModeChangeable = false
          PortPullDownOption = false
          PortPullUpOption = true
        PortPin3:
          PortBiDirectionControl = false
          PortDriveStrengthControl = DRIVE_STRENGTH_TYPE_1_SUPP_PDSC_PUCC
          PortInputBufferControl = false
          PortInputSelection = INPUT_BUFFER_TYPE_SCH1
          PortOpenDrainControl = OUTPUT_BUFFER_TYPE_PUSHPULL_SUPP_PODC_PODCE
          PortOutputLevelInversion = false
          PortPinDioAltModeChangeable = false
          PortPinDirection = PORT_PIN_IN
          PortPinDirectionChangeable = false
          PortPinInitialMode = DIO_SUPP_PFC_PFCE_PFCAE_PFCEAE_PMCSR
          PortPinLevelValue = PORT_PIN_LEVEL_LOW
          PortPinModeChangeable = false
          PortPullDownOption = false
          PortPullUpOption = false
        PortPin5:
          PortBiDirectionControl = false
          PortDriveStrengthControl = DRIVE_STRENGTH_TYPE_1_SUPP_PDSC_PUCC
          PortInputBufferControl = false
          PortInputSelection = INPUT_BUFFER_TYPE_SCH1
          PortOpenDrainControl = OUTPUT_BUFFER_TYPE_PUSHPULL_SUPP_PODC_PODCE
          PortOutputLevelInversion = false
          PortPinDioAltModeChangeable = false
          PortPinDirection = PORT_PIN_IN
          PortPinDirectionChangeable = false
          PortPinInitialMode = DIO_SUPP_PFC_PFCE_PFCAE_PFCEAE_PMCSR
          PortPinLevelValue = PORT_PIN_LEVEL_LOW
          PortPinModeChangeable = false
          PortPullDownOption = false
          PortPullUpOption = false
      PortFilterGroupConfig
      PortGroup2
        PortPin0:
          PortBiDirectionControl = false
          PortDriveStrengthControl = DRIVE_STRENGTH_TYPE_1_SUPP_PDSC_PUCC
          PortInputBufferControl = false
          PortInputSelection = INPUT_BUFFER_TYPE_SCH1
          PortIpControl = false
          PortOpenDrainControl = OUTPUT_BUFFER_TYPE_PUSHPULL_SUPP_PODC_PODCE
          PortOutputLevelInversion = false
          PortPinDioAltModeChangeable = false
          PortPinDirection = PORT_PIN_IN
          PortPinDirectionChangeable = false
          PortPinInitialMode = DIO_SUPP_PFC_PFCE_PFCAE_PFCEAE_PMCSR
          PortPinLevelValue = PORT_PIN_LEVEL_LOW
          PortPinModeChangeable = false
          PortPinSafeStateControl = false
          PortPinSafeStateTrigger = ERROROUTZ0
          PortPullDownOption = false
          PortPullUpOption = false
        PortPin1:
          PortBiDirectionControl = false
          PortDriveStrengthControl = DRIVE_STRENGTH_TYPE_1_SUPP_PDSC_PUCC
          PortInputBufferControl = false
          PortInputSelection = INPUT_BUFFER_TYPE_SCH1
          PortIpControl = false
          PortOpenDrainControl = OUTPUT_BUFFER_TYPE_PUSHPULL_SUPP_PODC_PODCE
          PortOutputLevelInversion = false
          PortPinDioAltModeChangeable = false
          PortPinDirection = PORT_PIN_IN
          PortPinDirectionChangeable = false
          PortPinInitialMode = DIO_SUPP_PFC_PFCE_PFCAE_PFCEAE_PMCSR
          PortPinLevelValue = PORT_PIN_LEVEL_LOW
          PortPinModeChangeable = false
          PortPinSafeStateControl = false
          PortPinSafeStateTrigger = ERROROUTZ0
          PortPullDownOption = false
          PortPullUpOption = false
        PortPin10:
          PortBiDirectionControl = false
          PortDriveStrengthControl = DRIVE_STRENGTH_TYPE_1_SUPP_PDSC_PUCC
          PortInputBufferControl = false
          PortInputSelection = INPUT_BUFFER_TYPE_SCH1
          PortIpControl = false
          PortOpenDrainControl = OUTPUT_BUFFER_TYPE_PUSHPULL_SUPP_PODC_PODCE
          PortOutputLevelInversion = false
          PortPinDioAltModeChangeable = false
          PortPinDirection = PORT_PIN_IN
          PortPinDirectionChangeable = false
          PortPinInitialMode = DIO_SUPP_PFC_PFCE_PFCAE_PFCEAE_PMCSR
          PortPinLevelValue = PORT_PIN_LEVEL_LOW
          PortPinModeChangeable = false
          PortPinSafeStateControl = false
          PortPinSafeStateTrigger = ERROROUTZ0
          PortPullDownOption = false
          PortPullUpOption = false
        PortPin11:
          PortBiDirectionControl = false
          PortDriveStrengthControl = DRIVE_STRENGTH_TYPE_1_SUPP_PDSC_PUCC
          PortInputBufferControl = false
          PortInputSelection = INPUT_BUFFER_TYPE_SCH1
          PortIpControl = false
          PortOpenDrainControl = OUTPUT_BUFFER_TYPE_PUSHPULL_SUPP_PODC_PODCE
          PortOutputLevelInversion = false
          PortPinDioAltModeChangeable = false
          PortPinDirection = PORT_PIN_IN
          PortPinDirectionChangeable = false
          PortPinInitialMode = DIO_SUPP_PFC_PFCE_PFCAE_PFCEAE_PMCSR
          PortPinLevelValue = PORT_PIN_LEVEL_LOW
          PortPinModeChangeable = false
          PortPinSafeStateControl = false
          PortPinSafeStateTrigger = ERROROUTZ0
          PortPullDownOption = false
          PortPullUpOption = false
        PortPin12:
          PortBiDirectionControl = false
          PortDriveStrengthControl = DRIVE_STRENGTH_TYPE_1_SUPP_PDSC_PUCC
          PortInputBufferControl = false
          PortInputSelection = INPUT_BUFFER_TYPE_SCH1
          PortIpControl = false
          PortOpenDrainControl = OUTPUT_BUFFER_TYPE_PUSHPULL_SUPP_PODC_PODCE
          PortOutputLevelInversion = false
          PortPinDioAltModeChangeable = false
          PortPinDirection = PORT_PIN_IN
          PortPinDirectionChangeable = false
          PortPinInitialMode = DIO_SUPP_PFC_PFCE_PFCAE_PFCEAE_PMCSR
          PortPinLevelValue = PORT_PIN_LEVEL_LOW
          PortPinModeChangeable = false
          PortPinSafeStateControl = false
          PortPinSafeStateTrigger = ERROROUTZ0
          PortPullDownOption = false
          PortPullUpOption = false
        PortPin13:
          PortBiDirectionControl = false
          PortDriveStrengthControl = DRIVE_STRENGTH_TYPE_1_SUPP_PDSC_PUCC
          PortInputBufferControl = false
          PortInputSelection = INPUT_BUFFER_TYPE_SCH1
          PortIpControl = false
          PortOpenDrainControl = OUTPUT_BUFFER_TYPE_PUSHPULL_SUPP_PODC_PODCE
          PortOutputLevelInversion = false
          PortPinDioAltModeChangeable = false
          PortPinDirection = PORT_PIN_IN
          PortPinDirectionChangeable = false
          PortPinInitialMode = DIO_SUPP_PFC_PFCE_PFCAE_PFCEAE_PMCSR
          PortPinLevelValue = PORT_PIN_LEVEL_LOW
          PortPinModeChangeable = false
          PortPinSafeStateControl = false
          PortPinSafeStateTrigger = ERROROUTZ0
          PortPullDownOption = false
          PortPullUpOption = false
        PortPin14:
          PortBiDirectionControl = false
          PortDriveStrengthControl = DRIVE_STRENGTH_TYPE_1_SUPP_PDSC_PUCC
          PortInputBufferControl = false
          PortInputSelection = INPUT_BUFFER_TYPE_SCH1
          PortIpControl = false
          PortOpenDrainControl = OUTPUT_BUFFER_TYPE_PUSHPULL_SUPP_PODC_PODCE
          PortOutputLevelInversion = false
          PortPinDioAltModeChangeable = false
          PortPinDirection = PORT_PIN_IN
          PortPinDirectionChangeable = false
          PortPinInitialMode = DIO_SUPP_PFC_PFCE_PFCAE_PFCEAE_PMCSR
          PortPinLevelValue = PORT_PIN_LEVEL_LOW
          PortPinModeChangeable = false
          PortPinSafeStateControl = false
          PortPinSafeStateTrigger = ERROROUTZ0
          PortPullDownOption = false
          PortPullUpOption = false
        PortPin15:
          PortBiDirectionControl = false
          PortDriveStrengthControl = DRIVE_STRENGTH_TYPE_1_SUPP_PDSC_PUCC
          PortInputBufferControl = false
          PortInputSelection = INPUT_BUFFER_TYPE_SCH1
          PortIpControl = false
          PortOpenDrainControl = OUTPUT_BUFFER_TYPE_PUSHPULL_SUPP_PODC_PODCE
          PortOutputLevelInversion = false
          PortPinDioAltModeChangeable = false
          PortPinDirection = PORT_PIN_IN
          PortPinDirectionChangeable = false
          PortPinInitialMode = DIO_SUPP_PFC_PFCE_PFCAE_PFCEAE_PMCSR
          PortPinLevelValue = PORT_PIN_LEVEL_LOW
          PortPinModeChangeable = false
          PortPinSafeStateControl = false
          PortPinSafeStateTrigger = ERROROUTZ0
          PortPullDownOption = false
          PortPullUpOption = false
        PortPin2:
          PortBiDirectionControl = false
          PortDriveStrengthControl = DRIVE_STRENGTH_TYPE_1_SUPP_PDSC_PUCC
          PortInputBufferControl = false
          PortInputSelection = INPUT_BUFFER_TYPE_SCH1
          PortIpControl = false
          PortOpenDrainControl = OUTPUT_BUFFER_TYPE_PUSHPULL_SUPP_PODC_PODCE
          PortOutputLevelInversion = false
          PortPinDioAltModeChangeable = false
          PortPinDirection = PORT_PIN_IN
          PortPinDirectionChangeable = false
          PortPinInitialMode = DIO_SUPP_PFC_PFCE_PFCAE_PFCEAE_PMCSR
          PortPinLevelValue = PORT_PIN_LEVEL_LOW
          PortPinModeChangeable = false
          PortPinSafeStateControl = false
          PortPinSafeStateTrigger = ERROROUTZ0
          PortPullDownOption = false
          PortPullUpOption = false
        PortPin3:
          PortBiDirectionControl = false
          PortDriveStrengthControl = DRIVE_STRENGTH_TYPE_1_SUPP_PDSC_PUCC
          PortInputBufferControl = false
          PortInputSelection = INPUT_BUFFER_TYPE_SCH1
          PortIpControl = false
          PortOpenDrainControl = OUTPUT_BUFFER_TYPE_PUSHPULL_SUPP_PODC_PODCE
          PortOutputLevelInversion = false
          PortPinDioAltModeChangeable = false
          PortPinDirection = PORT_PIN_IN
          PortPinDirectionChangeable = false
          PortPinInitialMode = DIO_SUPP_PFC_PFCE_PFCAE_PFCEAE_PMCSR
          PortPinLevelValue = PORT_PIN_LEVEL_LOW
          PortPinModeChangeable = false
          PortPinSafeStateControl = false
          PortPinSafeStateTrigger = ERROROUTZ0
          PortPullDownOption = false
          PortPullUpOption = false
        PortPin4:
          PortBiDirectionControl = false
          PortDriveStrengthControl = DRIVE_STRENGTH_TYPE_1_SUPP_PDSC_PUCC
          PortInputBufferControl = false
          PortInputSelection = INPUT_BUFFER_TYPE_SCH1
          PortIpControl = false
          PortOpenDrainControl = OUTPUT_BUFFER_TYPE_PUSHPULL_SUPP_PODC_PODCE
          PortOutputLevelInversion = false
          PortPinDioAltModeChangeable = false
          PortPinDirection = PORT_PIN_IN
          PortPinDirectionChangeable = false
          PortPinInitialMode = DIO_SUPP_PFC_PFCE_PFCAE_PFCEAE_PMCSR
          PortPinLevelValue = PORT_PIN_LEVEL_LOW
          PortPinModeChangeable = false
          PortPinSafeStateControl = false
          PortPinSafeStateTrigger = ERROROUTZ0
          PortPullDownOption = false
          PortPullUpOption = false
        PortPin5:
          PortBiDirectionControl = false
          PortDriveStrengthControl = DRIVE_STRENGTH_TYPE_1_SUPP_PDSC_PUCC
          PortInputBufferControl = false
          PortInputSelection = INPUT_BUFFER_TYPE_SCH1
          PortIpControl = false
          PortOpenDrainControl = OUTPUT_BUFFER_TYPE_PUSHPULL_SUPP_PODC_PODCE
          PortOutputLevelInversion = false
          PortPinDioAltModeChangeable = false
          PortPinDirection = PORT_PIN_IN
          PortPinDirectionChangeable = false
          PortPinInitialMode = DIO_SUPP_PFC_PFCE_PFCAE_PFCEAE_PMCSR
          PortPinLevelValue = PORT_PIN_LEVEL_LOW
          PortPinModeChangeable = false
          PortPinSafeStateControl = false
          PortPinSafeStateTrigger = ERROROUTZ0
          PortPullDownOption = false
          PortPullUpOption = false
        PortPin6:
          PortBiDirectionControl = false
          PortDriveStrengthControl = DRIVE_STRENGTH_TYPE_1_SUPP_PDSC_PUCC
          PortInputBufferControl = false
          PortInputSelection = INPUT_BUFFER_TYPE_SCH1
          PortIpControl = false
          PortOpenDrainControl = OUTPUT_BUFFER_TYPE_PUSHPULL_SUPP_PODC_PODCE
          PortOutputLevelInversion = false
          PortPinDioAltModeChangeable = false
          PortPinDirection = PORT_PIN_IN
          PortPinDirectionChangeable = false
          PortPinInitialMode = DIO_SUPP_PFC_PFCE_PFCAE_PFCEAE_PMCSR
          PortPinLevelValue = PORT_PIN_LEVEL_LOW
          PortPinModeChangeable = false
          PortPinSafeStateControl = false
          PortPinSafeStateTrigger = ERROROUTZ0
          PortPullDownOption = false
          PortPullUpOption = false
        PortPin7:
          PortBiDirectionControl = false
          PortDriveStrengthControl = DRIVE_STRENGTH_TYPE_1_SUPP_PDSC_PUCC
          PortInputBufferControl = false
          PortInputSelection = INPUT_BUFFER_TYPE_SCH1
          PortIpControl = false
          PortOpenDrainControl = OUTPUT_BUFFER_TYPE_PUSHPULL_SUPP_PODC_PODCE
          PortOutputLevelInversion = false
          PortPinDioAltModeChangeable = false
          PortPinDirection = PORT_PIN_IN
          PortPinDirectionChangeable = false
          PortPinInitialMode = DIO_SUPP_PFC_PFCE_PFCAE_PFCEAE_PMCSR
          PortPinLevelValue = PORT_PIN_LEVEL_LOW
          PortPinModeChangeable = false
          PortPinSafeStateControl = false
          PortPinSafeStateTrigger = ERROROUTZ0
          PortPullDownOption = false
          PortPullUpOption = false
        PortPin8:
          PortBiDirectionControl = false
          PortDriveStrengthControl = DRIVE_STRENGTH_TYPE_1_SUPP_PDSC_PUCC
          PortInputBufferControl = false
          PortInputSelection = INPUT_BUFFER_TYPE_SCH1
          PortIpControl = false
          PortOpenDrainControl = OUTPUT_BUFFER_TYPE_PUSHPULL_SUPP_PODC_PODCE
          PortOutputLevelInversion = false
          PortPinDioAltModeChangeable = false
          PortPinDirection = PORT_PIN_IN
          PortPinDirectionChangeable = false
          PortPinInitialMode = DIO_SUPP_PFC_PFCE_PFCAE_PFCEAE_PMCSR
          PortPinLevelValue = PORT_PIN_LEVEL_LOW
          PortPinModeChangeable = false
          PortPinSafeStateControl = false
          PortPinSafeStateTrigger = ERROROUTZ0
          PortPullDownOption = false
          PortPullUpOption = false
        PortPin9:
          PortBiDirectionControl = false
          PortDriveStrengthControl = DRIVE_STRENGTH_TYPE_1_SUPP_PDSC_PUCC
          PortInputBufferControl = false
          PortInputSelection = INPUT_BUFFER_TYPE_SCH1
          PortIpControl = false
          PortOpenDrainControl = OUTPUT_BUFFER_TYPE_PUSHPULL_SUPP_PODC_PODCE
          PortOutputLevelInversion = false
          PortPinDioAltModeChangeable = false
          PortPinDirection = PORT_PIN_IN
          PortPinDirectionChangeable = false
          PortPinInitialMode = DIO_SUPP_PFC_PFCE_PFCAE_PFCEAE_PMCSR
          PortPinLevelValue = PORT_PIN_LEVEL_LOW
          PortPinModeChangeable = false
          PortPinSafeStateControl = false
          PortPinSafeStateTrigger = ERROROUTZ0
          PortPullDownOption = false
          PortPullUpOption = false
      PortGroup4
        PortPin0:
          PortBiDirectionControl = false
          PortDriveStrengthControl = DRIVE_STRENGTH_TYPE_1_SUPP_PDSC_PUCC
          PortInputBufferControl = false
          PortInputSelection = INPUT_BUFFER_TYPE_SCH1
          PortIpControl = false
          PortOpenDrainControl = OUTPUT_BUFFER_TYPE_PUSHPULL_SUPP_PODC_PODCE
          PortOutputLevelInversion = false
          PortPinDioAltModeChangeable = false
          PortPinDirection = PORT_PIN_IN
          PortPinDirectionChangeable = false
          PortPinInitialMode = DIO_SUPP_PFC_PFCE_PFCAE_PFCEAE_PMCSR
          PortPinLevelValue = PORT_PIN_LEVEL_LOW
          PortPinModeChangeable = false
          PortPinSafeStateControl = false
          PortPinSafeStateTrigger = ERROROUTZ0
          PortPullDownOption = false
          PortPullUpOption = false
        PortPin1:
          PortBiDirectionControl = false
          PortDriveStrengthControl = DRIVE_STRENGTH_TYPE_1_SUPP_PDSC_PUCC
          PortInputBufferControl = false
          PortInputSelection = INPUT_BUFFER_TYPE_SCH1
          PortIpControl = false
          PortOpenDrainControl = OUTPUT_BUFFER_TYPE_PUSHPULL_SUPP_PODC_PODCE
          PortOutputLevelInversion = false
          PortPinDioAltModeChangeable = false
          PortPinDirection = PORT_PIN_IN
          PortPinDirectionChangeable = false
          PortPinInitialMode = DIO_SUPP_PFC_PFCE_PFCAE_PFCEAE_PMCSR
          PortPinLevelValue = PORT_PIN_LEVEL_LOW
          PortPinModeChangeable = false
          PortPinSafeStateControl = false
          PortPinSafeStateTrigger = ERROROUTZ0
          PortPullDownOption = false
          PortPullUpOption = false
        PortPin10:
          PortBiDirectionControl = false
          PortDriveStrengthControl = DRIVE_STRENGTH_TYPE_1_SUPP_PDSC_PUCC
          PortInputBufferControl = false
          PortInputSelection = INPUT_BUFFER_TYPE_SCH1
          PortIpControl = false
          PortOpenDrainControl = OUTPUT_BUFFER_TYPE_PUSHPULL_SUPP_PODC_PODCE
          PortOutputLevelInversion = false
          PortPinDioAltModeChangeable = false
          PortPinDirection = PORT_PIN_IN
          PortPinDirectionChangeable = false
          PortPinInitialMode = DIO_SUPP_PFC_PFCE_PFCAE_PFCEAE_PMCSR
          PortPinLevelValue = PORT_PIN_LEVEL_LOW
          PortPinModeChangeable = false
          PortPinSafeStateControl = false
          PortPinSafeStateTrigger = ERROROUTZ0
          PortPullDownOption = false
          PortPullUpOption = false
        PortPin11:
          PortBiDirectionControl = false
          PortDriveStrengthControl = DRIVE_STRENGTH_TYPE_1_SUPP_PDSC_PUCC
          PortInputBufferControl = false
          PortInputSelection = INPUT_BUFFER_TYPE_SCH1
          PortIpControl = false
          PortOpenDrainControl = OUTPUT_BUFFER_TYPE_PUSHPULL_SUPP_PODC_PODCE
          PortOutputLevelInversion = false
          PortPinDioAltModeChangeable = false
          PortPinDirection = PORT_PIN_IN
          PortPinDirectionChangeable = false
          PortPinInitialMode = DIO_SUPP_PFC_PFCE_PFCAE_PFCEAE_PMCSR
          PortPinLevelValue = PORT_PIN_LEVEL_LOW
          PortPinModeChangeable = false
          PortPinSafeStateControl = false
          PortPinSafeStateTrigger = ERROROUTZ0
          PortPullDownOption = false
          PortPullUpOption = false
        PortPin12:
          PortBiDirectionControl = false
          PortDriveStrengthControl = DRIVE_STRENGTH_TYPE_1_SUPP_PDSC_PUCC
          PortInputBufferControl = false
          PortInputSelection = INPUT_BUFFER_TYPE_SCH1
          PortIpControl = false
          PortOpenDrainControl = OUTPUT_BUFFER_TYPE_PUSHPULL_SUPP_PODC_PODCE
          PortOutputLevelInversion = false
          PortPinDioAltModeChangeable = false
          PortPinDirection = PORT_PIN_IN
          PortPinDirectionChangeable = false
          PortPinInitialMode = DIO_SUPP_PFC_PFCE_PFCAE_PFCEAE_PMCSR
          PortPinLevelValue = PORT_PIN_LEVEL_LOW
          PortPinModeChangeable = false
          PortPinSafeStateControl = false
          PortPinSafeStateTrigger = ERROROUTZ0
          PortPullDownOption = false
          PortPullUpOption = false
        PortPin13:
          PortBiDirectionControl = false
          PortDriveStrengthControl = DRIVE_STRENGTH_TYPE_1_SUPP_PDSC_PUCC
          PortInputBufferControl = false
          PortInputSelection = INPUT_BUFFER_TYPE_SCH1
          PortIpControl = false
          PortOpenDrainControl = OUTPUT_BUFFER_TYPE_PUSHPULL_SUPP_PODC_PODCE
          PortOutputLevelInversion = false
          PortPinDioAltModeChangeable = false
          PortPinDirection = PORT_PIN_IN
          PortPinDirectionChangeable = false
          PortPinInitialMode = DIO_SUPP_PFC_PFCE_PFCAE_PFCEAE_PMCSR
          PortPinLevelValue = PORT_PIN_LEVEL_LOW
          PortPinModeChangeable = false
          PortPinSafeStateControl = false
          PortPinSafeStateTrigger = ERROROUTZ0
          PortPullDownOption = false
          PortPullUpOption = false
        PortPin14:
          PortBiDirectionControl = false
          PortDriveStrengthControl = DRIVE_STRENGTH_TYPE_1_SUPP_PDSC_PUCC
          PortInputBufferControl = false
          PortInputSelection = INPUT_BUFFER_TYPE_SCH1
          PortIpControl = false
          PortOpenDrainControl = OUTPUT_BUFFER_TYPE_PUSHPULL_SUPP_PODC_PODCE
          PortOutputLevelInversion = false
          PortPinDioAltModeChangeable = false
          PortPinDirection = PORT_PIN_IN
          PortPinDirectionChangeable = false
          PortPinInitialMode = DIO_SUPP_PFC_PFCE_PFCAE_PFCEAE_PMCSR
          PortPinLevelValue = PORT_PIN_LEVEL_LOW
          PortPinModeChangeable = false
          PortPinSafeStateControl = false
          PortPinSafeStateTrigger = ERROROUTZ0
          PortPullDownOption = false
          PortPullUpOption = false
        PortPin15:
          PortBiDirectionControl = false
          PortDriveStrengthControl = DRIVE_STRENGTH_TYPE_1_SUPP_PDSC_PUCC
          PortInputBufferControl = false
          PortInputSelection = INPUT_BUFFER_TYPE_SCH1
          PortIpControl = false
          PortOpenDrainControl = OUTPUT_BUFFER_TYPE_PUSHPULL_SUPP_PODC_PODCE
          PortOutputLevelInversion = false
          PortPinDioAltModeChangeable = false
          PortPinDirection = PORT_PIN_IN
          PortPinDirectionChangeable = false
          PortPinInitialMode = DIO_SUPP_PFC_PFCE_PFCAE_PFCEAE_PMCSR
          PortPinLevelValue = PORT_PIN_LEVEL_LOW
          PortPinModeChangeable = false
          PortPinSafeStateControl = false
          PortPinSafeStateTrigger = ERROROUTZ0
          PortPullDownOption = false
          PortPullUpOption = false
        PortPin4:
          PortBiDirectionControl = false
          PortDriveStrengthControl = DRIVE_STRENGTH_TYPE_1_SUPP_PDSC_PUCC
          PortInputBufferControl = false
          PortInputSelection = INPUT_BUFFER_TYPE_SCH1
          PortIpControl = false
          PortOpenDrainControl = OUTPUT_BUFFER_TYPE_PUSHPULL_SUPP_PODC_PODCE
          PortOutputLevelInversion = false
          PortPinDioAltModeChangeable = false
          PortPinDirection = PORT_PIN_IN
          PortPinDirectionChangeable = false
          PortPinInitialMode = DIO_SUPP_PFC_PFCE_PFCAE_PFCEAE_PMCSR
          PortPinLevelValue = PORT_PIN_LEVEL_LOW
          PortPinModeChangeable = false
          PortPinSafeStateControl = false
          PortPinSafeStateTrigger = ERROROUTZ0
          PortPullDownOption = false
          PortPullUpOption = false
        PortPin5:
          PortBiDirectionControl = false
          PortDriveStrengthControl = DRIVE_STRENGTH_TYPE_1_SUPP_PDSC_PUCC
          PortInputBufferControl = false
          PortInputSelection = INPUT_BUFFER_TYPE_SCH1
          PortIpControl = false
          PortOpenDrainControl = OUTPUT_BUFFER_TYPE_PUSHPULL_SUPP_PODC_PODCE
          PortOutputLevelInversion = false
          PortPinDioAltModeChangeable = false
          PortPinDirection = PORT_PIN_IN
          PortPinDirectionChangeable = false
          PortPinInitialMode = DIO_SUPP_PFC_PFCE_PFCAE_PFCEAE_PMCSR
          PortPinLevelValue = PORT_PIN_LEVEL_LOW
          PortPinModeChangeable = false
          PortPinSafeStateControl = false
          PortPinSafeStateTrigger = ERROROUTZ0
          PortPullDownOption = false
          PortPullUpOption = false
        PortPin6:
          PortBiDirectionControl = false
          PortDriveStrengthControl = DRIVE_STRENGTH_TYPE_1_SUPP_PDSC_PUCC
          PortInputBufferControl = false
          PortInputSelection = INPUT_BUFFER_TYPE_SCH1
          PortIpControl = false
          PortOpenDrainControl = OUTPUT_BUFFER_TYPE_PUSHPULL_SUPP_PODC_PODCE
          PortOutputLevelInversion = false
          PortPinDioAltModeChangeable = false
          PortPinDirection = PORT_PIN_IN
          PortPinDirectionChangeable = false
          PortPinInitialMode = DIO_SUPP_PFC_PFCE_PFCAE_PFCEAE_PMCSR
          PortPinLevelValue = PORT_PIN_LEVEL_LOW
          PortPinModeChangeable = false
          PortPinSafeStateControl = false
          PortPinSafeStateTrigger = ERROROUTZ0
          PortPullDownOption = false
          PortPullUpOption = false
        PortPin7:
          PortBiDirectionControl = false
          PortDriveStrengthControl = DRIVE_STRENGTH_TYPE_1_SUPP_PDSC_PUCC
          PortInputBufferControl = false
          PortInputSelection = INPUT_BUFFER_TYPE_SCH1
          PortIpControl = false
          PortOpenDrainControl = OUTPUT_BUFFER_TYPE_PUSHPULL_SUPP_PODC_PODCE
          PortOutputLevelInversion = false
          PortPinDioAltModeChangeable = false
          PortPinDirection = PORT_PIN_IN
          PortPinDirectionChangeable = false
          PortPinInitialMode = DIO_SUPP_PFC_PFCE_PFCAE_PFCEAE_PMCSR
          PortPinLevelValue = PORT_PIN_LEVEL_LOW
          PortPinModeChangeable = false
          PortPinSafeStateControl = false
          PortPinSafeStateTrigger = ERROROUTZ0
          PortPullDownOption = false
          PortPullUpOption = false
        PortPin8:
          PortBiDirectionControl = false
          PortDriveStrengthControl = DRIVE_STRENGTH_TYPE_1_SUPP_PDSC_PUCC
          PortInputBufferControl = false
          PortInputSelection = INPUT_BUFFER_TYPE_SCH1
          PortIpControl = false
          PortOpenDrainControl = OUTPUT_BUFFER_TYPE_PUSHPULL_SUPP_PODC_PODCE
          PortOutputLevelInversion = false
          PortPinDioAltModeChangeable = false
          PortPinDirection = PORT_PIN_IN
          PortPinDirectionChangeable = false
          PortPinInitialMode = DIO_SUPP_PFC_PFCE_PFCAE_PFCEAE_PMCSR
          PortPinLevelValue = PORT_PIN_LEVEL_LOW
          PortPinModeChangeable = false
          PortPinSafeStateControl = false
          PortPinSafeStateTrigger = ERROROUTZ0
          PortPullDownOption = false
          PortPullUpOption = false
        PortPin9:
          PortBiDirectionControl = false
          PortDriveStrengthControl = DRIVE_STRENGTH_TYPE_1_SUPP_PDSC_PUCC
          PortInputBufferControl = false
          PortInputSelection = INPUT_BUFFER_TYPE_SCH1
          PortIpControl = false
          PortOpenDrainControl = OUTPUT_BUFFER_TYPE_PUSHPULL_SUPP_PODC_PODCE
          PortOutputLevelInversion = false
          PortPinDioAltModeChangeable = false
          PortPinDirection = PORT_PIN_IN
          PortPinDirectionChangeable = false
          PortPinInitialMode = DIO_SUPP_PFC_PFCE_PFCAE_PFCEAE_PMCSR
          PortPinLevelValue = PORT_PIN_LEVEL_LOW
          PortPinModeChangeable = false
          PortPinSafeStateControl = false
          PortPinSafeStateTrigger = ERROROUTZ0
          PortPullDownOption = false
          PortPullUpOption = false
      PortGroup5
        PortPin2:
          PortBiDirectionControl = false
          PortDriveStrengthControl = DRIVE_STRENGTH_TYPE_1_SUPP_PDSC_PUCC
          PortInputBufferControl = false
          PortInputSelection = INPUT_BUFFER_TYPE_SCH1
          PortIpControl = false
          PortOpenDrainControl = OUTPUT_BUFFER_TYPE_PUSHPULL_SUPP_PODC_PODCE
          PortOutputLevelInversion = false
          PortPinDioAltModeChangeable = false
          PortPinDirection = PORT_PIN_IN
          PortPinDirectionChangeable = false
          PortPinInitialMode = DIO_SUPP_PFC_PFCE_PFCAE_PFCEAE_PMCSR
          PortPinLevelValue = PORT_PIN_LEVEL_LOW
          PortPinModeChangeable = false
          PortPinSafeStateControl = false
          PortPinSafeStateTrigger = ERROROUTZ0
          PortPullDownOption = false
          PortPullUpOption = false
        PortPin3:
          PortBiDirectionControl = false
          PortDriveStrengthControl = DRIVE_STRENGTH_TYPE_1_SUPP_PDSC_PUCC
          PortInputBufferControl = false
          PortInputSelection = INPUT_BUFFER_TYPE_SCH1
          PortIpControl = false
          PortOpenDrainControl = OUTPUT_BUFFER_TYPE_PUSHPULL_SUPP_PODC_PODCE
          PortOutputLevelInversion = false
          PortPinDioAltModeChangeable = false
          PortPinDirection = PORT_PIN_IN
          PortPinDirectionChangeable = false
          PortPinInitialMode = DIO_SUPP_PFC_PFCE_PFCAE_PFCEAE_PMCSR
          PortPinLevelValue = PORT_PIN_LEVEL_LOW
          PortPinModeChangeable = false
          PortPinSafeStateControl = false
          PortPinSafeStateTrigger = ERROROUTZ0
          PortPullDownOption = false
          PortPullUpOption = false
        PortPin4:
          PortBiDirectionControl = false
          PortDriveStrengthControl = DRIVE_STRENGTH_TYPE_1_SUPP_PDSC_PUCC
          PortInputBufferControl = false
          PortInputSelection = INPUT_BUFFER_TYPE_SCH1
          PortIpControl = false
          PortOpenDrainControl = OUTPUT_BUFFER_TYPE_PUSHPULL_SUPP_PODC_PODCE
          PortOutputLevelInversion = false
          PortPinDioAltModeChangeable = false
          PortPinDirection = PORT_PIN_IN
          PortPinDirectionChangeable = false
          PortPinInitialMode = DIO_SUPP_PFC_PFCE_PFCAE_PFCEAE_PMCSR
          PortPinLevelValue = PORT_PIN_LEVEL_LOW
          PortPinModeChangeable = false
          PortPinSafeStateControl = false
          PortPinSafeStateTrigger = ERROROUTZ0
          PortPullDownOption = false
          PortPullUpOption = false
        PortPin6:
          PortBiDirectionControl = false
          PortDriveStrengthControl = DRIVE_STRENGTH_TYPE_1_SUPP_PDSC_PUCC
          PortInputBufferControl = false
          PortInputSelection = INPUT_BUFFER_TYPE_SCH1
          PortIpControl = false
          PortOpenDrainControl = OUTPUT_BUFFER_TYPE_PUSHPULL_SUPP_PODC_PODCE
          PortOutputLevelInversion = false
          PortPinDioAltModeChangeable = false
          PortPinDirection = PORT_PIN_IN
          PortPinDirectionChangeable = false
          PortPinInitialMode = DIO_SUPP_PFC_PFCE_PFCAE_PFCEAE_PMCSR
          PortPinLevelValue = PORT_PIN_LEVEL_LOW
          PortPinModeChangeable = false
          PortPinSafeStateControl = false
          PortPinSafeStateTrigger = ERROROUTZ0
          PortPullDownOption = false
          PortPullUpOption = false
      PortGroup6
        PortPin0:
          PortBiDirectionControl = false
          PortDriveStrengthControl = DRIVE_STRENGTH_TYPE_1_SUPP_PDSC_PUCC
          PortInputBufferControl = false
          PortInputSelection = INPUT_BUFFER_TYPE_SCH1
          PortIpControl = false
          PortOpenDrainControl = OUTPUT_BUFFER_TYPE_PUSHPULL_SUPP_PODC_PODCE
          PortOutputLevelInversion = false
          PortPinDioAltModeChangeable = false
          PortPinDirection = PORT_PIN_IN
          PortPinDirectionChangeable = false
          PortPinInitialMode = DIO_SUPP_PFC_PFCE_PFCAE_PFCEAE_PMCSR
          PortPinLevelValue = PORT_PIN_LEVEL_LOW
          PortPinModeChangeable = false
          PortPinSafeStateControl = false
          PortPinSafeStateTrigger = ERROROUTZ0
          PortPullDownOption = false
          PortPullUpOption = false
        PortPin10:
          PortBiDirectionControl = false
          PortDriveStrengthControl = DRIVE_STRENGTH_TYPE_1_SUPP_PDSC_PUCC
          PortInputBufferControl = false
          PortInputSelection = INPUT_BUFFER_TYPE_SCH1
          PortOpenDrainControl = OUTPUT_BUFFER_TYPE_PUSHPULL_SUPP_PODC_PODCE
          PortOutputLevelInversion = false
          PortPinDirection = PORT_PIN_IN
          PortPinDirectionChangeable = false
          PortPinInitialMode = DIO_SUPP_PM_PMSR
          PortPinLevelValue = PORT_PIN_LEVEL_LOW
          PortPinSafeStateControl = false
          PortPinSafeStateTrigger = ERROROUTZ0
          PortPullDownOption = false
          PortPullUpOption = false
        PortPin11:
          PortBiDirectionControl = false
          PortDriveStrengthControl = DRIVE_STRENGTH_TYPE_1_SUPP_PDSC_PUCC
          PortInputBufferControl = false
          PortInputSelection = INPUT_BUFFER_TYPE_SCH1
          PortIpControl = false
          PortOpenDrainControl = OUTPUT_BUFFER_TYPE_PUSHPULL_SUPP_PODC_PODCE
          PortOutputLevelInversion = false
          PortPinDioAltModeChangeable = false
          PortPinDirection = PORT_PIN_IN
          PortPinDirectionChangeable = false
          PortPinInitialMode = DIO_SUPP_PFC_PFCE_PFCAE_PFCEAE_PMCSR
          PortPinLevelValue = PORT_PIN_LEVEL_LOW
          PortPinModeChangeable = false
          PortPinSafeStateControl = false
          PortPinSafeStateTrigger = ERROROUTZ0
          PortPullDownOption = false
          PortPullUpOption = false
        PortPin12:
          PortBiDirectionControl = false
          PortDriveStrengthControl = DRIVE_STRENGTH_TYPE_1_SUPP_PDSC_PUCC
          PortInputBufferControl = false
          PortInputSelection = INPUT_BUFFER_TYPE_SCH1
          PortIpControl = false
          PortOpenDrainControl = OUTPUT_BUFFER_TYPE_PUSHPULL_SUPP_PODC_PODCE
          PortOutputLevelInversion = false
          PortPinDioAltModeChangeable = false
          PortPinDirection = PORT_PIN_IN
          PortPinDirectionChangeable = false
          PortPinInitialMode = DIO_SUPP_PFC_PFCE_PFCAE_PFCEAE_PMCSR
          PortPinLevelValue = PORT_PIN_LEVEL_LOW
          PortPinModeChangeable = false
          PortPinSafeStateControl = false
          PortPinSafeStateTrigger = ERROROUTZ0
          PortPullDownOption = false
          PortPullUpOption = false
        PortPin13:
          PortBiDirectionControl = false
          PortDriveStrengthControl = DRIVE_STRENGTH_TYPE_1_SUPP_PDSC_PUCC
          PortInputBufferControl = false
          PortInputSelection = INPUT_BUFFER_TYPE_SCH1
          PortIpControl = false
          PortOpenDrainControl = OUTPUT_BUFFER_TYPE_PUSHPULL_SUPP_PODC_PODCE
          PortOutputLevelInversion = false
          PortPinDioAltModeChangeable = false
          PortPinDirection = PORT_PIN_IN
          PortPinDirectionChangeable = false
          PortPinInitialMode = DIO_SUPP_PFC_PFCE_PFCAE_PFCEAE_PMCSR
          PortPinLevelValue = PORT_PIN_LEVEL_LOW
          PortPinModeChangeable = false
          PortPinSafeStateControl = false
          PortPinSafeStateTrigger = ERROROUTZ0
          PortPullDownOption = false
          PortPullUpOption = false
        PortPin14:
          PortBiDirectionControl = false
          PortDriveStrengthControl = DRIVE_STRENGTH_TYPE_1_SUPP_PDSC_PUCC
          PortInputBufferControl = false
          PortInputSelection = INPUT_BUFFER_TYPE_SCH1
          PortIpControl = false
          PortOpenDrainControl = OUTPUT_BUFFER_TYPE_PUSHPULL_SUPP_PODC_PODCE
          PortOutputLevelInversion = false
          PortPinDioAltModeChangeable = false
          PortPinDirection = PORT_PIN_IN
          PortPinDirectionChangeable = false
          PortPinInitialMode = DIO_SUPP_PFC_PFCE_PFCAE_PFCEAE_PMCSR
          PortPinLevelValue = PORT_PIN_LEVEL_LOW
          PortPinModeChangeable = false
          PortPinSafeStateControl = false
          PortPinSafeStateTrigger = ERROROUTZ0
          PortPullDownOption = false
          PortPullUpOption = false
        PortPin15:
          PortBiDirectionControl = false
          PortDriveStrengthControl = DRIVE_STRENGTH_TYPE_1_SUPP_PDSC_PUCC
          PortInputBufferControl = false
          PortInputSelection = INPUT_BUFFER_TYPE_SCH1
          PortIpControl = false
          PortOpenDrainControl = OUTPUT_BUFFER_TYPE_PUSHPULL_SUPP_PODC_PODCE
          PortOutputLevelInversion = false
          PortPinDioAltModeChangeable = false
          PortPinDirection = PORT_PIN_IN
          PortPinDirectionChangeable = false
          PortPinInitialMode = DIO_SUPP_PFC_PFCE_PFCAE_PFCEAE_PMCSR
          PortPinLevelValue = PORT_PIN_LEVEL_LOW
          PortPinModeChangeable = false
          PortPinSafeStateControl = false
          PortPinSafeStateTrigger = ERROROUTZ0
          PortPullDownOption = false
          PortPullUpOption = false
        PortPin2:
          PortBiDirectionControl = false
          PortDriveStrengthControl = DRIVE_STRENGTH_TYPE_1_SUPP_PDSC_PUCC
          PortInputBufferControl = false
          PortInputSelection = INPUT_BUFFER_TYPE_SCH1
          PortIpControl = false
          PortOpenDrainControl = OUTPUT_BUFFER_TYPE_PUSHPULL_SUPP_PODC_PODCE
          PortOutputLevelInversion = false
          PortPinDioAltModeChangeable = false
          PortPinDirection = PORT_PIN_IN
          PortPinDirectionChangeable = false
          PortPinInitialMode = DIO_SUPP_PFC_PFCE_PFCAE_PFCEAE_PMCSR
          PortPinLevelValue = PORT_PIN_LEVEL_LOW
          PortPinModeChangeable = false
          PortPinSafeStateControl = false
          PortPinSafeStateTrigger = ERROROUTZ0
          PortPullDownOption = false
          PortPullUpOption = false
        PortPin3:
          PortBiDirectionControl = false
          PortDriveStrengthControl = DRIVE_STRENGTH_TYPE_1_SUPP_PDSC_PUCC
          PortInputBufferControl = false
          PortInputSelection = INPUT_BUFFER_TYPE_SCH1
          PortIpControl = false
          PortOpenDrainControl = OUTPUT_BUFFER_TYPE_PUSHPULL_SUPP_PODC_PODCE
          PortOutputLevelInversion = false
          PortPinDioAltModeChangeable = false
          PortPinDirection = PORT_PIN_IN
          PortPinDirectionChangeable = false
          PortPinInitialMode = DIO_SUPP_PFC_PFCE_PFCAE_PFCEAE_PMCSR
          PortPinLevelValue = PORT_PIN_LEVEL_LOW
          PortPinModeChangeable = false
          PortPinSafeStateControl = false
          PortPinSafeStateTrigger = ERROROUTZ0
          PortPullDownOption = false
          PortPullUpOption = false
        PortPin4:
          PortBiDirectionControl = false
          PortDriveStrengthControl = DRIVE_STRENGTH_TYPE_1_SUPP_PDSC_PUCC
          PortInputBufferControl = false
          PortInputSelection = INPUT_BUFFER_TYPE_SCH1
          PortIpControl = false
          PortOpenDrainControl = OUTPUT_BUFFER_TYPE_PUSHPULL_SUPP_PODC_PODCE
          PortOutputLevelInversion = false
          PortPinDioAltModeChangeable = false
          PortPinDirection = PORT_PIN_IN
          PortPinDirectionChangeable = false
          PortPinInitialMode = DIO_SUPP_PFC_PFCE_PFCAE_PFCEAE_PMCSR
          PortPinLevelValue = PORT_PIN_LEVEL_LOW
          PortPinModeChangeable = false
          PortPinSafeStateControl = false
          PortPinSafeStateTrigger = ERROROUTZ0
          PortPullDownOption = false
          PortPullUpOption = false
        PortPin5:
          PortBiDirectionControl = false
          PortDriveStrengthControl = DRIVE_STRENGTH_TYPE_1_SUPP_PDSC_PUCC
          PortInputBufferControl = false
          PortInputSelection = INPUT_BUFFER_TYPE_SCH1
          PortIpControl = false
          PortOpenDrainControl = OUTPUT_BUFFER_TYPE_PUSHPULL_SUPP_PODC_PODCE
          PortOutputLevelInversion = false
          PortPinDioAltModeChangeable = false
          PortPinDirection = PORT_PIN_IN
          PortPinDirectionChangeable = false
          PortPinInitialMode = DIO_SUPP_PFC_PFCE_PFCAE_PFCEAE_PMCSR
          PortPinLevelValue = PORT_PIN_LEVEL_LOW
          PortPinModeChangeable = false
          PortPinSafeStateControl = false
          PortPinSafeStateTrigger = ERROROUTZ0
          PortPullDownOption = false
          PortPullUpOption = false
        PortPin6:
          PortBiDirectionControl = false
          PortDriveStrengthControl = DRIVE_STRENGTH_TYPE_1_SUPP_PDSC_PUCC
          PortInputBufferControl = false
          PortInputSelection = INPUT_BUFFER_TYPE_SCH1
          PortIpControl = false
          PortOpenDrainControl = OUTPUT_BUFFER_TYPE_PUSHPULL_SUPP_PODC_PODCE
          PortOutputLevelInversion = false
          PortPinDioAltModeChangeable = false
          PortPinDirection = PORT_PIN_IN
          PortPinDirectionChangeable = false
          PortPinInitialMode = DIO_SUPP_PFC_PFCE_PFCAE_PFCEAE_PMCSR
          PortPinLevelValue = PORT_PIN_LEVEL_LOW
          PortPinModeChangeable = false
          PortPinSafeStateControl = false
          PortPinSafeStateTrigger = ERROROUTZ0
          PortPullDownOption = false
          PortPullUpOption = false
        PortPin7:
          PortBiDirectionControl = false
          PortDriveStrengthControl = DRIVE_STRENGTH_TYPE_1_SUPP_PDSC_PUCC
          PortInputBufferControl = false
          PortInputSelection = INPUT_BUFFER_TYPE_SCH1
          PortIpControl = false
          PortOpenDrainControl = OUTPUT_BUFFER_TYPE_PUSHPULL_SUPP_PODC_PODCE
          PortOutputLevelInversion = false
          PortPinDioAltModeChangeable = false
          PortPinDirection = PORT_PIN_IN
          PortPinDirectionChangeable = false
          PortPinInitialMode = DIO_SUPP_PFC_PFCE_PFCAE_PFCEAE_PMCSR
          PortPinLevelValue = PORT_PIN_LEVEL_LOW
          PortPinModeChangeable = false
          PortPinSafeStateControl = false
          PortPinSafeStateTrigger = ERROROUTZ0
          PortPullDownOption = false
          PortPullUpOption = false
        PortPin8:
          PortBiDirectionControl = false
          PortDriveStrengthControl = DRIVE_STRENGTH_TYPE_1_SUPP_PDSC_PUCC
          PortInputBufferControl = false
          PortInputSelection = INPUT_BUFFER_TYPE_SCH1
          PortIpControl = false
          PortOpenDrainControl = OUTPUT_BUFFER_TYPE_PUSHPULL_SUPP_PODC_PODCE
          PortOutputLevelInversion = false
          PortPinDioAltModeChangeable = false
          PortPinDirection = PORT_PIN_IN
          PortPinDirectionChangeable = false
          PortPinInitialMode = DIO_SUPP_PFC_PFCE_PFCAE_PFCEAE_PMCSR
          PortPinLevelValue = PORT_PIN_LEVEL_LOW
          PortPinModeChangeable = false
          PortPinSafeStateControl = false
          PortPinSafeStateTrigger = ERROROUTZ0
          PortPullDownOption = false
          PortPullUpOption = false
        PortPin9:
          PortBiDirectionControl = false
          PortDriveStrengthControl = DRIVE_STRENGTH_TYPE_1_SUPP_PDSC_PUCC
          PortInputBufferControl = false
          PortInputSelection = INPUT_BUFFER_TYPE_SCH1
          PortIpControl = false
          PortOpenDrainControl = OUTPUT_BUFFER_TYPE_PUSHPULL_SUPP_PODC_PODCE
          PortOutputLevelInversion = false
          PortPinDioAltModeChangeable = false
          PortPinDirection = PORT_PIN_IN
          PortPinDirectionChangeable = false
          PortPinInitialMode = DIO_SUPP_PFC_PFCE_PFCAE_PFCEAE_PMCSR
          PortPinLevelValue = PORT_PIN_LEVEL_LOW
          PortPinModeChangeable = false
          PortPinSafeStateControl = false
          PortPinSafeStateTrigger = ERROROUTZ0
          PortPullDownOption = false
          PortPullUpOption = false
      PortGroup10
        PortPin0:
          PortBiDirectionControl = false
          PortDriveStrengthControl = DRIVE_STRENGTH_TYPE_1_SUPP_PDSC_PUCC
          PortInputBufferControl = false
          PortInputSelection = INPUT_BUFFER_TYPE_SCH1
          PortIpControl = false
          PortOpenDrainControl = OUTPUT_BUFFER_TYPE_PUSHPULL_SUPP_PODC_PODCE
          PortOutputLevelInversion = false
          PortPinDioAltModeChangeable = false
          PortPinDirection = PORT_PIN_IN
          PortPinDirectionChangeable = false
          PortPinInitialMode = DIO_SUPP_PFC_PFCE_PFCAE_PFCEAE_PMCSR
          PortPinLevelValue = PORT_PIN_LEVEL_LOW
          PortPinModeChangeable = false
          PortPinSafeStateControl = false
          PortPinSafeStateTrigger = ERROROUTZ0
          PortPullDownOption = false
          PortPullUpOption = false
        PortPin1:
          PortBiDirectionControl = false
          PortDriveStrengthControl = DRIVE_STRENGTH_TYPE_1_SUPP_PDSC_PUCC
          PortInputBufferControl = false
          PortInputSelection = INPUT_BUFFER_TYPE_SCH1
          PortIpControl = false
          PortOpenDrainControl = OUTPUT_BUFFER_TYPE_PUSHPULL_SUPP_PODC_PODCE
          PortOutputLevelInversion = false
          PortPinDioAltModeChangeable = false
          PortPinDirection = PORT_PIN_IN
          PortPinDirectionChangeable = false
          PortPinInitialMode = DIO_SUPP_PFC_PFCE_PFCAE_PFCEAE_PMCSR
          PortPinLevelValue = PORT_PIN_LEVEL_LOW
          PortPinModeChangeable = false
          PortPinSafeStateControl = false
          PortPinSafeStateTrigger = ERROROUTZ0
          PortPullDownOption = false
          PortPullUpOption = false
        PortPin10:
          PortBiDirectionControl = false
          PortDriveStrengthControl = DRIVE_STRENGTH_TYPE_1_SUPP_PDSC_PUCC
          PortInputBufferControl = false
          PortInputSelection = INPUT_BUFFER_TYPE_SCH1
          PortIpControl = false
          PortOpenDrainControl = OUTPUT_BUFFER_TYPE_PUSHPULL_SUPP_PODC_PODCE
          PortOutputLevelInversion = false
          PortPinDioAltModeChangeable = false
          PortPinDirection = PORT_PIN_IN
          PortPinDirectionChangeable = false
          PortPinInitialMode = DIO_SUPP_PFC_PFCE_PFCAE_PFCEAE_PMCSR
          PortPinLevelValue = PORT_PIN_LEVEL_LOW
          PortPinModeChangeable = false
          PortPinSafeStateControl = false
          PortPinSafeStateTrigger = ERROROUTZ0
          PortPullDownOption = false
          PortPullUpOption = false
        PortPin11:
          PortBiDirectionControl = false
          PortDriveStrengthControl = DRIVE_STRENGTH_TYPE_1_SUPP_PDSC_PUCC
          PortInputBufferControl = false
          PortInputSelection = INPUT_BUFFER_TYPE_SCH1
          PortIpControl = false
          PortOpenDrainControl = OUTPUT_BUFFER_TYPE_PUSHPULL_SUPP_PODC_PODCE
          PortOutputLevelInversion = false
          PortPinDioAltModeChangeable = false
          PortPinDirection = PORT_PIN_IN
          PortPinDirectionChangeable = false
          PortPinInitialMode = DIO_SUPP_PFC_PFCE_PFCAE_PFCEAE_PMCSR
          PortPinLevelValue = PORT_PIN_LEVEL_LOW
          PortPinModeChangeable = false
          PortPinSafeStateControl = false
          PortPinSafeStateTrigger = ERROROUTZ0
          PortPullDownOption = false
          PortPullUpOption = false
        PortPin12:
          PortBiDirectionControl = false
          PortDriveStrengthControl = DRIVE_STRENGTH_TYPE_1_SUPP_PDSC_PUCC
          PortInputBufferControl = false
          PortInputSelection = INPUT_BUFFER_TYPE_SCH1
          PortIpControl = false
          PortOpenDrainControl = OUTPUT_BUFFER_TYPE_PUSHPULL_SUPP_PODC_PODCE
          PortOutputLevelInversion = false
          PortPinDioAltModeChangeable = false
          PortPinDirection = PORT_PIN_IN
          PortPinDirectionChangeable = false
          PortPinInitialMode = DIO_SUPP_PFC_PFCE_PFCAE_PFCEAE_PMCSR
          PortPinLevelValue = PORT_PIN_LEVEL_LOW
          PortPinModeChangeable = false
          PortPinSafeStateControl = false
          PortPinSafeStateTrigger = ERROROUTZ0
          PortPullDownOption = false
          PortPullUpOption = false
        PortPin13:
          PortBiDirectionControl = false
          PortDriveStrengthControl = DRIVE_STRENGTH_TYPE_1_SUPP_PDSC_PUCC
          PortInputBufferControl = false
          PortInputSelection = INPUT_BUFFER_TYPE_SCH1
          PortIpControl = false
          PortOpenDrainControl = OUTPUT_BUFFER_TYPE_PUSHPULL_SUPP_PODC_PODCE
          PortOutputLevelInversion = false
          PortPinDioAltModeChangeable = false
          PortPinDirection = PORT_PIN_IN
          PortPinDirectionChangeable = false
          PortPinInitialMode = DIO_SUPP_PFC_PFCE_PFCAE_PFCEAE_PMCSR
          PortPinLevelValue = PORT_PIN_LEVEL_LOW
          PortPinModeChangeable = false
          PortPinSafeStateControl = false
          PortPinSafeStateTrigger = ERROROUTZ0
          PortPullDownOption = false
          PortPullUpOption = false
        PortPin14:
          PortBiDirectionControl = false
          PortDriveStrengthControl = DRIVE_STRENGTH_TYPE_1_SUPP_PDSC_PUCC
          PortInputBufferControl = false
          PortInputSelection = INPUT_BUFFER_TYPE_SCH1
          PortIpControl = false
          PortOpenDrainControl = OUTPUT_BUFFER_TYPE_PUSHPULL_SUPP_PODC_PODCE
          PortOutputLevelInversion = false
          PortPinDioAltModeChangeable = false
          PortPinDirection = PORT_PIN_IN
          PortPinDirectionChangeable = false
          PortPinInitialMode = DIO_SUPP_PFC_PFCE_PFCAE_PFCEAE_PMCSR
          PortPinLevelValue = PORT_PIN_LEVEL_LOW
          PortPinModeChangeable = false
          PortPinSafeStateControl = false
          PortPinSafeStateTrigger = ERROROUTZ0
          PortPullDownOption = false
          PortPullUpOption = false
        PortPin2:
          PortBiDirectionControl = false
          PortDriveStrengthControl = DRIVE_STRENGTH_TYPE_1_SUPP_PDSC_PUCC
          PortInputBufferControl = false
          PortInputSelection = INPUT_BUFFER_TYPE_SCH1
          PortIpControl = false
          PortOpenDrainControl = OUTPUT_BUFFER_TYPE_PUSHPULL_SUPP_PODC_PODCE
          PortOutputLevelInversion = false
          PortPinDioAltModeChangeable = false
          PortPinDirection = PORT_PIN_IN
          PortPinDirectionChangeable = false
          PortPinInitialMode = DIO_SUPP_PFC_PFCE_PFCAE_PFCEAE_PMCSR
          PortPinLevelValue = PORT_PIN_LEVEL_LOW
          PortPinModeChangeable = false
          PortPinSafeStateControl = false
          PortPinSafeStateTrigger = ERROROUTZ0
          PortPullDownOption = false
          PortPullUpOption = false
        PortPin3:
          PortBiDirectionControl = false
          PortDriveStrengthControl = DRIVE_STRENGTH_TYPE_1_SUPP_PDSC_PUCC
          PortInputBufferControl = false
          PortInputSelection = INPUT_BUFFER_TYPE_SCH1
          PortIpControl = false
          PortOpenDrainControl = OUTPUT_BUFFER_TYPE_PUSHPULL_SUPP_PODC_PODCE
          PortOutputLevelInversion = false
          PortPinDioAltModeChangeable = false
          PortPinDirection = PORT_PIN_IN
          PortPinDirectionChangeable = false
          PortPinInitialMode = DIO_SUPP_PFC_PFCE_PFCAE_PFCEAE_PMCSR
          PortPinLevelValue = PORT_PIN_LEVEL_LOW
          PortPinModeChangeable = false
          PortPinSafeStateControl = false
          PortPinSafeStateTrigger = ERROROUTZ0
          PortPullDownOption = false
          PortPullUpOption = false
        PortPin4:
          PortBiDirectionControl = false
          PortDriveStrengthControl = DRIVE_STRENGTH_TYPE_1_SUPP_PDSC_PUCC
          PortInputBufferControl = false
          PortInputSelection = INPUT_BUFFER_TYPE_SCH1
          PortIpControl = false
          PortOpenDrainControl = OUTPUT_BUFFER_TYPE_PUSHPULL_SUPP_PODC_PODCE
          PortOutputLevelInversion = false
          PortPinDioAltModeChangeable = false
          PortPinDirection = PORT_PIN_IN
          PortPinDirectionChangeable = false
          PortPinInitialMode = DIO_SUPP_PFC_PFCE_PFCAE_PFCEAE_PMCSR
          PortPinLevelValue = PORT_PIN_LEVEL_LOW
          PortPinModeChangeable = false
          PortPinSafeStateControl = false
          PortPinSafeStateTrigger = ERROROUTZ0
          PortPullDownOption = false
          PortPullUpOption = false
        PortPin5:
          PortBiDirectionControl = false
          PortDriveStrengthControl = DRIVE_STRENGTH_TYPE_1_SUPP_PDSC_PUCC
          PortInputBufferControl = false
          PortInputSelection = INPUT_BUFFER_TYPE_SCH1
          PortIpControl = false
          PortOpenDrainControl = OUTPUT_BUFFER_TYPE_PUSHPULL_SUPP_PODC_PODCE
          PortOutputLevelInversion = false
          PortPinDioAltModeChangeable = false
          PortPinDirection = PORT_PIN_IN
          PortPinDirectionChangeable = false
          PortPinInitialMode = DIO_SUPP_PFC_PFCE_PFCAE_PFCEAE_PMCSR
          PortPinLevelValue = PORT_PIN_LEVEL_LOW
          PortPinModeChangeable = false
          PortPinSafeStateControl = false
          PortPinSafeStateTrigger = ERROROUTZ0
          PortPullDownOption = false
          PortPullUpOption = false
        PortPin6:
          PortBiDirectionControl = false
          PortDriveStrengthControl = DRIVE_STRENGTH_TYPE_1_SUPP_PDSC_PUCC
          PortInputBufferControl = false
          PortInputSelection = INPUT_BUFFER_TYPE_SCH1
          PortIpControl = false
          PortOpenDrainControl = OUTPUT_BUFFER_TYPE_PUSHPULL_SUPP_PODC_PODCE
          PortOutputLevelInversion = false
          PortPinDioAltModeChangeable = false
          PortPinDirection = PORT_PIN_IN
          PortPinDirectionChangeable = false
          PortPinInitialMode = DIO_SUPP_PFC_PFCE_PFCAE_PFCEAE_PMCSR
          PortPinLevelValue = PORT_PIN_LEVEL_LOW
          PortPinModeChangeable = false
          PortPinSafeStateControl = false
          PortPinSafeStateTrigger = ERROROUTZ0
          PortPullDownOption = false
          PortPullUpOption = false
        PortPin7:
          PortBiDirectionControl = false
          PortDriveStrengthControl = DRIVE_STRENGTH_TYPE_1_SUPP_PDSC_PUCC
          PortInputBufferControl = false
          PortInputSelection = INPUT_BUFFER_TYPE_SCH1
          PortIpControl = false
          PortOpenDrainControl = OUTPUT_BUFFER_TYPE_PUSHPULL_SUPP_PODC_PODCE
          PortOutputLevelInversion = false
          PortPinDioAltModeChangeable = false
          PortPinDirection = PORT_PIN_IN
          PortPinDirectionChangeable = false
          PortPinInitialMode = DIO_SUPP_PFC_PFCE_PFCAE_PFCEAE_PMCSR
          PortPinLevelValue = PORT_PIN_LEVEL_LOW
          PortPinModeChangeable = false
          PortPinSafeStateControl = false
          PortPinSafeStateTrigger = ERROROUTZ0
          PortPullDownOption = false
          PortPullUpOption = false
        PortPin8:
          PortBiDirectionControl = false
          PortDriveStrengthControl = DRIVE_STRENGTH_TYPE_1_SUPP_PDSC_PUCC
          PortInputBufferControl = false
          PortInputSelection = INPUT_BUFFER_TYPE_SCH1
          PortIpControl = false
          PortOpenDrainControl = OUTPUT_BUFFER_TYPE_PUSHPULL_SUPP_PODC_PODCE
          PortOutputLevelInversion = false
          PortPinDioAltModeChangeable = false
          PortPinDirection = PORT_PIN_IN
          PortPinDirectionChangeable = false
          PortPinInitialMode = DIO_SUPP_PFC_PFCE_PFCAE_PFCEAE_PMCSR
          PortPinLevelValue = PORT_PIN_LEVEL_LOW
          PortPinModeChangeable = false
          PortPinSafeStateControl = false
          PortPinSafeStateTrigger = ERROROUTZ0
          PortPullDownOption = false
          PortPullUpOption = false
        PortPin9:
          PortBiDirectionControl = false
          PortDriveStrengthControl = DRIVE_STRENGTH_TYPE_1_SUPP_PDSC_PUCC
          PortInputBufferControl = false
          PortInputSelection = INPUT_BUFFER_TYPE_SCH1
          PortIpControl = false
          PortOpenDrainControl = OUTPUT_BUFFER_TYPE_PUSHPULL_SUPP_PODC_PODCE
          PortOutputLevelInversion = false
          PortPinDioAltModeChangeable = false
          PortPinDirection = PORT_PIN_IN
          PortPinDirectionChangeable = false
          PortPinInitialMode = DIO_SUPP_PFC_PFCE_PFCAE_PFCEAE_PMCSR
          PortPinLevelValue = PORT_PIN_LEVEL_LOW
          PortPinModeChangeable = false
          PortPinSafeStateControl = false
          PortPinSafeStateTrigger = ERROROUTZ0
          PortPullDownOption = false
          PortPullUpOption = false
      PortGroup17
        PortPin0:
          PortBiDirectionControl = false
          PortDriveStrengthControl = DRIVE_STRENGTH_TYPE_1_SUPP_PDSC_PUCC
          PortInputBufferControl = false
          PortInputSelection = INPUT_BUFFER_TYPE_SCH1
          PortIpControl = false
          PortOpenDrainControl = OUTPUT_BUFFER_TYPE_PUSHPULL_SUPP_PODC_PODCE
          PortOutputLevelInversion = false
          PortPinDioAltModeChangeable = false
          PortPinDirection = PORT_PIN_IN
          PortPinDirectionChangeable = false
          PortPinInitialMode = DIO_SUPP_PFC_PFCE_PFCAE_PFCEAE_PMCSR
          PortPinLevelValue = PORT_PIN_LEVEL_LOW
          PortPinModeChangeable = false
          PortPinSafeStateControl = false
          PortPinSafeStateTrigger = ERROROUTZ0
          PortPullDownOption = false
          PortPullUpOption = false
        PortPin1:
          PortBiDirectionControl = false
          PortDriveStrengthControl = DRIVE_STRENGTH_TYPE_1_SUPP_PDSC_PUCC
          PortInputBufferControl = false
          PortInputSelection = INPUT_BUFFER_TYPE_SCH1
          PortIpControl = false
          PortOpenDrainControl = OUTPUT_BUFFER_TYPE_PUSHPULL_SUPP_PODC_PODCE
          PortOutputLevelInversion = false
          PortPinDioAltModeChangeable = false
          PortPinDirection = PORT_PIN_IN
          PortPinDirectionChangeable = false
          PortPinInitialMode = DIO_SUPP_PFC_PFCE_PFCAE_PFCEAE_PMCSR
          PortPinLevelValue = PORT_PIN_LEVEL_LOW
          PortPinModeChangeable = false
          PortPinSafeStateControl = false
          PortPinSafeStateTrigger = ERROROUTZ0
          PortPullDownOption = false
          PortPullUpOption = false
        PortPin2:
          PortBiDirectionControl = false
          PortDriveStrengthControl = DRIVE_STRENGTH_TYPE_1_SUPP_PDSC_PUCC
          PortInputBufferControl = false
          PortInputSelection = INPUT_BUFFER_TYPE_SCH1
          PortIpControl = false
          PortOpenDrainControl = OUTPUT_BUFFER_TYPE_PUSHPULL_SUPP_PODC_PODCE
          PortOutputLevelInversion = false
          PortPinDioAltModeChangeable = false
          PortPinDirection = PORT_PIN_IN
          PortPinDirectionChangeable = false
          PortPinInitialMode = DIO_SUPP_PFC_PFCE_PFCAE_PFCEAE_PMCSR
          PortPinLevelValue = PORT_PIN_LEVEL_LOW
          PortPinModeChangeable = false
          PortPinSafeStateControl = false
          PortPinSafeStateTrigger = ERROROUTZ0
          PortPullDownOption = false
          PortPullUpOption = false
        PortPin3:
          PortBiDirectionControl = false
          PortDriveStrengthControl = DRIVE_STRENGTH_TYPE_1_SUPP_PDSC_PUCC
          PortInputBufferControl = false
          PortInputSelection = INPUT_BUFFER_TYPE_SCH1
          PortIpControl = false
          PortOpenDrainControl = OUTPUT_BUFFER_TYPE_PUSHPULL_SUPP_PODC_PODCE
          PortOutputLevelInversion = false
          PortPinDioAltModeChangeable = false
          PortPinDirection = PORT_PIN_IN
          PortPinDirectionChangeable = false
          PortPinInitialMode = DIO_SUPP_PFC_PFCE_PFCAE_PFCEAE_PMCSR
          PortPinLevelValue = PORT_PIN_LEVEL_LOW
          PortPinModeChangeable = false
          PortPinSafeStateControl = false
          PortPinSafeStateTrigger = ERROROUTZ0
          PortPullDownOption = false
          PortPullUpOption = false
        PortPin4:
          PortBiDirectionControl = false
          PortDriveStrengthControl = DRIVE_STRENGTH_TYPE_1_SUPP_PDSC_PUCC
          PortInputBufferControl = false
          PortInputSelection = INPUT_BUFFER_TYPE_SCH1
          PortIpControl = false
          PortOpenDrainControl = OUTPUT_BUFFER_TYPE_PUSHPULL_SUPP_PODC_PODCE
          PortOutputLevelInversion = false
          PortPinDioAltModeChangeable = false
          PortPinDirection = PORT_PIN_IN
          PortPinDirectionChangeable = false
          PortPinInitialMode = DIO_SUPP_PFC_PFCE_PFCAE_PFCEAE_PMCSR
          PortPinLevelValue = PORT_PIN_LEVEL_LOW
          PortPinModeChangeable = false
          PortPinSafeStateControl = false
          PortPinSafeStateTrigger = ERROROUTZ0
          PortPullDownOption = false
          PortPullUpOption = false
        PortPin5:
          PortBiDirectionControl = false
          PortDriveStrengthControl = DRIVE_STRENGTH_TYPE_1_SUPP_PDSC_PUCC
          PortInputBufferControl = false
          PortInputSelection = INPUT_BUFFER_TYPE_SCH1
          PortOpenDrainControl = OUTPUT_BUFFER_TYPE_PUSHPULL_SUPP_PODC_PODCE
          PortOutputLevelInversion = false
          PortPinDioAltModeChangeable = false
          PortPinDirection = PORT_PIN_IN
          PortPinDirectionChangeable = false
          PortPinInitialMode = DIO_SUPP_PFC_PFCE_PFCAE_PFCEAE_PMCSR
          PortPinLevelValue = PORT_PIN_LEVEL_LOW
          PortPinModeChangeable = false
          PortPinSafeStateControl = false
          PortPinSafeStateTrigger = ERROROUTZ0
          PortPullDownOption = false
          PortPullUpOption = false
        PortPin6:
          PortBiDirectionControl = false
          PortDriveStrengthControl = DRIVE_STRENGTH_TYPE_1_SUPP_PDSC_PUCC
          PortInputBufferControl = false
          PortInputSelection = INPUT_BUFFER_TYPE_SCH1
          PortOpenDrainControl = OUTPUT_BUFFER_TYPE_PUSHPULL_SUPP_PODC_PODCE
          PortOutputLevelInversion = false
          PortPinDioAltModeChangeable = false
          PortPinDirection = PORT_PIN_IN
          PortPinDirectionChangeable = false
          PortPinInitialMode = DIO_SUPP_PFC_PFCE_PFCAE_PFCEAE_PMCSR
          PortPinLevelValue = PORT_PIN_LEVEL_LOW
          PortPinModeChangeable = false
          PortPinSafeStateControl = false
          PortPinSafeStateTrigger = ERROROUTZ0
          PortPullDownOption = false
          PortPullUpOption = false
      PortGroup20
        PortPin0:
          PortBiDirectionControl = false
          PortDriveStrengthControl = DRIVE_STRENGTH_TYPE_1_SUPP_PDSC_PUCC
          PortInputBufferControl = false
          PortInputSelection = INPUT_BUFFER_TYPE_SCH1
          PortIpControl = false
          PortOpenDrainControl = OUTPUT_BUFFER_TYPE_PUSHPULL_SUPP_PODC_PODCE
          PortOutputLevelInversion = false
          PortPinDioAltModeChangeable = false
          PortPinDirection = PORT_PIN_IN
          PortPinDirectionChangeable = false
          PortPinInitialMode = DIO_SUPP_PFC_PFCE_PFCAE_PFCEAE_PMCSR
          PortPinLevelValue = PORT_PIN_LEVEL_LOW
          PortPinModeChangeable = false
          PortPinSafeStateControl = false
          PortPinSafeStateTrigger = ERROROUTZ0
          PortPullDownOption = false
          PortPullUpOption = false
        PortPin1:
          PortBiDirectionControl = false
          PortDriveStrengthControl = DRIVE_STRENGTH_TYPE_1_SUPP_PDSC_PUCC
          PortInputBufferControl = false
          PortInputSelection = INPUT_BUFFER_TYPE_SCH1
          PortIpControl = false
          PortOpenDrainControl = OUTPUT_BUFFER_TYPE_PUSHPULL_SUPP_PODC_PODCE
          PortOutputLevelInversion = false
          PortPinDioAltModeChangeable = false
          PortPinDirection = PORT_PIN_IN
          PortPinDirectionChangeable = false
          PortPinInitialMode = DIO_SUPP_PFC_PFCE_PFCAE_PFCEAE_PMCSR
          PortPinLevelValue = PORT_PIN_LEVEL_LOW
          PortPinModeChangeable = false
          PortPinSafeStateControl = false
          PortPinSafeStateTrigger = ERROROUTZ0
          PortPullDownOption = false
          PortPullUpOption = false
        PortPin10:
          PortBiDirectionControl = false
          PortDriveStrengthControl = DRIVE_STRENGTH_TYPE_1_SUPP_PDSC_PUCC
          PortInputBufferControl = false
          PortInputSelection = INPUT_BUFFER_TYPE_SCH1
          PortIpControl = false
          PortOpenDrainControl = OUTPUT_BUFFER_TYPE_PUSHPULL_SUPP_PODC_PODCE
          PortOutputLevelInversion = false
          PortPinDioAltModeChangeable = false
          PortPinDirection = PORT_PIN_IN
          PortPinDirectionChangeable = false
          PortPinInitialMode = DIO_SUPP_PFC_PFCE_PFCAE_PFCEAE_PMCSR
          PortPinLevelValue = PORT_PIN_LEVEL_LOW
          PortPinModeChangeable = false
          PortPinSafeStateControl = false
          PortPinSafeStateTrigger = ERROROUTZ0
          PortPullDownOption = false
          PortPullUpOption = false
        PortPin12:
          PortBiDirectionControl = false
          PortDriveStrengthControl = DRIVE_STRENGTH_TYPE_1_SUPP_PDSC_PUCC
          PortInputBufferControl = false
          PortInputSelection = INPUT_BUFFER_TYPE_SCH1
          PortIpControl = false
          PortOpenDrainControl = OUTPUT_BUFFER_TYPE_PUSHPULL_SUPP_PODC_PODCE
          PortOutputLevelInversion = false
          PortPinDioAltModeChangeable = false
          PortPinDirection = PORT_PIN_IN
          PortPinDirectionChangeable = false
          PortPinInitialMode = DIO_SUPP_PFC_PFCE_PFCAE_PFCEAE_PMCSR
          PortPinLevelValue = PORT_PIN_LEVEL_LOW
          PortPinModeChangeable = false
          PortPinSafeStateControl = false
          PortPinSafeStateTrigger = ERROROUTZ0
          PortPullDownOption = false
          PortPullUpOption = false
        PortPin13:
          PortBiDirectionControl = false
          PortDriveStrengthControl = DRIVE_STRENGTH_TYPE_1_SUPP_PDSC_PUCC
          PortInputBufferControl = false
          PortInputSelection = INPUT_BUFFER_TYPE_SCH1
          PortIpControl = false
          PortOpenDrainControl = OUTPUT_BUFFER_TYPE_PUSHPULL_SUPP_PODC_PODCE
          PortOutputLevelInversion = false
          PortPinDioAltModeChangeable = false
          PortPinDirection = PORT_PIN_IN
          PortPinDirectionChangeable = false
          PortPinInitialMode = DIO_SUPP_PFC_PFCE_PFCAE_PFCEAE_PMCSR
          PortPinLevelValue = PORT_PIN_LEVEL_LOW
          PortPinModeChangeable = false
          PortPinSafeStateControl = false
          PortPinSafeStateTrigger = ERROROUTZ0
          PortPullDownOption = false
          PortPullUpOption = false
        PortPin14:
          PortBiDirectionControl = false
          PortDriveStrengthControl = DRIVE_STRENGTH_TYPE_1_SUPP_PDSC_PUCC
          PortInputBufferControl = false
          PortInputSelection = INPUT_BUFFER_TYPE_SCH1
          PortIpControl = false
          PortOpenDrainControl = OUTPUT_BUFFER_TYPE_PUSHPULL_SUPP_PODC_PODCE
          PortOutputLevelInversion = false
          PortPinDioAltModeChangeable = false
          PortPinDirection = PORT_PIN_IN
          PortPinDirectionChangeable = false
          PortPinInitialMode = DIO_SUPP_PFC_PFCE_PFCAE_PFCEAE_PMCSR
          PortPinLevelValue = PORT_PIN_LEVEL_LOW
          PortPinModeChangeable = false
          PortPinSafeStateControl = false
          PortPinSafeStateTrigger = ERROROUTZ0
          PortPullDownOption = false
          PortPullUpOption = false
        PortPin2:
          PortBiDirectionControl = false
          PortDriveStrengthControl = DRIVE_STRENGTH_TYPE_1_SUPP_PDSC_PUCC
          PortInputBufferControl = false
          PortInputSelection = INPUT_BUFFER_TYPE_SCH1
          PortIpControl = false
          PortOpenDrainControl = OUTPUT_BUFFER_TYPE_PUSHPULL_SUPP_PODC_PODCE
          PortOutputLevelInversion = false
          PortPinDioAltModeChangeable = false
          PortPinDirection = PORT_PIN_IN
          PortPinDirectionChangeable = false
          PortPinInitialMode = DIO_SUPP_PFC_PFCE_PFCAE_PFCEAE_PMCSR
          PortPinLevelValue = PORT_PIN_LEVEL_LOW
          PortPinModeChangeable = false
          PortPinSafeStateControl = false
          PortPinSafeStateTrigger = ERROROUTZ0
          PortPullDownOption = false
          PortPullUpOption = false
        PortPin3:
          PortBiDirectionControl = false
          PortDriveStrengthControl = DRIVE_STRENGTH_TYPE_1_SUPP_PDSC_PUCC
          PortInputBufferControl = false
          PortInputSelection = INPUT_BUFFER_TYPE_SCH1
          PortIpControl = false
          PortOpenDrainControl = OUTPUT_BUFFER_TYPE_PUSHPULL_SUPP_PODC_PODCE
          PortOutputLevelInversion = false
          PortPinDioAltModeChangeable = false
          PortPinDirection = PORT_PIN_IN
          PortPinDirectionChangeable = false
          PortPinInitialMode = DIO_SUPP_PFC_PFCE_PFCAE_PFCEAE_PMCSR
          PortPinLevelValue = PORT_PIN_LEVEL_LOW
          PortPinModeChangeable = false
          PortPinSafeStateControl = false
          PortPinSafeStateTrigger = ERROROUTZ0
          PortPullDownOption = false
          PortPullUpOption = false
        PortPin4:
          PortBiDirectionControl = false
          PortDriveStrengthControl = DRIVE_STRENGTH_TYPE_1_SUPP_PDSC_PUCC
          PortInputBufferControl = false
          PortInputSelection = INPUT_BUFFER_TYPE_SCH1
          PortIpControl = false
          PortOpenDrainControl = OUTPUT_BUFFER_TYPE_PUSHPULL_SUPP_PODC_PODCE
          PortOutputLevelInversion = false
          PortPinDioAltModeChangeable = false
          PortPinDirection = PORT_PIN_IN
          PortPinDirectionChangeable = false
          PortPinInitialMode = DIO_SUPP_PFC_PFCE_PFCAE_PFCEAE_PMCSR
          PortPinLevelValue = PORT_PIN_LEVEL_LOW
          PortPinModeChangeable = false
          PortPinSafeStateControl = false
          PortPinSafeStateTrigger = ERROROUTZ0
          PortPullDownOption = false
          PortPullUpOption = false
        PortPin5:
          PortBiDirectionControl = false
          PortDriveStrengthControl = DRIVE_STRENGTH_TYPE_1_SUPP_PDSC_PUCC
          PortInputBufferControl = false
          PortInputSelection = INPUT_BUFFER_TYPE_SCH1
          PortIpControl = false
          PortOpenDrainControl = OUTPUT_BUFFER_TYPE_PUSHPULL_SUPP_PODC_PODCE
          PortOutputLevelInversion = false
          PortPinDioAltModeChangeable = false
          PortPinDirection = PORT_PIN_IN
          PortPinDirectionChangeable = false
          PortPinInitialMode = DIO_SUPP_PFC_PFCE_PFCAE_PFCEAE_PMCSR
          PortPinLevelValue = PORT_PIN_LEVEL_LOW
          PortPinModeChangeable = false
          PortPinSafeStateControl = false
          PortPinSafeStateTrigger = ERROROUTZ0
          PortPullDownOption = false
          PortPullUpOption = false
        PortPin6:
          PortBiDirectionControl = false
          PortDriveStrengthControl = DRIVE_STRENGTH_TYPE_1_SUPP_PDSC_PUCC
          PortInputBufferControl = false
          PortInputSelection = INPUT_BUFFER_TYPE_SCH1
          PortIpControl = false
          PortOpenDrainControl = OUTPUT_BUFFER_TYPE_PUSHPULL_SUPP_PODC_PODCE
          PortOutputLevelInversion = false
          PortPinDioAltModeChangeable = false
          PortPinDirection = PORT_PIN_IN
          PortPinDirectionChangeable = false
          PortPinInitialMode = DIO_SUPP_PFC_PFCE_PFCAE_PFCEAE_PMCSR
          PortPinLevelValue = PORT_PIN_LEVEL_LOW
          PortPinModeChangeable = false
          PortPinSafeStateControl = false
          PortPinSafeStateTrigger = ERROROUTZ0
          PortPullDownOption = false
          PortPullUpOption = false
        PortPin7:
          PortBiDirectionControl = false
          PortDriveStrengthControl = DRIVE_STRENGTH_TYPE_1_SUPP_PDSC_PUCC
          PortInputBufferControl = false
          PortInputSelection = INPUT_BUFFER_TYPE_SCH1
          PortIpControl = false
          PortOpenDrainControl = OUTPUT_BUFFER_TYPE_PUSHPULL_SUPP_PODC_PODCE
          PortOutputLevelInversion = false
          PortPinDioAltModeChangeable = false
          PortPinDirection = PORT_PIN_IN
          PortPinDirectionChangeable = false
          PortPinInitialMode = DIO_SUPP_PFC_PFCE_PFCAE_PFCEAE_PMCSR
          PortPinLevelValue = PORT_PIN_LEVEL_LOW
          PortPinModeChangeable = false
          PortPinSafeStateControl = false
          PortPinSafeStateTrigger = ERROROUTZ0
          PortPullDownOption = false
          PortPullUpOption = false
        PortPin8:
          PortBiDirectionControl = false
          PortDriveStrengthControl = DRIVE_STRENGTH_TYPE_1_SUPP_PDSC_PUCC
          PortInputBufferControl = false
          PortInputSelection = INPUT_BUFFER_TYPE_SCH1
          PortIpControl = false
          PortOpenDrainControl = OUTPUT_BUFFER_TYPE_PUSHPULL_SUPP_PODC_PODCE
          PortOutputLevelInversion = false
          PortPinDioAltModeChangeable = false
          PortPinDirection = PORT_PIN_IN
          PortPinDirectionChangeable = false
          PortPinInitialMode = DIO_SUPP_PFC_PFCE_PFCAE_PFCEAE_PMCSR
          PortPinLevelValue = PORT_PIN_LEVEL_LOW
          PortPinModeChangeable = false
          PortPinSafeStateControl = false
          PortPinSafeStateTrigger = ERROROUTZ0
          PortPullDownOption = false
          PortPullUpOption = false
        PortPin9:
          PortBiDirectionControl = false
          PortDriveStrengthControl = DRIVE_STRENGTH_TYPE_1_SUPP_PDSC_PUCC
          PortInputBufferControl = false
          PortInputSelection = INPUT_BUFFER_TYPE_SCH1
          PortIpControl = false
          PortOpenDrainControl = OUTPUT_BUFFER_TYPE_PUSHPULL_SUPP_PODC_PODCE
          PortOutputLevelInversion = false
          PortPinDioAltModeChangeable = false
          PortPinDirection = PORT_PIN_IN
          PortPinDirectionChangeable = false
          PortPinInitialMode = DIO_SUPP_PFC_PFCE_PFCAE_PFCEAE_PMCSR
          PortPinLevelValue = PORT_PIN_LEVEL_LOW
          PortPinModeChangeable = false
          PortPinSafeStateControl = false
          PortPinSafeStateTrigger = ERROROUTZ0
          PortPullDownOption = false
          PortPullUpOption = false
      PortGroup21
        PortPin0:
          PortBiDirectionControl = false
          PortDriveStrengthControl = DRIVE_STRENGTH_TYPE_1_SUPP_PDSC_PUCC
          PortInputBufferControl = false
          PortInputSelection = INPUT_BUFFER_TYPE_SCH1
          PortIpControl = false
          PortOpenDrainControl = OUTPUT_BUFFER_TYPE_PUSHPULL_SUPP_PODC_PODCE
          PortOutputLevelInversion = false
          PortPinDioAltModeChangeable = false
          PortPinDirection = PORT_PIN_IN
          PortPinDirectionChangeable = false
          PortPinInitialMode = DIO_SUPP_PFC_PFCE_PFCAE_PFCEAE_PMCSR
          PortPinLevelValue = PORT_PIN_LEVEL_LOW
          PortPinModeChangeable = false
          PortPinSafeStateControl = false
          PortPinSafeStateTrigger = ERROROUTZ0
          PortPullDownOption = false
          PortPullUpOption = false
        PortPin1:
          PortBiDirectionControl = false
          PortDriveStrengthControl = DRIVE_STRENGTH_TYPE_1_SUPP_PDSC_PUCC
          PortInputBufferControl = false
          PortInputSelection = INPUT_BUFFER_TYPE_SCH1
          PortIpControl = false
          PortOpenDrainControl = OUTPUT_BUFFER_TYPE_PUSHPULL_SUPP_PODC_PODCE
          PortOutputLevelInversion = false
          PortPinDioAltModeChangeable = false
          PortPinDirection = PORT_PIN_IN
          PortPinDirectionChangeable = false
          PortPinInitialMode = DIO_SUPP_PFC_PFCE_PFCAE_PFCEAE_PMCSR
          PortPinLevelValue = PORT_PIN_LEVEL_LOW
          PortPinModeChangeable = false
          PortPinSafeStateControl = false
          PortPinSafeStateTrigger = ERROROUTZ0
          PortPullDownOption = false
          PortPullUpOption = false
        PortPin2:
          PortBiDirectionControl = false
          PortDriveStrengthControl = DRIVE_STRENGTH_TYPE_1_SUPP_PDSC_PUCC
          PortInputBufferControl = false
          PortInputSelection = INPUT_BUFFER_TYPE_SCH1
          PortIpControl = false
          PortOpenDrainControl = OUTPUT_BUFFER_TYPE_PUSHPULL_SUPP_PODC_PODCE
          PortOutputLevelInversion = false
          PortPinDioAltModeChangeable = false
          PortPinDirection = PORT_PIN_IN
          PortPinDirectionChangeable = false
          PortPinInitialMode = DIO_SUPP_PFC_PFCE_PFCAE_PFCEAE_PMCSR
          PortPinLevelValue = PORT_PIN_LEVEL_LOW
          PortPinModeChangeable = false
          PortPinSafeStateControl = false
          PortPinSafeStateTrigger = ERROROUTZ0
          PortPullDownOption = false
          PortPullUpOption = false
        PortPin3:
          PortBiDirectionControl = false
          PortDriveStrengthControl = DRIVE_STRENGTH_TYPE_1_SUPP_PDSC_PUCC
          PortInputBufferControl = false
          PortInputSelection = INPUT_BUFFER_TYPE_SCH1
          PortIpControl = false
          PortOpenDrainControl = OUTPUT_BUFFER_TYPE_PUSHPULL_SUPP_PODC_PODCE
          PortOutputLevelInversion = false
          PortPinDioAltModeChangeable = false
          PortPinDirection = PORT_PIN_IN
          PortPinDirectionChangeable = false
          PortPinInitialMode = DIO_SUPP_PFC_PFCE_PFCAE_PFCEAE_PMCSR
          PortPinLevelValue = PORT_PIN_LEVEL_LOW
          PortPinModeChangeable = false
          PortPinSafeStateControl = false
          PortPinSafeStateTrigger = ERROROUTZ0
          PortPullDownOption = false
          PortPullUpOption = false
        PortPin4:
          PortBiDirectionControl = false
          PortDriveStrengthControl = DRIVE_STRENGTH_TYPE_1_SUPP_PDSC_PUCC
          PortInputBufferControl = false
          PortInputSelection = INPUT_BUFFER_TYPE_SCH1
          PortIpControl = false
          PortOpenDrainControl = OUTPUT_BUFFER_TYPE_PUSHPULL_SUPP_PODC_PODCE
          PortOutputLevelInversion = false
          PortPinDioAltModeChangeable = false
          PortPinDirection = PORT_PIN_IN
          PortPinDirectionChangeable = false
          PortPinInitialMode = DIO_SUPP_PFC_PFCE_PFCAE_PFCEAE_PMCSR
          PortPinLevelValue = PORT_PIN_LEVEL_LOW
          PortPinModeChangeable = false
          PortPinSafeStateControl = false
          PortPinSafeStateTrigger = ERROROUTZ0
          PortPullDownOption = false
          PortPullUpOption = false
        PortPin5:
          PortBiDirectionControl = false
          PortDriveStrengthControl = DRIVE_STRENGTH_TYPE_1_SUPP_PDSC_PUCC
          PortInputBufferControl = false
          PortInputSelection = INPUT_BUFFER_TYPE_SCH1
          PortIpControl = false
          PortOpenDrainControl = OUTPUT_BUFFER_TYPE_PUSHPULL_SUPP_PODC_PODCE
          PortOutputLevelInversion = false
          PortPinDioAltModeChangeable = false
          PortPinDirection = PORT_PIN_IN
          PortPinDirectionChangeable = false
          PortPinInitialMode = DIO_SUPP_PFC_PFCE_PFCAE_PFCEAE_PMCSR
          PortPinLevelValue = PORT_PIN_LEVEL_LOW
          PortPinModeChangeable = false
          PortPinSafeStateControl = false
          PortPinSafeStateTrigger = ERROROUTZ0
          PortPullDownOption = false
          PortPullUpOption = false
        PortPin6:
          PortBiDirectionControl = false
          PortDriveStrengthControl = DRIVE_STRENGTH_TYPE_1_SUPP_PDSC_PUCC
          PortInputBufferControl = false
          PortInputSelection = INPUT_BUFFER_TYPE_SCH1
          PortIpControl = false
          PortOpenDrainControl = OUTPUT_BUFFER_TYPE_PUSHPULL_SUPP_PODC_PODCE
          PortOutputLevelInversion = false
          PortPinDioAltModeChangeable = false
          PortPinDirection = PORT_PIN_IN
          PortPinDirectionChangeable = false
          PortPinInitialMode = DIO_SUPP_PFC_PFCE_PFCAE_PFCEAE_PMCSR
          PortPinLevelValue = PORT_PIN_LEVEL_LOW
          PortPinModeChangeable = false
          PortPinSafeStateControl = false
          PortPinSafeStateTrigger = ERROROUTZ0
          PortPullDownOption = false
          PortPullUpOption = false
        PortPin7:
          PortBiDirectionControl = false
          PortDriveStrengthControl = DRIVE_STRENGTH_TYPE_1_SUPP_PDSC_PUCC
          PortInputBufferControl = false
          PortInputSelection = INPUT_BUFFER_TYPE_SCH1
          PortIpControl = false
          PortOpenDrainControl = OUTPUT_BUFFER_TYPE_PUSHPULL_SUPP_PODC_PODCE
          PortOutputLevelInversion = false
          PortPinDioAltModeChangeable = false
          PortPinDirection = PORT_PIN_IN
          PortPinDirectionChangeable = false
          PortPinInitialMode = DIO_SUPP_PFC_PFCE_PFCAE_PFCEAE_PMCSR
          PortPinLevelValue = PORT_PIN_LEVEL_LOW
          PortPinModeChangeable = false
          PortPinSafeStateControl = false
          PortPinSafeStateTrigger = ERROROUTZ0
          PortPullDownOption = false
          PortPullUpOption = false
      PortGroup22
        PortPin0:
          PortBiDirectionControl = false
          PortDriveStrengthControl = DRIVE_STRENGTH_TYPE_1_SUPP_PDSC_PUCC
          PortInputBufferControl = false
          PortInputSelection = INPUT_BUFFER_TYPE_SCH1
          PortIpControl = false
          PortOpenDrainControl = OUTPUT_BUFFER_TYPE_PUSHPULL_SUPP_PODC_PODCE
          PortOutputLevelInversion = false
          PortPinDioAltModeChangeable = false
          PortPinDirection = PORT_PIN_IN
          PortPinDirectionChangeable = false
          PortPinInitialMode = DIO_SUPP_PFC_PFCE_PFCAE_PFCEAE_PMCSR
          PortPinLevelValue = PORT_PIN_LEVEL_LOW
          PortPinModeChangeable = false
          PortPinSafeStateControl = false
          PortPinSafeStateTrigger = ERROROUTZ0
          PortPullDownOption = false
          PortPullUpOption = false
        PortPin1:
          PortBiDirectionControl = false
          PortDriveStrengthControl = DRIVE_STRENGTH_TYPE_1_SUPP_PDSC_PUCC
          PortInputBufferControl = false
          PortInputSelection = INPUT_BUFFER_TYPE_SCH1
          PortIpControl = false
          PortOpenDrainControl = OUTPUT_BUFFER_TYPE_PUSHPULL_SUPP_PODC_PODCE
          PortOutputLevelInversion = false
          PortPinDioAltModeChangeable = false
          PortPinDirection = PORT_PIN_IN
          PortPinDirectionChangeable = false
          PortPinInitialMode = DIO_SUPP_PFC_PFCE_PFCAE_PFCEAE_PMCSR
          PortPinLevelValue = PORT_PIN_LEVEL_LOW
          PortPinModeChangeable = false
          PortPinSafeStateControl = false
          PortPinSafeStateTrigger = ERROROUTZ0
          PortPullDownOption = false
          PortPullUpOption = false
        PortPin2:
          PortBiDirectionControl = false
          PortDriveStrengthControl = DRIVE_STRENGTH_TYPE_1_SUPP_PDSC_PUCC
          PortInputBufferControl = false
          PortInputSelection = INPUT_BUFFER_TYPE_SCH1
          PortIpControl = false
          PortOpenDrainControl = OUTPUT_BUFFER_TYPE_PUSHPULL_SUPP_PODC_PODCE
          PortOutputLevelInversion = false
          PortPinDioAltModeChangeable = false
          PortPinDirection = PORT_PIN_IN
          PortPinDirectionChangeable = false
          PortPinInitialMode = DIO_SUPP_PFC_PFCE_PFCAE_PFCEAE_PMCSR
          PortPinLevelValue = PORT_PIN_LEVEL_LOW
          PortPinModeChangeable = false
          PortPinSafeStateControl = false
          PortPinSafeStateTrigger = ERROROUTZ0
          PortPullDownOption = false
          PortPullUpOption = false
        PortPin3:
          PortBiDirectionControl = false
          PortDriveStrengthControl = DRIVE_STRENGTH_TYPE_1_SUPP_PDSC_PUCC
          PortInputBufferControl = false
          PortInputSelection = INPUT_BUFFER_TYPE_SCH1
          PortIpControl = false
          PortOpenDrainControl = OUTPUT_BUFFER_TYPE_PUSHPULL_SUPP_PODC_PODCE
          PortOutputLevelInversion = false
          PortPinDioAltModeChangeable = false
          PortPinDirection = PORT_PIN_IN
          PortPinDirectionChangeable = false
          PortPinInitialMode = DIO_SUPP_PFC_PFCE_PFCAE_PFCEAE_PMCSR
          PortPinLevelValue = PORT_PIN_LEVEL_LOW
          PortPinModeChangeable = false
          PortPinSafeStateControl = false
          PortPinSafeStateTrigger = ERROROUTZ0
          PortPullDownOption = false
          PortPullUpOption = false
        PortPin4:
          PortBiDirectionControl = false
          PortDriveStrengthControl = DRIVE_STRENGTH_TYPE_1_SUPP_PDSC_PUCC
          PortInputBufferControl = false
          PortInputSelection = INPUT_BUFFER_TYPE_SCH1
          PortIpControl = false
          PortOpenDrainControl = OUTPUT_BUFFER_TYPE_PUSHPULL_SUPP_PODC_PODCE
          PortOutputLevelInversion = false
          PortPinDioAltModeChangeable = false
          PortPinDirection = PORT_PIN_IN
          PortPinDirectionChangeable = false
          PortPinInitialMode = DIO_SUPP_PFC_PFCE_PFCAE_PFCEAE_PMCSR
          PortPinLevelValue = PORT_PIN_LEVEL_LOW
          PortPinModeChangeable = false
          PortPinSafeStateControl = false
          PortPinSafeStateTrigger = ERROROUTZ0
          PortPullDownOption = false
          PortPullUpOption = false
      PortGroup24
        PortPin10:
          PortBiDirectionControl = false
          PortDriveStrengthControl = DRIVE_STRENGTH_TYPE_1_SUPP_PDSC_PUCC
          PortInputBufferControl = false
          PortInputSelection = INPUT_BUFFER_TYPE_SCH1
          PortIpControl = false
          PortOpenDrainControl = OUTPUT_BUFFER_TYPE_PUSHPULL_SUPP_PODC_PODCE
          PortOutputLevelInversion = false
          PortPinDioAltModeChangeable = false
          PortPinDirection = PORT_PIN_IN
          PortPinDirectionChangeable = false
          PortPinInitialMode = DIO_SUPP_PFC_PFCE_PFCAE_PFCEAE_PMCSR
          PortPinLevelValue = PORT_PIN_LEVEL_LOW
          PortPinModeChangeable = false
          PortPinSafeStateControl = false
          PortPinSafeStateTrigger = ERROROUTZ0
          PortPullDownOption = false
          PortPullUpOption = false
        PortPin11:
          PortBiDirectionControl = false
          PortDriveStrengthControl = DRIVE_STRENGTH_TYPE_1_SUPP_PDSC_PUCC
          PortInputBufferControl = false
          PortInputSelection = INPUT_BUFFER_TYPE_SCH1
          PortIpControl = false
          PortOpenDrainControl = OUTPUT_BUFFER_TYPE_PUSHPULL_SUPP_PODC_PODCE
          PortOutputLevelInversion = false
          PortPinDioAltModeChangeable = false
          PortPinDirection = PORT_PIN_IN
          PortPinDirectionChangeable = false
          PortPinInitialMode = DIO_SUPP_PFC_PFCE_PFCAE_PFCEAE_PMCSR
          PortPinLevelValue = PORT_PIN_LEVEL_LOW
          PortPinModeChangeable = false
          PortPinSafeStateControl = false
          PortPinSafeStateTrigger = ERROROUTZ0
          PortPullDownOption = false
          PortPullUpOption = false
        PortPin12:
          PortBiDirectionControl = false
          PortDriveStrengthControl = DRIVE_STRENGTH_TYPE_1_SUPP_PDSC_PUCC
          PortInputBufferControl = false
          PortInputSelection = INPUT_BUFFER_TYPE_SCH1
          PortIpControl = false
          PortOpenDrainControl = OUTPUT_BUFFER_TYPE_PUSHPULL_SUPP_PODC_PODCE
          PortOutputLevelInversion = false
          PortPinDioAltModeChangeable = false
          PortPinDirection = PORT_PIN_IN
          PortPinDirectionChangeable = false
          PortPinInitialMode = DIO_SUPP_PFC_PFCE_PFCAE_PFCEAE_PMCSR
          PortPinLevelValue = PORT_PIN_LEVEL_LOW
          PortPinModeChangeable = false
          PortPinSafeStateControl = false
          PortPinSafeStateTrigger = ERROROUTZ0
          PortPullDownOption = false
          PortPullUpOption = false
        PortPin13:
          PortBiDirectionControl = false
          PortDriveStrengthControl = DRIVE_STRENGTH_TYPE_1_SUPP_PDSC_PUCC
          PortInputBufferControl = false
          PortInputSelection = INPUT_BUFFER_TYPE_SCH1
          PortIpControl = false
          PortOpenDrainControl = OUTPUT_BUFFER_TYPE_PUSHPULL_SUPP_PODC_PODCE
          PortOutputLevelInversion = false
          PortPinDioAltModeChangeable = false
          PortPinDirection = PORT_PIN_IN
          PortPinDirectionChangeable = false
          PortPinInitialMode = DIO_SUPP_PFC_PFCE_PFCAE_PFCEAE_PMCSR
          PortPinLevelValue = PORT_PIN_LEVEL_LOW
          PortPinModeChangeable = false
          PortPinSafeStateControl = false
          PortPinSafeStateTrigger = ERROROUTZ0
          PortPullDownOption = false
          PortPullUpOption = false
        PortPin4:
          PortBiDirectionControl = false
          PortDriveStrengthControl = DRIVE_STRENGTH_TYPE_1_SUPP_PDSC_PUCC
          PortInputBufferControl = false
          PortInputSelection = INPUT_BUFFER_TYPE_SCH1
          PortIpControl = false
          PortOpenDrainControl = OUTPUT_BUFFER_TYPE_PUSHPULL_SUPP_PODC_PODCE
          PortOutputLevelInversion = false
          PortPinDioAltModeChangeable = false
          PortPinDirection = PORT_PIN_IN
          PortPinDirectionChangeable = false
          PortPinInitialMode = DIO_SUPP_PFC_PFCE_PFCAE_PFCEAE_PMCSR
          PortPinLevelValue = PORT_PIN_LEVEL_LOW
          PortPinModeChangeable = false
          PortPinSafeStateControl = false
          PortPinSafeStateTrigger = ERROROUTZ0
          PortPullDownOption = false
          PortPullUpOption = false
        PortPin5:
          PortBiDirectionControl = false
          PortDriveStrengthControl = DRIVE_STRENGTH_TYPE_1_SUPP_PDSC_PUCC
          PortInputBufferControl = false
          PortInputSelection = INPUT_BUFFER_TYPE_SCH1
          PortIpControl = false
          PortOpenDrainControl = OUTPUT_BUFFER_TYPE_PUSHPULL_SUPP_PODC_PODCE
          PortOutputLevelInversion = false
          PortPinDioAltModeChangeable = false
          PortPinDirection = PORT_PIN_IN
          PortPinDirectionChangeable = false
          PortPinInitialMode = DIO_SUPP_PFC_PFCE_PFCAE_PFCEAE_PMCSR
          PortPinLevelValue = PORT_PIN_LEVEL_LOW
          PortPinModeChangeable = false
          PortPinSafeStateControl = false
          PortPinSafeStateTrigger = ERROROUTZ0
          PortPullDownOption = false
          PortPullUpOption = false
        PortPin6:
          PortBiDirectionControl = false
          PortDriveStrengthControl = DRIVE_STRENGTH_TYPE_1_SUPP_PDSC_PUCC
          PortInputBufferControl = false
          PortInputSelection = INPUT_BUFFER_TYPE_SCH1
          PortIpControl = false
          PortOpenDrainControl = OUTPUT_BUFFER_TYPE_PUSHPULL_SUPP_PODC_PODCE
          PortOutputLevelInversion = false
          PortPinDioAltModeChangeable = false
          PortPinDirection = PORT_PIN_IN
          PortPinDirectionChangeable = false
          PortPinInitialMode = DIO_SUPP_PFC_PFCE_PFCAE_PFCEAE_PMCSR
          PortPinLevelValue = PORT_PIN_LEVEL_LOW
          PortPinModeChangeable = false
          PortPinSafeStateControl = false
          PortPinSafeStateTrigger = ERROROUTZ0
          PortPullDownOption = false
          PortPullUpOption = false
        PortPin7:
          PortBiDirectionControl = false
          PortDriveStrengthControl = DRIVE_STRENGTH_TYPE_1_SUPP_PDSC_PUCC
          PortInputBufferControl = false
          PortInputSelection = INPUT_BUFFER_TYPE_SCH1
          PortIpControl = false
          PortOpenDrainControl = OUTPUT_BUFFER_TYPE_PUSHPULL_SUPP_PODC_PODCE
          PortOutputLevelInversion = false
          PortPinDioAltModeChangeable = false
          PortPinDirection = PORT_PIN_IN
          PortPinDirectionChangeable = false
          PortPinInitialMode = DIO_SUPP_PFC_PFCE_PFCAE_PFCEAE_PMCSR
          PortPinLevelValue = PORT_PIN_LEVEL_LOW
          PortPinModeChangeable = false
          PortPinSafeStateControl = false
          PortPinSafeStateTrigger = ERROROUTZ0
          PortPullDownOption = false
          PortPullUpOption = false
        PortPin8:
          PortBiDirectionControl = false
          PortDriveStrengthControl = DRIVE_STRENGTH_TYPE_1_SUPP_PDSC_PUCC
          PortInputBufferControl = false
          PortInputSelection = INPUT_BUFFER_TYPE_SCH1
          PortIpControl = false
          PortOpenDrainControl = OUTPUT_BUFFER_TYPE_PUSHPULL_SUPP_PODC_PODCE
          PortOutputLevelInversion = false
          PortPinDioAltModeChangeable = false
          PortPinDirection = PORT_PIN_IN
          PortPinDirectionChangeable = false
          PortPinInitialMode = DIO_SUPP_PFC_PFCE_PFCAE_PFCEAE_PMCSR
          PortPinLevelValue = PORT_PIN_LEVEL_LOW
          PortPinModeChangeable = false
          PortPinSafeStateControl = false
          PortPinSafeStateTrigger = ERROROUTZ0
          PortPullDownOption = false
          PortPullUpOption = false
        PortPin9:
          PortBiDirectionControl = false
          PortDriveStrengthControl = DRIVE_STRENGTH_TYPE_1_SUPP_PDSC_PUCC
          PortInputBufferControl = false
          PortInputSelection = INPUT_BUFFER_TYPE_SCH1
          PortIpControl = false
          PortOpenDrainControl = OUTPUT_BUFFER_TYPE_PUSHPULL_SUPP_PODC_PODCE
          PortOutputLevelInversion = false
          PortPinDioAltModeChangeable = false
          PortPinDirection = PORT_PIN_IN
          PortPinDirectionChangeable = false
          PortPinInitialMode = DIO_SUPP_PFC_PFCE_PFCAE_PFCEAE_PMCSR
          PortPinLevelValue = PORT_PIN_LEVEL_LOW
          PortPinModeChangeable = false
          PortPinSafeStateControl = false
          PortPinSafeStateTrigger = ERROROUTZ0
          PortPullDownOption = false
          PortPullUpOption = false
      PortGroupAnalog0
        PortPin0:
          PortBiDirectionControl = true
          PortDriveStrengthControl = DRIVE_STRENGTH_TYPE_1_SUPP_PDSC
          PortInputBufferControl = false
          PortOpenDrainControl = OUTPUT_BUFFER_TYPE_PUSHPULL_SUPP_PODC_PODCE
          PortOutputLevelInversion = false
          PortPinDirection = PORT_PIN_IN
          PortPinDirectionChangeable = false
          PortPinInitialMode = DIO_ALT_NOT_SUPPORTED
          PortPinLevelValue = PORT_PIN_LEVEL_LOW
          PortPinSafeStateControl = false
          PortPinSafeStateTrigger = ERROROUTZ0
        PortPin1:
          PortBiDirectionControl = false
          PortDriveStrengthControl = DRIVE_STRENGTH_TYPE_1_SUPP_PDSC
          PortInputBufferControl = false
          PortOpenDrainControl = OUTPUT_BUFFER_TYPE_PUSHPULL_SUPP_PODC_PODCE
          PortOutputLevelInversion = false
          PortPinDirection = PORT_PIN_IN
          PortPinDirectionChangeable = false
          PortPinInitialMode = DIO_ALT_NOT_SUPPORTED
          PortPinLevelValue = PORT_PIN_LEVEL_LOW
          PortPinSafeStateControl = false
          PortPinSafeStateTrigger = ERROROUTZ0
        PortPin10:
          PortBiDirectionControl = false
          PortDriveStrengthControl = DRIVE_STRENGTH_TYPE_1_SUPP_PDSC
          PortInputBufferControl = false
          PortOpenDrainControl = OUTPUT_BUFFER_TYPE_PUSHPULL_SUPP_PODC_PODCE
          PortOutputLevelInversion = false
          PortPinDirection = PORT_PIN_IN
          PortPinDirectionChangeable = false
          PortPinInitialMode = DIO_ALT_NOT_SUPPORTED
          PortPinLevelValue = PORT_PIN_LEVEL_LOW
          PortPinSafeStateControl = false
          PortPinSafeStateTrigger = ERROROUTZ0
        PortPin11:
          PortBiDirectionControl = false
          PortDriveStrengthControl = DRIVE_STRENGTH_TYPE_1_SUPP_PDSC
          PortInputBufferControl = false
          PortOpenDrainControl = OUTPUT_BUFFER_TYPE_PUSHPULL_SUPP_PODC_PODCE
          PortOutputLevelInversion = false
          PortPinDirection = PORT_PIN_IN
          PortPinDirectionChangeable = false
          PortPinInitialMode = DIO_ALT_NOT_SUPPORTED
          PortPinLevelValue = PORT_PIN_LEVEL_LOW
          PortPinSafeStateControl = false
          PortPinSafeStateTrigger = ERROROUTZ0
        PortPin12:
          PortBiDirectionControl = false
          PortDriveStrengthControl = DRIVE_STRENGTH_TYPE_1_SUPP_PDSC
          PortInputBufferControl = false
          PortOpenDrainControl = OUTPUT_BUFFER_TYPE_PUSHPULL_SUPP_PODC_PODCE
          PortOutputLevelInversion = false
          PortPinDirection = PORT_PIN_IN
          PortPinDirectionChangeable = false
          PortPinInitialMode = DIO_ALT_NOT_SUPPORTED
          PortPinLevelValue = PORT_PIN_LEVEL_LOW
          PortPinSafeStateControl = false
          PortPinSafeStateTrigger = ERROROUTZ0
        PortPin13:
          PortBiDirectionControl = false
          PortDriveStrengthControl = DRIVE_STRENGTH_TYPE_1_SUPP_PDSC
          PortInputBufferControl = false
          PortOpenDrainControl = OUTPUT_BUFFER_TYPE_PUSHPULL_SUPP_PODC_PODCE
          PortOutputLevelInversion = false
          PortPinDirection = PORT_PIN_IN
          PortPinDirectionChangeable = false
          PortPinInitialMode = DIO_ALT_NOT_SUPPORTED
          PortPinLevelValue = PORT_PIN_LEVEL_LOW
          PortPinSafeStateControl = false
          PortPinSafeStateTrigger = ERROROUTZ0
        PortPin14:
          PortBiDirectionControl = false
          PortDriveStrengthControl = DRIVE_STRENGTH_TYPE_1_SUPP_PDSC
          PortInputBufferControl = false
          PortOpenDrainControl = OUTPUT_BUFFER_TYPE_PUSHPULL_SUPP_PODC_PODCE
          PortOutputLevelInversion = false
          PortPinDirection = PORT_PIN_IN
          PortPinDirectionChangeable = false
          PortPinInitialMode = DIO_ALT_NOT_SUPPORTED
          PortPinLevelValue = PORT_PIN_LEVEL_LOW
          PortPinSafeStateControl = false
          PortPinSafeStateTrigger = ERROROUTZ0
        PortPin15:
          PortBiDirectionControl = false
          PortDriveStrengthControl = DRIVE_STRENGTH_TYPE_1_SUPP_PDSC
          PortInputBufferControl = false
          PortOpenDrainControl = OUTPUT_BUFFER_TYPE_PUSHPULL_SUPP_PODC_PODCE
          PortOutputLevelInversion = false
          PortPinDirection = PORT_PIN_IN
          PortPinDirectionChangeable = false
          PortPinInitialMode = DIO_ALT_NOT_SUPPORTED
          PortPinLevelValue = PORT_PIN_LEVEL_LOW
          PortPinSafeStateControl = false
          PortPinSafeStateTrigger = ERROROUTZ0
        PortPin2:
          PortBiDirectionControl = false
          PortDriveStrengthControl = DRIVE_STRENGTH_TYPE_1_SUPP_PDSC
          PortInputBufferControl = false
          PortOpenDrainControl = OUTPUT_BUFFER_TYPE_PUSHPULL_SUPP_PODC_PODCE
          PortOutputLevelInversion = false
          PortPinDirection = PORT_PIN_IN
          PortPinDirectionChangeable = false
          PortPinInitialMode = DIO_ALT_NOT_SUPPORTED
          PortPinLevelValue = PORT_PIN_LEVEL_LOW
          PortPinSafeStateControl = false
          PortPinSafeStateTrigger = ERROROUTZ0
        PortPin3:
          PortBiDirectionControl = false
          PortDriveStrengthControl = DRIVE_STRENGTH_TYPE_1_SUPP_PDSC
          PortInputBufferControl = false
          PortOpenDrainControl = OUTPUT_BUFFER_TYPE_PUSHPULL_SUPP_PODC_PODCE
          PortOutputLevelInversion = false
          PortPinDirection = PORT_PIN_IN
          PortPinDirectionChangeable = false
          PortPinInitialMode = DIO_ALT_NOT_SUPPORTED
          PortPinLevelValue = PORT_PIN_LEVEL_LOW
          PortPinSafeStateControl = false
          PortPinSafeStateTrigger = ERROROUTZ0
        PortPin4:
          PortBiDirectionControl = false
          PortDriveStrengthControl = DRIVE_STRENGTH_TYPE_1_SUPP_PDSC
          PortInputBufferControl = false
          PortOpenDrainControl = OUTPUT_BUFFER_TYPE_PUSHPULL_SUPP_PODC_PODCE
          PortOutputLevelInversion = false
          PortPinDirection = PORT_PIN_IN
          PortPinDirectionChangeable = false
          PortPinInitialMode = DIO_ALT_NOT_SUPPORTED
          PortPinLevelValue = PORT_PIN_LEVEL_LOW
          PortPinSafeStateControl = false
          PortPinSafeStateTrigger = ERROROUTZ0
        PortPin5:
          PortBiDirectionControl = false
          PortDriveStrengthControl = DRIVE_STRENGTH_TYPE_1_SUPP_PDSC
          PortInputBufferControl = false
          PortOpenDrainControl = OUTPUT_BUFFER_TYPE_PUSHPULL_SUPP_PODC_PODCE
          PortOutputLevelInversion = false
          PortPinDirection = PORT_PIN_IN
          PortPinDirectionChangeable = false
          PortPinInitialMode = DIO_ALT_NOT_SUPPORTED
          PortPinLevelValue = PORT_PIN_LEVEL_LOW
          PortPinSafeStateControl = false
          PortPinSafeStateTrigger = ERROROUTZ0
        PortPin6:
          PortBiDirectionControl = false
          PortDriveStrengthControl = DRIVE_STRENGTH_TYPE_1_SUPP_PDSC
          PortInputBufferControl = false
          PortOpenDrainControl = OUTPUT_BUFFER_TYPE_PUSHPULL_SUPP_PODC_PODCE
          PortOutputLevelInversion = false
          PortPinDirection = PORT_PIN_IN
          PortPinDirectionChangeable = false
          PortPinInitialMode = DIO_ALT_NOT_SUPPORTED
          PortPinLevelValue = PORT_PIN_LEVEL_LOW
          PortPinSafeStateControl = false
          PortPinSafeStateTrigger = ERROROUTZ0
        PortPin7:
          PortBiDirectionControl = false
          PortDriveStrengthControl = DRIVE_STRENGTH_TYPE_1_SUPP_PDSC
          PortInputBufferControl = false
          PortOpenDrainControl = OUTPUT_BUFFER_TYPE_PUSHPULL_SUPP_PODC_PODCE
          PortOutputLevelInversion = false
          PortPinDirection = PORT_PIN_IN
          PortPinDirectionChangeable = false
          PortPinInitialMode = DIO_ALT_NOT_SUPPORTED
          PortPinLevelValue = PORT_PIN_LEVEL_LOW
          PortPinSafeStateControl = false
          PortPinSafeStateTrigger = ERROROUTZ0
        PortPin8:
          PortBiDirectionControl = false
          PortDriveStrengthControl = DRIVE_STRENGTH_TYPE_1_SUPP_PDSC
          PortInputBufferControl = false
          PortOpenDrainControl = OUTPUT_BUFFER_TYPE_PUSHPULL_SUPP_PODC_PODCE
          PortOutputLevelInversion = false
          PortPinDirection = PORT_PIN_IN
          PortPinDirectionChangeable = false
          PortPinInitialMode = DIO_ALT_NOT_SUPPORTED
          PortPinLevelValue = PORT_PIN_LEVEL_LOW
          PortPinSafeStateControl = false
          PortPinSafeStateTrigger = ERROROUTZ0
        PortPin9:
          PortBiDirectionControl = false
          PortDriveStrengthControl = DRIVE_STRENGTH_TYPE_1_SUPP_PDSC
          PortInputBufferControl = false
          PortOpenDrainControl = OUTPUT_BUFFER_TYPE_PUSHPULL_SUPP_PODC_PODCE
          PortOutputLevelInversion = false
          PortPinDirection = PORT_PIN_IN
          PortPinDirectionChangeable = false
          PortPinInitialMode = DIO_ALT_NOT_SUPPORTED
          PortPinLevelValue = PORT_PIN_LEVEL_LOW
          PortPinSafeStateControl = false
          PortPinSafeStateTrigger = ERROROUTZ0
      PortGroupAnalog1
        PortPin0:
          PortBiDirectionControl = false
          PortDriveStrengthControl = DRIVE_STRENGTH_TYPE_1_SUPP_PDSC
          PortInputBufferControl = false
          PortOpenDrainControl = OUTPUT_BUFFER_TYPE_PUSHPULL_SUPP_PODC_PODCE
          PortOutputLevelInversion = false
          PortPinDirection = PORT_PIN_IN
          PortPinDirectionChangeable = false
          PortPinInitialMode = DIO_ALT_NOT_SUPPORTED
          PortPinLevelValue = PORT_PIN_LEVEL_LOW
          PortPinSafeStateControl = false
          PortPinSafeStateTrigger = ERROROUTZ0
        PortPin1:
          PortBiDirectionControl = false
          PortDriveStrengthControl = DRIVE_STRENGTH_TYPE_1_SUPP_PDSC
          PortInputBufferControl = false
          PortOpenDrainControl = OUTPUT_BUFFER_TYPE_PUSHPULL_SUPP_PODC_PODCE
          PortOutputLevelInversion = false
          PortPinDirection = PORT_PIN_IN
          PortPinDirectionChangeable = false
          PortPinInitialMode = DIO_ALT_NOT_SUPPORTED
          PortPinLevelValue = PORT_PIN_LEVEL_LOW
          PortPinSafeStateControl = false
          PortPinSafeStateTrigger = ERROROUTZ0
        PortPin2:
          PortBiDirectionControl = false
          PortDriveStrengthControl = DRIVE_STRENGTH_TYPE_1_SUPP_PDSC
          PortInputBufferControl = false
          PortOpenDrainControl = OUTPUT_BUFFER_TYPE_PUSHPULL_SUPP_PODC_PODCE
          PortOutputLevelInversion = false
          PortPinDirection = PORT_PIN_IN
          PortPinDirectionChangeable = false
          PortPinInitialMode = DIO_ALT_NOT_SUPPORTED
          PortPinLevelValue = PORT_PIN_LEVEL_LOW
          PortPinSafeStateControl = false
          PortPinSafeStateTrigger = ERROROUTZ0
        PortPin3:
          PortBiDirectionControl = false
          PortDriveStrengthControl = DRIVE_STRENGTH_TYPE_1_SUPP_PDSC
          PortInputBufferControl = false
          PortOpenDrainControl = OUTPUT_BUFFER_TYPE_PUSHPULL_SUPP_PODC_PODCE
          PortOutputLevelInversion = false
          PortPinDirection = PORT_PIN_IN
          PortPinDirectionChangeable = false
          PortPinInitialMode = DIO_ALT_NOT_SUPPORTED
          PortPinLevelValue = PORT_PIN_LEVEL_LOW
          PortPinSafeStateControl = false
          PortPinSafeStateTrigger = ERROROUTZ0
      PortGroupAnalog2
        PortPin0:
          PortBiDirectionControl = false
          PortDriveStrengthControl = DRIVE_STRENGTH_TYPE_1_SUPP_PDSC
          PortInputBufferControl = false
          PortOpenDrainControl = OUTPUT_BUFFER_TYPE_PUSHPULL_SUPP_PODC_PODCE
          PortOutputLevelInversion = false
          PortPinDirection = PORT_PIN_IN
          PortPinDirectionChangeable = false
          PortPinInitialMode = DIO_ALT_NOT_SUPPORTED
          PortPinLevelValue = PORT_PIN_LEVEL_LOW
          PortPinSafeStateControl = false
          PortPinSafeStateTrigger = ERROROUTZ0
        PortPin1:
          PortBiDirectionControl = false
          PortDriveStrengthControl = DRIVE_STRENGTH_TYPE_1_SUPP_PDSC
          PortInputBufferControl = false
          PortOpenDrainControl = OUTPUT_BUFFER_TYPE_PUSHPULL_SUPP_PODC_PODCE
          PortOutputLevelInversion = false
          PortPinDirection = PORT_PIN_IN
          PortPinDirectionChangeable = false
          PortPinInitialMode = DIO_ALT_NOT_SUPPORTED
          PortPinLevelValue = PORT_PIN_LEVEL_LOW
          PortPinSafeStateControl = false
          PortPinSafeStateTrigger = ERROROUTZ0
        PortPin10:
          PortBiDirectionControl = false
          PortDriveStrengthControl = DRIVE_STRENGTH_TYPE_1_SUPP_PDSC
          PortInputBufferControl = false
          PortOpenDrainControl = OUTPUT_BUFFER_TYPE_PUSHPULL_SUPP_PODC_PODCE
          PortOutputLevelInversion = false
          PortPinDirection = PORT_PIN_IN
          PortPinDirectionChangeable = false
          PortPinInitialMode = DIO_ALT_NOT_SUPPORTED
          PortPinLevelValue = PORT_PIN_LEVEL_LOW
          PortPinSafeStateControl = false
          PortPinSafeStateTrigger = ERROROUTZ0
        PortPin11:
          PortBiDirectionControl = false
          PortDriveStrengthControl = DRIVE_STRENGTH_TYPE_1_SUPP_PDSC
          PortInputBufferControl = false
          PortOpenDrainControl = OUTPUT_BUFFER_TYPE_PUSHPULL_SUPP_PODC_PODCE
          PortOutputLevelInversion = false
          PortPinDirection = PORT_PIN_IN
          PortPinDirectionChangeable = false
          PortPinInitialMode = DIO_ALT_NOT_SUPPORTED
          PortPinLevelValue = PORT_PIN_LEVEL_LOW
          PortPinSafeStateControl = false
          PortPinSafeStateTrigger = ERROROUTZ0
        PortPin12:
          PortBiDirectionControl = false
          PortDriveStrengthControl = DRIVE_STRENGTH_TYPE_1_SUPP_PDSC
          PortInputBufferControl = false
          PortOpenDrainControl = OUTPUT_BUFFER_TYPE_PUSHPULL_SUPP_PODC_PODCE
          PortOutputLevelInversion = false
          PortPinDirection = PORT_PIN_IN
          PortPinDirectionChangeable = false
          PortPinInitialMode = DIO_ALT_NOT_SUPPORTED
          PortPinLevelValue = PORT_PIN_LEVEL_LOW
          PortPinSafeStateControl = false
          PortPinSafeStateTrigger = ERROROUTZ0
        PortPin13:
          PortBiDirectionControl = false
          PortDriveStrengthControl = DRIVE_STRENGTH_TYPE_1_SUPP_PDSC
          PortInputBufferControl = false
          PortOpenDrainControl = OUTPUT_BUFFER_TYPE_PUSHPULL_SUPP_PODC_PODCE
          PortOutputLevelInversion = false
          PortPinDirection = PORT_PIN_IN
          PortPinDirectionChangeable = false
          PortPinInitialMode = DIO_ALT_NOT_SUPPORTED
          PortPinLevelValue = PORT_PIN_LEVEL_LOW
          PortPinSafeStateControl = false
          PortPinSafeStateTrigger = ERROROUTZ0
        PortPin14:
          PortBiDirectionControl = false
          PortDriveStrengthControl = DRIVE_STRENGTH_TYPE_1_SUPP_PDSC
          PortInputBufferControl = false
          PortOpenDrainControl = OUTPUT_BUFFER_TYPE_PUSHPULL_SUPP_PODC_PODCE
          PortOutputLevelInversion = false
          PortPinDirection = PORT_PIN_IN
          PortPinDirectionChangeable = false
          PortPinInitialMode = DIO_ALT_NOT_SUPPORTED
          PortPinLevelValue = PORT_PIN_LEVEL_LOW
          PortPinSafeStateControl = false
          PortPinSafeStateTrigger = ERROROUTZ0
        PortPin15:
          PortBiDirectionControl = false
          PortDriveStrengthControl = DRIVE_STRENGTH_TYPE_1_SUPP_PDSC
          PortInputBufferControl = false
          PortOpenDrainControl = OUTPUT_BUFFER_TYPE_PUSHPULL_SUPP_PODC_PODCE
          PortOutputLevelInversion = false
          PortPinDirection = PORT_PIN_IN
          PortPinDirectionChangeable = false
          PortPinInitialMode = DIO_ALT_NOT_SUPPORTED
          PortPinLevelValue = PORT_PIN_LEVEL_LOW
          PortPinSafeStateControl = false
          PortPinSafeStateTrigger = ERROROUTZ0
        PortPin2:
          PortBiDirectionControl = false
          PortDriveStrengthControl = DRIVE_STRENGTH_TYPE_1_SUPP_PDSC
          PortInputBufferControl = false
          PortOpenDrainControl = OUTPUT_BUFFER_TYPE_PUSHPULL_SUPP_PODC_PODCE
          PortOutputLevelInversion = false
          PortPinDirection = PORT_PIN_IN
          PortPinDirectionChangeable = false
          PortPinInitialMode = DIO_ALT_NOT_SUPPORTED
          PortPinLevelValue = PORT_PIN_LEVEL_LOW
          PortPinSafeStateControl = false
          PortPinSafeStateTrigger = ERROROUTZ0
        PortPin3:
          PortBiDirectionControl = false
          PortDriveStrengthControl = DRIVE_STRENGTH_TYPE_1_SUPP_PDSC
          PortInputBufferControl = false
          PortOpenDrainControl = OUTPUT_BUFFER_TYPE_PUSHPULL_SUPP_PODC_PODCE
          PortOutputLevelInversion = false
          PortPinDirection = PORT_PIN_IN
          PortPinDirectionChangeable = false
          PortPinInitialMode = DIO_ALT_NOT_SUPPORTED
          PortPinLevelValue = PORT_PIN_LEVEL_LOW
          PortPinSafeStateControl = false
          PortPinSafeStateTrigger = ERROROUTZ0
        PortPin4:
          PortBiDirectionControl = false
          PortDriveStrengthControl = DRIVE_STRENGTH_TYPE_1_SUPP_PDSC
          PortInputBufferControl = false
          PortOpenDrainControl = OUTPUT_BUFFER_TYPE_PUSHPULL_SUPP_PODC_PODCE
          PortOutputLevelInversion = false
          PortPinDirection = PORT_PIN_IN
          PortPinDirectionChangeable = false
          PortPinInitialMode = DIO_ALT_NOT_SUPPORTED
          PortPinLevelValue = PORT_PIN_LEVEL_LOW
          PortPinSafeStateControl = false
          PortPinSafeStateTrigger = ERROROUTZ0
        PortPin5:
          PortBiDirectionControl = false
          PortDriveStrengthControl = DRIVE_STRENGTH_TYPE_1_SUPP_PDSC
          PortInputBufferControl = false
          PortOpenDrainControl = OUTPUT_BUFFER_TYPE_PUSHPULL_SUPP_PODC_PODCE
          PortOutputLevelInversion = false
          PortPinDirection = PORT_PIN_IN
          PortPinDirectionChangeable = false
          PortPinInitialMode = DIO_ALT_NOT_SUPPORTED
          PortPinLevelValue = PORT_PIN_LEVEL_LOW
          PortPinSafeStateControl = false
          PortPinSafeStateTrigger = ERROROUTZ0
        PortPin6:
          PortBiDirectionControl = false
          PortDriveStrengthControl = DRIVE_STRENGTH_TYPE_1_SUPP_PDSC
          PortInputBufferControl = false
          PortOpenDrainControl = OUTPUT_BUFFER_TYPE_PUSHPULL_SUPP_PODC_PODCE
          PortOutputLevelInversion = false
          PortPinDirection = PORT_PIN_IN
          PortPinDirectionChangeable = false
          PortPinInitialMode = DIO_ALT_NOT_SUPPORTED
          PortPinLevelValue = PORT_PIN_LEVEL_LOW
          PortPinSafeStateControl = false
          PortPinSafeStateTrigger = ERROROUTZ0
        PortPin7:
          PortBiDirectionControl = false
          PortDriveStrengthControl = DRIVE_STRENGTH_TYPE_1_SUPP_PDSC
          PortInputBufferControl = false
          PortOpenDrainControl = OUTPUT_BUFFER_TYPE_PUSHPULL_SUPP_PODC_PODCE
          PortOutputLevelInversion = false
          PortPinDirection = PORT_PIN_IN
          PortPinDirectionChangeable = false
          PortPinInitialMode = DIO_ALT_NOT_SUPPORTED
          PortPinLevelValue = PORT_PIN_LEVEL_LOW
          PortPinSafeStateControl = false
          PortPinSafeStateTrigger = ERROROUTZ0
        PortPin8:
          PortBiDirectionControl = false
          PortDriveStrengthControl = DRIVE_STRENGTH_TYPE_1_SUPP_PDSC
          PortInputBufferControl = false
          PortOpenDrainControl = OUTPUT_BUFFER_TYPE_PUSHPULL_SUPP_PODC_PODCE
          PortOutputLevelInversion = false
          PortPinDirection = PORT_PIN_IN
          PortPinDirectionChangeable = false
          PortPinInitialMode = DIO_ALT_NOT_SUPPORTED
          PortPinLevelValue = PORT_PIN_LEVEL_LOW
          PortPinSafeStateControl = false
          PortPinSafeStateTrigger = ERROROUTZ0
        PortPin9:
          PortBiDirectionControl = false
          PortDriveStrengthControl = DRIVE_STRENGTH_TYPE_1_SUPP_PDSC
          PortInputBufferControl = false
          PortOpenDrainControl = OUTPUT_BUFFER_TYPE_PUSHPULL_SUPP_PODC_PODCE
          PortOutputLevelInversion = false
          PortPinDirection = PORT_PIN_IN
          PortPinDirectionChangeable = false
          PortPinInitialMode = DIO_ALT_NOT_SUPPORTED
          PortPinLevelValue = PORT_PIN_LEVEL_LOW
          PortPinSafeStateControl = false
          PortPinSafeStateTrigger = ERROROUTZ0
      PortGroupAnalog3
        PortPin0:
          PortBiDirectionControl = false
          PortDriveStrengthControl = DRIVE_STRENGTH_TYPE_1_SUPP_PDSC
          PortInputBufferControl = false
          PortOpenDrainControl = OUTPUT_BUFFER_TYPE_PUSHPULL_SUPP_PODC_PODCE
          PortOutputLevelInversion = false
          PortPinDirection = PORT_PIN_IN
          PortPinDirectionChangeable = false
          PortPinInitialMode = DIO_ALT_NOT_SUPPORTED
          PortPinLevelValue = PORT_PIN_LEVEL_LOW
          PortPinSafeStateControl = false
          PortPinSafeStateTrigger = ERROROUTZ0
        PortPin1:
          PortBiDirectionControl = false
          PortDriveStrengthControl = DRIVE_STRENGTH_TYPE_1_SUPP_PDSC
          PortInputBufferControl = false
          PortOpenDrainControl = OUTPUT_BUFFER_TYPE_PUSHPULL_SUPP_PODC_PODCE
          PortOutputLevelInversion = false
          PortPinDirection = PORT_PIN_IN
          PortPinDirectionChangeable = false
          PortPinInitialMode = DIO_ALT_NOT_SUPPORTED
          PortPinLevelValue = PORT_PIN_LEVEL_LOW
          PortPinSafeStateControl = false
          PortPinSafeStateTrigger = ERROROUTZ0
        PortPin2:
          PortBiDirectionControl = false
          PortDriveStrengthControl = DRIVE_STRENGTH_TYPE_1_SUPP_PDSC
          PortInputBufferControl = false
          PortOpenDrainControl = OUTPUT_BUFFER_TYPE_PUSHPULL_SUPP_PODC_PODCE
          PortOutputLevelInversion = false
          PortPinDirection = PORT_PIN_IN
          PortPinDirectionChangeable = false
          PortPinInitialMode = DIO_ALT_NOT_SUPPORTED
          PortPinLevelValue = PORT_PIN_LEVEL_LOW
          PortPinSafeStateControl = false
          PortPinSafeStateTrigger = ERROROUTZ0
        PortPin3:
          PortBiDirectionControl = false
          PortDriveStrengthControl = DRIVE_STRENGTH_TYPE_1_SUPP_PDSC
          PortInputBufferControl = false
          PortOpenDrainControl = OUTPUT_BUFFER_TYPE_PUSHPULL_SUPP_PODC_PODCE
          PortOutputLevelInversion = false
          PortPinDirection = PORT_PIN_IN
          PortPinDirectionChangeable = false
          PortPinInitialMode = DIO_ALT_NOT_SUPPORTED
          PortPinLevelValue = PORT_PIN_LEVEL_LOW
          PortPinSafeStateControl = false
          PortPinSafeStateTrigger = ERROROUTZ0
      PortGroupAnalog4
        PortPin0:
          PortBiDirectionControl = false
          PortDriveStrengthControl = DRIVE_STRENGTH_TYPE_1_SUPP_PDSC
          PortInputBufferControl = false
          PortOpenDrainControl = OUTPUT_BUFFER_TYPE_PUSHPULL_SUPP_PODC_PODCE
          PortOutputLevelInversion = false
          PortPinDirection = PORT_PIN_IN
          PortPinDirectionChangeable = false
          PortPinInitialMode = DIO_ALT_NOT_SUPPORTED
          PortPinLevelValue = PORT_PIN_LEVEL_LOW
          PortPinSafeStateControl = false
          PortPinSafeStateTrigger = ERROROUTZ0
        PortPin1:
          PortBiDirectionControl = false
          PortDriveStrengthControl = DRIVE_STRENGTH_TYPE_1_SUPP_PDSC
          PortInputBufferControl = false
          PortOpenDrainControl = OUTPUT_BUFFER_TYPE_PUSHPULL_SUPP_PODC_PODCE
          PortOutputLevelInversion = false
          PortPinDirection = PORT_PIN_IN
          PortPinDirectionChangeable = false
          PortPinInitialMode = DIO_ALT_NOT_SUPPORTED
          PortPinLevelValue = PORT_PIN_LEVEL_LOW
          PortPinSafeStateControl = false
          PortPinSafeStateTrigger = ERROROUTZ0
        PortPin2:
          PortBiDirectionControl = false
          PortDriveStrengthControl = DRIVE_STRENGTH_TYPE_1_SUPP_PDSC
          PortInputBufferControl = false
          PortOpenDrainControl = OUTPUT_BUFFER_TYPE_PUSHPULL_SUPP_PODC_PODCE
          PortOutputLevelInversion = false
          PortPinDirection = PORT_PIN_IN
          PortPinDirectionChangeable = false
          PortPinInitialMode = DIO_ALT_NOT_SUPPORTED
          PortPinLevelValue = PORT_PIN_LEVEL_LOW
          PortPinSafeStateControl = false
          PortPinSafeStateTrigger = ERROROUTZ0
        PortPin3:
          PortBiDirectionControl = false
          PortDriveStrengthControl = DRIVE_STRENGTH_TYPE_1_SUPP_PDSC
          PortInputBufferControl = false
          PortOpenDrainControl = OUTPUT_BUFFER_TYPE_PUSHPULL_SUPP_PODC_PODCE
          PortOutputLevelInversion = false
          PortPinDirection = PORT_PIN_IN
          PortPinDirectionChangeable = false
          PortPinInitialMode = DIO_ALT_NOT_SUPPORTED
          PortPinLevelValue = PORT_PIN_LEVEL_LOW
          PortPinSafeStateControl = false
          PortPinSafeStateTrigger = ERROROUTZ0
        PortPin4:
          PortBiDirectionControl = false
          PortDriveStrengthControl = DRIVE_STRENGTH_TYPE_1_SUPP_PDSC
          PortInputBufferControl = false
          PortOpenDrainControl = OUTPUT_BUFFER_TYPE_PUSHPULL_SUPP_PODC_PODCE
          PortOutputLevelInversion = false
          PortPinDirection = PORT_PIN_IN
          PortPinDirectionChangeable = false
          PortPinInitialMode = DIO_ALT_NOT_SUPPORTED
          PortPinLevelValue = PORT_PIN_LEVEL_LOW
          PortPinSafeStateControl = false
          PortPinSafeStateTrigger = ERROROUTZ0
  module config Mcu: implementation-config-variant=VARIANT-POST-BUILD, module-description=Mcu_Impl
    McuGeneralConfiguration:
      McuClearAndSetWakeupFactorApi = true
      McuCriticalSectionProtection = true
      McuDevErrorDetect = true
      McuDeviceName = R7F702300AFABA
      McuEcmInterruptConsistencyCheck = false
      McuEcmResetTriggerSelect = false
      McuGetRamStateApi = false
      McuGetWakeupFactorApi = true
      McuInitClock = true
      McuIsrCategory = CAT2
      McuNoPll = false
      McuPerformResetApi = true
      McuProvideRAMStateISR = false
      McuRamEccEcmSettingSelect = Init
      McuReleaseIoBufferHoldApi = true
      McuSoftwareResetTriggerSelect = false
      McuSwResetCall = false
      McuVersionCheckExternalModules = false
      McuVersionInfoApi = true
      McuPowerGoodCount = 4095
    McuModuleConfiguration: McuClockSrcFailureNotification=DISABLED, McuNumberOfMcuModes=1, McuRamSectors=1, McuResetSetting=1
      McuClockSettingConfig:
        McuClkModeSelect = MCU_CLK_PLLO
        McuClockResponseWaitCount = 64
        McuClockSettingId = 0
        McuCpuMainSysClk = 400000000
        McuHsoscStopMask = MCU_HSOSC_STOP_MASK_DIS
        McuMainOscSelect = MCU_MOSC_20MHZ
        McuMoscStopMask = MCU_MOSC_STOP_MASK_DIS
        McuPllStopMask = MCU_PLL_STOP_MASK_DIS
        McuUnitName = CLK_CPU
        McuADCClk: McuPeripheralClock=40000000, McuSrcClockSel=MCU_CLK_LSB, McuUnitName=CLK_ADC
        McuADCClkA: McuDivClockSel=MCU_CLKA_ADC_DIVBY2, McuPeripheralClock=5000000, McuSrcClockSel=MCU_CLK_HSOSC_D20, McuUnitName=CLKA_ADC
        McuClockMonitorSettingConf:
          McuClm0MonitoringClockAccuracy = 14
          McuClm0Operation = false
          McuClm0SamplingClockAccuracy = 14
          McuClm1MonitoringClockAccuracy = 14
          McuClm1Operation = false
          McuClm1SamplingClockAccuracy = 14
          McuClm2MonitoringClockAccuracy = 14
          McuClm2Operation = false
          McuClm2SamplingClockAccuracy = 14
          McuClm3MonitoringClockAccuracy = 14
          McuClm3Operation = false
          McuClm3SamplingClockAccuracy = 14
          McuClm4MonitoringClockAccuracy = 14
          McuClm4Operation = false
          McuClm4SamplingClockAccuracy = 14
          McuClm5MonitoringClockAccuracy = 14
          McuClm5Operation = false
          McuClm5SamplingClockAccuracy = 14
          McuClm6MonitoringClockAccuracy = 14
          McuClm6Operation = false
          McuClm6SamplingClockAccuracy = 14
          McuClm7MonitoringClockAccuracy = 14
          McuClm7Operation = false
          McuClm7SamplingClockAccuracy = 14
          McuClm8Operation = false
          McuClm9Operation = false
          McuClm8MonitoringClockAccuracy = 14
          McuClm8SamplingClockAccuracy = 14
          McuClm9MonitoringClockAccuracy = 14
          McuClm9SamplingClockAccuracy = 14
        McuClockReferencePoint: McuClockReferencePointFrequency=400000000
        McuEXTCLK0OClk: McuDivClockN=0, McuPeripheralClock=20000000, McuSrcClockSel=MCU_CLK_HSB, McuUnitName=EXTCLK0O
        McuEXTCLK1OClk: McuDivClockN=0, McuPeripheralClock=20000000, McuSrcClockSel=MCU_CLK_HSB, McuUnitName=EXTCLK1O
        McuHBusClk: McuPeripheralClock=100000000, McuUnitName=CLK_HBUS
        McuHighSpeedPeriClk: McuPeripheralClock=80000000, McuUnitName=CLK_HSB
        McuLowSpeedPeriClk: McuPeripheralClock=40000000, McuUnitName=CLK_LSB
        McuMSPIClk: McuPeripheralClock=80000000, McuSrcClockSel=MCU_CLK_HSB, McuUnitName=CLK_MSPI
        McuRLINClk: McuPeripheralClock=80000000, McuSrcClockSel=MCU_CLK_HSB, McuUnitName=CLK_RLIN
        McuRTCClk: McuPeripheralClock=240000, McuSrcClockSel=MCU_CLK_LSOSC, McuUnitName=CLKA_RTCA
        McuSystemBusClk: McuPeripheralClock=200000000, McuUnitName=CLK_SBUS
        McuTAUJClk: McuPeripheralClock=240000, McuSrcClockSel=MCU_CLK_LSOSC, McuUnitName=CLK_TAUJ
        McuUltraHighSpeedPeriClk: McuPeripheralClock=160000000, McuUnitName=CLK_UHSB
        McuWDTClk: McuPeripheralClock=312500, McuSrcClockSel=MCU_CLK_HSOSC_D640, McuUnitName=CLK_WDT
        McuWDTClkA: McuPeripheralClock=240000, McuSrcClockSel=MCU_CLK_LSOSC, McuUnitName=CLKA_WDT
        McuRCANClk: McuPeripheralClock=20000000, McuSrcClockSel=MCU_CLK_MOSC, McuUnitName=CLK_RCAN
      McuMode_RUN (McuModeSettingConf): McuMode=0, McuModeType=MCU_RUN_MODE, McuWakeUpFactor=false
      McuVmonSettingConf: McuDmonDiagOperation=false, McuVmonDiagOperation=false
        McuDmonDetailSettingConf:
          McuDmonFilterSelect = MCU_VMON_DMONFLTW_NONE
          McuDmoncirren = MCU_VMON_DMONCIRREN_DIS
          McuDmonflten = MCU_VMON_DMONFLTEN_DIS
          McuDmonlde = MCU_VMON_DMONLDE_DIS
        McuVmonDetailSettingConf:
          McuVmonAwovddfbistme = MCU_VMON_AWOVDDFBISTME_EN
          McuVmonE0Vcccirren = MCU_VMON_E0VCCCIRREN_DIS
          McuVmonIsovddcirren = MCU_VMON_ISOVDDCIRREN_DIS
          McuVmonIsovddfbistme = MCU_VMON_ISOVDDFBISTME_EN
          McuVmonVcccirren = MCU_VMON_VCCCIRREN_DIS
    McuPublishedInformation
      McuResetReasonConf: McuResetReason=0
      McuRstRsnConfAdParityErrRst: McuResetReason=46
      McuRstRsnConfAdrbusEdcEccErrRst: McuResetReason=83
      McuRstRsnConfBusBridgecompErrorRst: McuResetReason=23
      McuRstRsnConfCanramEcc1bitErrRst: McuResetReason=71
      McuRstRsnConfCanramEcc2bitErrRst: McuResetReason=70
      McuRstRsnConfCflhEcc1bitErrRst: McuResetReason=50
      McuRstRsnConfCflhEcc2bitErrRst: McuResetReason=49
      McuRstRsnConfCflhErrAdrOflowRst: McuResetReason=51
      McuRstRsnConfCflhErrAdrPrtyErrRst: McuResetReason=48
      McuRstRsnConfClmaErrPe0Rst: McuResetReason=103
      McuRstRsnConfClmaErrPe1Rst: McuResetReason=114
      McuRstRsnConfClmaErrPe2Rst: McuResetReason=125
      McuRstRsnConfClmaErrPe3Rst: McuResetReason=136
      McuRstRsnConfClmaHbusErrRst: McuResetReason=36
      McuRstRsnConfClmaHoscErrRst: McuResetReason=32
      McuRstRsnConfClmaLoscErrRst: McuResetReason=33
      McuRstRsnConfClmaLsbErrRst: McuResetReason=34
      McuRstRsnConfClmaMoscErrRst: McuResetReason=31
      McuRstRsnConfClmaUhsbErrRst: McuResetReason=35
      McuRstRsnConfCramAdrOrEcc2ErrRst: McuResetReason=58
      McuRstRsnConfCramBusRst: McuResetReason=27
      McuRstRsnConfCramEcc1bitErrRst: McuResetReason=59
      McuRstRsnConfCramErrAdrOflowRst: McuResetReason=60
      McuRstRsnConfCramGuardErrRst: McuResetReason=86
      McuRstRsnConfDataAccessErrPe0Rst: McuResetReason=110
      McuRstRsnConfDataAccessErrPe1Rst: McuResetReason=121
      McuRstRsnConfDataAccessErrPe2Rst: McuResetReason=132
      McuRstRsnConfDataAccessErrPe3Rst: McuResetReason=143
      McuRstRsnConfDataTransDmaOrDtsErrRst: McuResetReason=90
      McuRstRsnConfDataTransHbusErrRst: McuResetReason=91
      McuRstRsnConfDatabusEcc1bitErrRst: McuResetReason=85
      McuRstRsnConfDatabusEcc2bitErrRst: McuResetReason=84
      McuRstRsnConfDclsCompErrPe0Rst: McuResetReason=100
      McuRstRsnConfDclsCompErrPe1Rst: McuResetReason=111
      McuRstRsnConfDclsCompErrPe2Rst: McuResetReason=122
      McuRstRsnConfDclsCompErrPe3Rst: McuResetReason=133
      McuRstRsnConfDeepstopRst: McuResetReason=8
      McuRstRsnConfDflhEcc1bitErrRst: McuResetReason=53
      McuRstRsnConfDflhEcc2bitErrRst: McuResetReason=52
      McuRstRsnConfDflhErrAdrOflowRst: McuResetReason=54
      McuRstRsnConfDmaCompErrRst: McuResetReason=22
      McuRstRsnConfDtsCompErrRst: McuResetReason=21
      McuRstRsnConfDtsramEcc1bitErrRst: McuResetReason=62
      McuRstRsnConfDtsramEcc2bitErrRst: McuResetReason=61
      McuRstRsnConfDtsramErrAdrOflowRst: McuResetReason=63
      McuRstRsnConfEcmAppRst: McuResetReason=7
      McuRstRsnConfEcmCompErrRst: McuResetReason=12
      McuRstRsnConfEcmDlyTimerOflowRst: McuResetReason=11
      McuRstRsnConfEcmSysRst: McuResetReason=4
      McuRstRsnConfExtErrin0Rst: McuResetReason=92
      McuRstRsnConfExtErrin1Rst: McuResetReason=93
      McuRstRsnConfExtErrin2Rst: McuResetReason=94
      McuRstRsnConfExtErrin3Rst: McuResetReason=95
      McuRstRsnConfExtRst: McuResetReason=1
      McuRstRsnConfFlashAccessErrRst: McuResetReason=20
      McuRstRsnConfFrramEcc1bitErrRst: McuResetReason=69
      McuRstRsnConfFrramEcc2bitErrRst: McuResetReason=68
      McuRstRsnConfGethramEcc1bitErrRst: McuResetReason=79
      McuRstRsnConfGethramEcc2bitErrRst: McuResetReason=78
      McuRstRsnConfGlobalFlashBusRst: McuResetReason=29
      McuRstRsnConfGtmramEcc1bitErrRst: McuResetReason=75
      McuRstRsnConfGtmramEcc2bitErrRst: McuResetReason=74
      McuRstRsnConfHbusGuardErrRst: McuResetReason=89
      McuRstRsnConfIbusGuardErrRst: McuResetReason=87
      McuRstRsnConfIcacheAdrOrEdcErrPe0Rst: McuResetReason=107
      McuRstRsnConfIcacheAdrOrEdcErrPe1Rst: McuResetReason=118
      McuRstRsnConfIcacheAdrOrEdcErrPe2Rst: McuResetReason=129
      McuRstRsnConfIcacheAdrOrEdcErrPe3Rst: McuResetReason=140
      McuRstRsnConfIcumSwAppRst: McuResetReason=10
      McuRstRsnConfIcumSwSysRst: McuResetReason=9
      McuRstRsnConfInterClusterBusRst: McuResetReason=25
      McuRstRsnConfInterProcElementBusRst: McuResetReason=24
      McuRstRsnConfLocalFlashBusRst: McuResetReason=30
      McuRstRsnConfLramAdrOrEcc2ErrPe0Rst: McuResetReason=104
      McuRstRsnConfLramAdrOrEcc2ErrPe1Rst: McuResetReason=115
      McuRstRsnConfLramAdrOrEcc2ErrPe2Rst: McuResetReason=126
      McuRstRsnConfLramAdrOrEcc2ErrPe3Rst: McuResetReason=137
      McuRstRsnConfLramEcc1ErrPe0Rst: McuResetReason=105
      McuRstRsnConfLramEcc1ErrPe1Rst: McuResetReason=116
      McuRstRsnConfLramEcc1ErrPe2Rst: McuResetReason=127
      McuRstRsnConfLramEcc1ErrPe3Rst: McuResetReason=138
      McuRstRsnConfLramEcc1bitErrRst: McuResetReason=56
      McuRstRsnConfLramEcc2bitErrRst: McuResetReason=55
      McuRstRsnConfLramErrAdrOflowRst: McuResetReason=57
      McuRstRsnConfLramErradrOflowPe0Rst: McuResetReason=106
      McuRstRsnConfLramErradrOflowPe1Rst: McuResetReason=117
      McuRstRsnConfLramErradrOflowPe2Rst: McuResetReason=128
      McuRstRsnConfLramErradrOflowPe3Rst: McuResetReason=139
      McuRstRsnConfMethramEcc1bitErrRst: McuResetReason=77
      McuRstRsnConfMethramEcc2bitErrRst: McuResetReason=76
      McuRstRsnConfMmcaRamEcc1bitErrRst: McuResetReason=81
      McuRstRsnConfMmcaRamEcc2bitErrRst: McuResetReason=80
      McuRstRsnConfModeErr0Rst: McuResetReason=13
      McuRstRsnConfModeErr1Rst: McuResetReason=14
      McuRstRsnConfModeErr2Rst: McuResetReason=15
      McuRstRsnConfModeErr3Rst: McuResetReason=16
      McuRstRsnConfModeErr4Rst: McuResetReason=17
      McuRstRsnConfModeErr5Rst: McuResetReason=18
      McuRstRsnConfModeErr6Rst: McuResetReason=19
      McuRstRsnConfModeUnintDebugEnablePe0Rst: McuResetReason=101
      McuRstRsnConfModeUnintDebugEnablePe1Rst: McuResetReason=112
      McuRstRsnConfModeUnintDebugEnablePe2Rst: McuResetReason=123
      McuRstRsnConfModeUnintDebugEnablePe3Rst: McuResetReason=134
      McuRstRsnConfMspiramEcc1bitErrRst: McuResetReason=73
      McuRstRsnConfMspiramEcc2bitErrRst: McuResetReason=72
      McuRstRsnConfMultiRst: McuResetReason=144
      McuRstRsnConfNonRst: McuResetReason=146
      McuRstRsnConfOstm1IntRst: McuResetReason=37
      McuRstRsnConfOstm2IntRst: McuResetReason=38
      McuRstRsnConfOstm3IntRst: McuResetReason=39
      McuRstRsnConfOstm4IntRst: McuResetReason=40
      McuRstRsnConfOstm5IntRst: McuResetReason=41
      McuRstRsnConfOstm6IntRst: McuResetReason=42
      McuRstRsnConfOstm7IntRst: McuResetReason=43
      McuRstRsnConfOstm8IntRst: McuResetReason=44
      McuRstRsnConfOstm9IntRst: McuResetReason=45
      McuRstRsnConfPbusGuardErrRst: McuResetReason=88
      McuRstRsnConfPegOtherLramreqPe0Rst: McuResetReason=109
      McuRstRsnConfPegOtherLramreqPe1Rst: McuResetReason=120
      McuRstRsnConfPegOtherLramreqPe2Rst: McuResetReason=131
      McuRstRsnConfPegOtherLramreqPe3Rst: McuResetReason=142
      McuRstRsnConfPeguardErrPe0Rst: McuResetReason=108
      McuRstRsnConfPeguardErrPe1Rst: McuResetReason=119
      McuRstRsnConfPeguardErrPe2Rst: McuResetReason=130
      McuRstRsnConfPeguardErrPe3Rst: McuResetReason=141
      McuRstRsnConfPeriRamEccOflowErrRst: McuResetReason=82
      McuRstRsnConfPheripheralBusRst: McuResetReason=26
      McuRstRsnConfPowerOnReset: McuResetReason=0
      McuRstRsnConfResetUndefined: McuResetReason=145
      McuRstRsnConfSdmac0RamEcc1bitErrRst: McuResetReason=65
      McuRstRsnConfSdmac0RamEcc2bitErrRst: McuResetReason=64
      McuRstRsnConfSdmac1RamEcc1bitErrRst: McuResetReason=67
      McuRstRsnConfSdmac1RamEcc2bitErrRst: McuResetReason=66
      McuRstRsnConfSwAlarm0Rst: McuResetReason=96
      McuRstRsnConfSwAlarm1Rst: McuResetReason=97
      McuRstRsnConfSwAlarm2Rst: McuResetReason=98
      McuRstRsnConfSwAlarm3Rst: McuResetReason=99
      McuRstRsnConfSwAppRst: McuResetReason=6
      McuRstRsnConfSwSysRst: McuResetReason=3
      McuRstRsnConfSystemBusRst: McuResetReason=28
      McuRstRsnConfTempSensorerrRst: McuResetReason=47
      McuRstRsnConfVmonRst: McuResetReason=2
      McuRstRsnConfWdtErrPe0Rst: McuResetReason=102
      McuRstRsnConfWdtErrPe1Rst: McuResetReason=113
      McuRstRsnConfWdtErrPe2Rst: McuResetReason=124
      McuRstRsnConfWdtErrPe3Rst: McuResetReason=135
      McuRstRsnConfWdtbaSysRst: McuResetReason=5
  module config EcuM: implementation-config-variant=VARIANT-POST-BUILD-LOADABLE
    EcuMConfiguration
      EcuMCommonConfiguration: EcuMConfigConsistencyHash=(unset), EcuMDefaultAppMode=(unset), EcuMOSResource=(unset)
        EcuMDefaultShutdownTarget: EcuMDefaultState=(unset)
        EcuMSleepMode: EcuMSleepModeId=(unset), EcuMSleepModeSuspend=(unset), EcuMSleepModeMcuModeRef=(unset), EcuMWakeupSourceMask=(unset)
        EcuMWakeupSource_BKBCANFD (EcuMWakeupSource): EcuMWakeupSourceId=(unset), EcuMWakeupSourcePolling=(unset), EcuMResetReasonRef=(unset)
        EcuMWakeupSource_LHBDCANFD (EcuMWakeupSource): EcuMWakeupSourceId=(unset), EcuMWakeupSourcePolling=(unset), EcuMResetReasonRef=(unset)
    EcuMGeneral: EcuMDevErrorDetect=(unset), EcuMIncludeDem=(unset), EcuMIncludeDet=(unset), EcuMMainFunctionPeriod=(unset), EcuMVersionInfoApi=(unset)
  module config Can: implementation-config-variant=VARIANT-POST-BUILD, module-description=Can_Impl
    CanConfigSet0 (CanConfigSet):
      CanControllerMainClockImmediateValue = 20000000
      CanControllerPplClockImmediateValue = 80000000
      CanControllerPclkClockImmediateValue = 80000000
      CanControllerMainClock = McuRCANClk
      CanControllerPclkClock = McuHighSpeedPeriClk
      CanControllerPplClock = McuHighSpeedPeriClk
      11 x CanHardwareObject, all with CanHwObjectCount=1, CanIdType=STANDARD, CanTriggerTransmitEnable=false, CanHardwareObjectUsesPolling=false, CanControllerRef=CanController_CAN0:
        CanHardwareObject_CAN0_Tx_0x501_NM_ECU: CanHandleType=FULL, CanObjectId=11, CanObjectType=TRANSMIT, CanMemoryMode=BUFFER_MODE, CanObjectPayloadLength=CAN_OBJECT_PL_64
        CanHardwareObject_CAN0_Tx_0x709_Diag_Phy_Response: CanHandleType=FULL, CanObjectId=12, CanObjectType=TRANSMIT, CanMemoryMode=BUFFER_MODE, CanObjectPayloadLength=CAN_OBJECT_PL_64
        CanHardwareObject_CAN0_Tx_0x302_Mixed: CanHandleType=FULL, CanObjectId=6, CanObjectType=TRANSMIT, CanMemoryMode=BUFFER_MODE, CanObjectPayloadLength=CAN_OBJECT_PL_64
        CanHardwareObject_CAN0_Tx_0x351_Cyclic_PN29: CanHandleType=FULL, CanObjectId=9, CanObjectType=TRANSMIT, CanMemoryMode=BUFFER_MODE, CanObjectPayloadLength=CAN_OBJECT_PL_64
        CanHardwareObject_CAN0_Tx_0x360_E2E_P01: CanHandleType=FULL, CanObjectId=10, CanObjectType=TRANSMIT, CanMemoryMode=BUFFER_MODE, CanObjectPayloadLength=CAN_OBJECT_PL_64
        CanHardwareObject_CAN0_Tx_0x303_Cyclic_Counter: CanHandleType=FULL, CanObjectId=7, CanObjectType=TRANSMIT, CanMemoryMode=BUFFER_MODE, CanObjectPayloadLength=CAN_OBJECT_PL_64
        CanHardwareObject_CAN0_Tx_0x350_Cyclic_PN17: CanHandleType=FULL, CanObjectId=8, CanObjectType=TRANSMIT, CanMemoryMode=BUFFER_MODE, CanObjectPayloadLength=CAN_OBJECT_PL_64
        CanHardwareObject_CAN0_Tx_0x301_Event: CanHandleType=FULL, CanObjectId=5, CanObjectType=TRANSMIT, CanMemoryMode=BUFFER_MODE, CanObjectPayloadLength=CAN_OBJECT_PL_64
        CanHardwareObject_CAN0_Rx_0x5xx_NM_ECU: CanHandleType=BASIC, CanMemoryMode=RECEIVE_FIFO_MODE, CanObjectId=0, CanObjectType=RECEIVE, CanObjectPayloadLength=CAN_OBJECT_PL_8
          CanHwFilter: CanHwFilterCode=1280, CanHwFilterDLCCheckValue=0, CanHwFilterMask=1792, CanHwFilterReceiveIdType=STANDARD, CanHwFilterSourceNode=FROM_OTHER_NODE
          CanReceiveFIFOConfiguration:
            CanEnableReceiveFIFOInterrupt = true
            CanReceiveFIFOBufferDepth = BUFFER_8
            CanReceiveFIFOPayloadLength = PAYLOAD_8
            CanReceiveFIFOInterruptRatioSel = FIFO_1_BY_8
            CanReceiveFIFOInterruptSrcSel = EACH_MESSAGE
        CanHardwareObject_CAN0_Rx_0x708_Diag_Phy_Request: CanHandleType=FULL, CanMemoryMode=RECEIVE_FIFO_MODE, CanObjectId=2, CanObjectType=RECEIVE, CanObjectPayloadLength=CAN_OBJECT_PL_8
          CanReceiveFIFOConfiguration:
            CanEnableReceiveFIFOInterrupt = true
            CanReceiveFIFOBufferDepth = BUFFER_8
            CanReceiveFIFOPayloadLength = PAYLOAD_8
            CanReceiveFIFOInterruptRatioSel = FIFO_1_BY_8
            CanReceiveFIFOInterruptSrcSel = EACH_MESSAGE
          CanHwFilter: CanHwFilterCode=1800, CanHwFilterDLCCheckValue=0, CanHwFilterMask=2047, CanHwFilterReceiveIdType=STANDARD, CanHwFilterSourceNode=FROM_OTHER_NODE
        CanHardwareObject_CAN0_Rx_0x7df_Diag_Fun_Request: CanHandleType=FULL, CanMemoryMode=RECEIVE_FIFO_MODE, CanObjectId=1, CanObjectType=RECEIVE, CanObjectPayloadLength=CAN_OBJECT_PL_8
          CanReceiveFIFOConfiguration:
            CanEnableReceiveFIFOInterrupt = true
            CanReceiveFIFOBufferDepth = BUFFER_8
            CanReceiveFIFOPayloadLength = PAYLOAD_8
            CanReceiveFIFOInterruptRatioSel = FIFO_1_BY_8
            CanReceiveFIFOInterruptSrcSel = EACH_MESSAGE
          CanHwFilter: CanHwFilterCode=2015, CanHwFilterDLCCheckValue=0, CanHwFilterMask=2047, CanHwFilterReceiveIdType=STANDARD, CanHwFilterSourceNode=FROM_OTHER_NODE
      CanController_CAN0 (CanController):
        CanBusoffProcessing = INTERRUPT
        CanControllerActivation = true
        CanControllerId = 0
        CanRxProcessing = INTERRUPT
        CanTxProcessing = INTERRUPT
        CanWakeupProcessing = POLLING
        CanWakeupSupport = false
        CanEnableTransmitHistoryInterrupt = false
        CanControllerSelection = RSCANFD02
        CanControllerInterfaceMode = CLASSICAL_CAN_ONLY
        CanEnableCanCanFDGateway = false
        CanFDGatewayForwardingFormat = CLASSICAL_CAN_FORMAT
        CanFDGatewayBRSBit = false
        CanControllerBaseAddress = 0
        CanWakeupFunctionalityAPI = false
        CanControllerDefaultBaudrate = CanControllerBaudrateConfig0
        CanCpuClockRef = McuClockReferencePoint
        CanControllerBaudrateConfig0 (CanControllerBaudrateConfig):
          CanControllerBaudRate = 500
          CanControllerBaudRateConfigID = 0
          CanControllerSeg1 = 15
          CanControllerSeg2 = 4
          CanControllerSyncJumpWidth = 1
          CanControllerPropSeg = 0
      4 x CanHardwareObject, all with CanHwObjectCount=1, CanTriggerTransmitEnable=false, CanHardwareObjectUsesPolling=false, CanControllerRef=CanController_CAN0:
        CanHardwareObject_CAN0_Tx_0x300_Cyclic: CanHandleType=FULL, CanIdType=STANDARD, CanObjectId=4, CanObjectType=TRANSMIT, CanMemoryMode=BUFFER_MODE, CanObjectPayloadLength=CAN_OBJECT_PL_64
        CanHardwareObject_CAN0_Rx_COM: CanHandleType=BASIC, CanIdType=STANDARD, CanMemoryMode=RECEIVE_FIFO_MODE, CanObjectId=3, CanObjectType=RECEIVE, CanObjectPayloadLength=CAN_OBJECT_PL_8
          CanReceiveFIFOConfiguration:
            CanEnableReceiveFIFOInterrupt = true
            CanReceiveFIFOBufferDepth = BUFFER_64
            CanReceiveFIFOPayloadLength = PAYLOAD_8
            CanReceiveFIFOInterruptRatioSel = FIFO_1_BY_8
            CanReceiveFIFOInterruptSrcSel = EACH_MESSAGE
          7 x CanHwFilter, all with CanHwFilterDLCCheckValue=0, CanHwFilterMask=2047, CanHwFilterReceiveIdType=STANDARD, CanHwFilterSourceNode=FROM_OTHER_NODE:
            CanHwFilter_0x200: CanHwFilterCode=512
            CanHwFilter_0x201: CanHwFilterCode=513
            CanHwFilter_0x202: CanHwFilterCode=514
            CanHwFilter_0x203: CanHwFilterCode=515
            CanHwFilter_0x250: CanHwFilterCode=592
            CanHwFilter_0x251: CanHwFilterCode=593
            CanHwFilter_0x260: CanHwFilterCode=608
        CanHardwareObject_CAN0_Tx_0x304_Cyclic_Counter: CanHandleType=FULL, CanIdType=STANDARD, CanObjectId=13, CanObjectType=TRANSMIT, CanMemoryMode=BUFFER_MODE, CanObjectPayloadLength=CAN_OBJECT_PL_64
        CanHardwareObject_CAN0_Tx_0x18C4D2D0_Cyclic_Counter: CanHandleType=FULL, CanIdType=EXTENDED, CanObjectId=14, CanObjectType=TRANSMIT, CanMemoryMode=BUFFER_MODE, CanObjectPayloadLength=CAN_OBJECT_PL_64
    Can (CanGeneral):
      CanIndex = 0
      CanMainFunctionModePeriod = 0.005
      CanMultiplexedTransmission = false
      CanTimeoutDuration = 5
      CanVersionInfoApi = false
      CanCriticalSectionProtection = true
      CanVersionCheckExternalModules = false
      CanDeviceName = R7F702300BFABA
      CanAlreadyInitDetCheck = true
      CanInterruptConsistencyCheck = false
      CanIsrCategory = CAT2
      CanEnableClkImmediateValue = true
      CanMultiCoreSupport = false
      CanSetBaudrateApi = false
      CanLPduReceiveCalloutFunction = 
      CanDevErrorDetect = false
      CanWakeUpFactorClearIsr = true
      CanEnableSecurityEventReporting = false
      CanGlobalTimeSupport = false
      CanMainFunctionBusoffPeriod = 0.005
      CanMainFunctionWakeupPeriod = 0.005
      CanPublicIcomSupport = false
      CanOsCounterRef = OsCounter
      CanSupportTTCANRef = (unset)
    CanGlobalConfiguration:
      CanHardwareUnitSelect = RSCANFD0
      CanClockSourceSelect = CLKC
      CanIntervalTimerPrescalerSet = 8
      CanMirrorFunctionSupport = false
      CanEnableDLCCheck = true
      CanTransmitPrioritySelect = DEPEND_ON_ID
      CanPayloadOverflowModeSelect = DISCARD
      CanRxBufferPayloadLength = PAYLOAD_8
