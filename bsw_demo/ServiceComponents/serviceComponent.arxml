AUTOSAR XML (schema 00048)
standard types defined: Boolean, SInt8, SInt16, SInt32, UInt8, UInt16, UInt32, UInt64, Float32, Float64, boolean, uint8, uint16, uint32, uint64, sint8, sint16, sint32, sint64, float32, float64, Std_ReturnType, sint8_least, sint16_least, uint16_least, uint32_least, uint8_least, sint32_least
package /AUTOSAR/StdTypes/DataConstrs
  range SInt8_Constr: raw -128..127
  range SInt16_Constr: raw -32768..32767
  range SInt32_Constr: raw -2147483648..2147483647
  range UInt8_ConStr: raw 0..255
  range UInt16_ConStr: raw 0..65535
  range UInt32_Constr: raw 0..4294967295
  range UInt64_Constr: raw 0..18446744073709551615
  range Boolean_Constr: phys 0..1
package /AUTOSAR/DataTypes
  13 x impl type, all with category=VALUE, type-emitter=Platform_Type:
    Std_VersionInfoType
    Std_Std_TransformerError
    PduIdType
    PduInfoType
    PduLengthType
    PNCHandleType
    TPParameterType
    BufReq_ReturnType
    TpDataStateType
    RetryInfoType
    NetworkHandleType
    lcomConfigldType
    lcomSwitch_ErrorType
