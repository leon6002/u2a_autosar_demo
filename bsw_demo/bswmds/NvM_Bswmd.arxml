AUTOSAR XML (schema 00048)
package /AUTOSAR/BswOverviews
  bsw module description NvM: implemented-entrys=NvM_MainFunction
    bsw internal behavior IB_NvM
      exclusive area Queue
      bsw schedulable entity SE_NvM_MainFunction: reentrancy-level=NON-REENTRANT, implemented-entry=NvM_MainFunction
      bsw timing event TE_NvM_MainFunction: category=Memory, starts-on-event=SE_NvM_MainFunction, period=0.01
      bsw distinguished partition NvM_EcucPartition
package /AUTOSAR/BswImplementations
  bsw implementation Imp_NvM: programming-language=C, sw-version=2.0.6, vendor-id=62, ar-release-version=4.5.0, behavior=IB_NvM
package /AUTOSAR/BswInterfaces
  bsw module entry NvM_MainFunction: is-synchronous=true, call-type=SCHEDULED, execution-context=TASK, sw-service-impl-policy=STANDARD
