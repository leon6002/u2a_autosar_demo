AUTOSAR XML (schema 00048)
package /AUTOSAR/BswModuleDescription
  bsw module description ComXf
    bsw internal behavior IB_ComXf
package /AUTOSAR/BswImplementationPackage
  bsw implementation Imp_ComXf: programming-language=C, sw-version=2.0.0, vendor-id=62, ar-release-version=4.5.0, behavior=IB_ComXf
