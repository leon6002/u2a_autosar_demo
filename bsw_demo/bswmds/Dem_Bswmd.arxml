AUTOSAR XML (schema 00048)
package /AUTOSAR/BswOverviews
  bsw module description Dem: implemented-entrys=Dem_MainFunction
    bsw internal behavior IB_Dem
      exclusive area ExclusiveArea
      bsw schedulable entity SE_Dem_MainFunction: reentrancy-level=NON-REENTRANT, implemented-entry=Dem_MainFunction
      bsw timing event TE_Dem_MainFunction: starts-on-event=SE_Dem_MainFunction, period=0.01
      bsw distinguished partition Dem_EcucPartition
package /AUTOSAR/BswImplementations
  bsw implementation Imp_Dem: programming-language=C, sw-version=2.1.2, vendor-id=62, ar-release-version=4.2.2, behavior=IB_Dem
package /AUTOSAR/BswInterfaces
  bsw module entry Dem_MainFunction: is-synchronous=true, call-type=SCHEDULED, execution-context=TASK, sw-service-impl-policy=STANDARD
