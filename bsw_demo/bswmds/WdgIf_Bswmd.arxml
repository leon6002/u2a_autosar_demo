AUTOSAR XML (schema 00048)
package /AUTOSAR/BswOverviews
  bsw module description WdgIf
    bsw internal behavior IB_WdgIf
package /AUTOSAR/BswInterfaces
  bsw implementation Imp_WdgIf: programming-language=C, sw-version=1.0.0, vendor-id=62, ar-release-version=1.0.0, behavior=IB_WdgIf
