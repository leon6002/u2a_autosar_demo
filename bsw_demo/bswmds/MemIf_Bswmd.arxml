AUTOSAR XML (schema 00048)
package /AUTOSAR/BswOverviews
  bsw module description MemIf
    bsw internal behavior IB_MemIf
package /AUTOSAR/BswImplementations
  bsw implementation Imp_MemIf: programming-language=C, sw-version=2.0.2, vendor-id=62, ar-release-version=4.5.0, behavior=IB_MemIf
