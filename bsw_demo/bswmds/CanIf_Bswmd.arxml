AUTOSAR XML (schema 00048)
package /AUTOSAR/BswOverviews
  bsw module description CanIf: module-id=60
    provided-client-server-entrys:
      bsw module client server entry pCanIf_Transmit: encapsulated-entry=CanIf_Transmit, is-synchronous=true
    bsw internal behavior IB_CanIf
      exclusive area ExclusiveArea_Channel
      bsw called entity CE_CanIf_Transmit: implemented-entry=CanIf_Transmit
      bsw operation invoked event OIE_CanIf_Transmit: starts-on-event=CE_CanIf_Transmit, entry=pCanIf_Transmit
package /AUTOSAR/BswImplementations
  bsw implementation Imp_CanIf: programming-language=C, sw-version=2.1.5, vendor-id=62, ar-release-version=4.5.0, behavior=IB_CanIf
    code-descriptors:
      code Header: artifact-descriptors=[{short-label=Std_Types.h, category=SWHDR}, {short-label=ComStack_Cfg.h, category=SWHDR}]
package /AUTOSAR/BswInterfaces
  bsw module entry CanIf_Transmit: service-id=5, is-synchronous=true, call-type=REGULAR, execution-context=UNSPECIFIED, sw-service-impl-policy=STANDARD
    return type result: direction=OUT, implementation-data-type=Std_ReturnType
    sw service arg CanIfTxSduId: direction=IN, implementation-data-type=PduIdType
    sw service arg PduInfoPtr: direction=INOUT, implementation-data-type=PduInfoType, sw-impl-policy=CONST
