AUTOSAR XML (schema 00048)
package /AUTOSAR/BswOverviews
  bsw module description ComM: category=BSW_MODULE, implemented-entrys=ComM_MainFunction_Channel_CanController_0, module-id=12
    bsw internal behavior ComMBehavior
      exclusive area COMM_EXCLUSIVE_AREA_0
      exclusive area COMM_EXCLUSIVE_AREA_1
      bsw schedulable entity ComM_MainFunction_Channel_CanController_0: implemented-entry=ComM_MainFunction_Channel_CanController_0
      bsw timing event TimingEvent_MainFunction_Channel_CanController_0: starts-on-event=ComM_MainFunction_Channel_CanController_0, period=0.005
package /AUTOSAR/BswImplementations
  bsw implementation ComMImplementation: programming-language=C, sw-version=1.0.0, vendor-id=62, ar-release-version=1.0.0, behavior=ComMBehavior
package /AUTOSAR/BswInterfaces
  bsw module entry ComM_MainFunction_Channel_CanController_0: service-id=96, is-synchronous=true, call-type=SCHEDULED, execution-context=TASK, sw-service-impl-policy=STANDARD
