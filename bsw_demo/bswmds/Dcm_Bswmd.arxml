AUTOSAR XML (schema 00048)
package /AUTOSAR/BswOverviews
  bsw module description Dcm: implemented-entrys=Dcm_MainFunction
    provided-client-server-entrys:
      6 x bsw module client server entry, all with is-reentrant=true, is-synchronous=true:
        pDcm_StartOfReception: encapsulated-entry=Dcm_StartOfReception
        pDcm_CopyRxData: encapsulated-entry=Dcm_CopyRxData
        pDcm_TpRxIndication: encapsulated-entry=Dcm_TpRxIndication
        pDcm_CopyTxData: encapsulated-entry=Dcm_CopyTxData
        pDcm_TpTxConfirmation: encapsulated-entry=Dcm_TpTxConfirmation
        pDcm_TxConfirmation: encapsulated-entry=Dcm_TxConfirmation
    bsw internal behavior IB_Dcm
      exclusive area ExclusiveArea
      6 x bsw called entity:
        CE_Dcm_StartOfReception: implemented-entry=Dcm_StartOfReception
        CE_Dcm_CopyRxData: implemented-entry=Dcm_CopyRxData
        CE_Dcm_TpRxIndication: implemented-entry=Dcm_TpRxIndication
        CE_Dcm_CopyTxData: implemented-entry=Dcm_CopyTxData
        CE_Dcm_TpTxConfirmation: implemented-entry=Dcm_TpTxConfirmation
        CE_Dcm_TxConfirmation: implemented-entry=Dcm_TxConfirmation
      bsw schedulable entity SE_Dcm_MainFunction: reentrancy-level=NON-REENTRANT, implemented-entry=Dcm_MainFunction
      bsw timing event TE_Dcm_MainFunction: starts-on-event=SE_Dcm_MainFunction, period=0.005
      6 x bsw operation invoked event:
        OIE_Dcm_StartOfReception: category=DIRECT_SEQUENCE, starts-on-event=CE_Dcm_StartOfReception, entry=pDcm_StartOfReception
        OIE_Dcm_CopyRxData: category=DIRECT_SEQUENCE, starts-on-event=CE_Dcm_CopyRxData, entry=pDcm_CopyRxData
        OIE_Dcm_TpRxIndication: category=DIRECT_SEQUENCE, starts-on-event=CE_Dcm_TpRxIndication, entry=pDcm_TpRxIndication
        OIE_Dcm_CopyTxData: category=DIRECT_SEQUENCE, starts-on-event=CE_Dcm_CopyTxData, entry=pDcm_CopyTxData
        OIE_Dcm_TpTxConfirmation: starts-on-event=CE_Dcm_TpTxConfirmation, entry=pDcm_TpTxConfirmation
        OIE_Dcm_TxConfirmation: category=DIRECT_SEQUENCE, starts-on-event=CE_Dcm_TxConfirmation, entry=pDcm_TxConfirmation
      bsw scheduler name prefix Prefix_Dcm_
      bsw distinguished partition Dcm_EcucPartition
package /AUTOSAR/BswImplementations
  bsw implementation Imp_Dcm: programming-language=C, sw-version=2.1.2, vendor-id=62, ar-release-version=4.2.2, behavior=IB_Dcm
    code-descriptors:
      code code_0: artifact-descriptors=autosar-engineering-object={short-label=ComStack_Types.h, category=SWHDR}
package /AUTOSAR/BswInterfaces
  7 x bsw module entry, all with is-synchronous=true, sw-service-impl-policy=STANDARD:
    Dcm_MainFunction: call-type=SCHEDULED, execution-context=TASK
    Dcm_StartOfReception: service-id=70, is-reentrant=true, call-type=CALLBACK, execution-context=UNSPECIFIED
      return type ret: direction=OUT, implementation-data-type=BufReq_ReturnType
      4 x sw service arg, all with category=TYPE_REFERENCE:
        id: direction=IN, implementation-data-type=PduIdType
        info: direction=INOUT, implementation-data-type=PduInfoType, sw-impl-policy=CONST
        TpSduLength: direction=IN, implementation-data-type=PduLengthType
        bufferSizePtr: direction=OUT, implementation-data-type=PduLengthType
    Dcm_CopyRxData: service-id=68, is-reentrant=true, call-type=CALLBACK, execution-context=UNSPECIFIED
      return type ret: direction=OUT, implementation-data-type=BufReq_ReturnType
      sw service arg id: direction=IN, implementation-data-type=PduIdType
      sw service arg info: direction=INOUT, implementation-data-type=PduInfoType, sw-impl-policy=CONST
      sw service arg bufferSizePtr: direction=OUT, implementation-data-type=PduLengthType
    Dcm_TpRxIndication: service-id=69, is-reentrant=true, call-type=CALLBACK, execution-context=UNSPECIFIED
      sw service arg id: direction=IN, implementation-data-type=PduIdType
      sw service arg result: direction=IN, implementation-data-type=Std_ReturnType
    Dcm_CopyTxData: service-id=67, is-reentrant=true, call-type=CALLBACK, execution-context=UNSPECIFIED
      return type ret: direction=OUT, implementation-data-type=BufReq_ReturnType
      4 x sw service arg, all with category=TYPE_REFERENCE:
        id: direction=IN, implementation-data-type=PduIdType
        info: direction=INOUT, implementation-data-type=PduInfoType, sw-impl-policy=CONST
        retry: direction=INOUT, implementation-data-type=RetryInfoType, sw-impl-policy=CONST
        availableDataPtr: direction=OUT, implementation-data-type=PduLengthType
    Dcm_TpTxConfirmation: service-id=72, is-reentrant=true, call-type=CALLBACK, execution-context=UNSPECIFIED
      sw service arg id: direction=IN, implementation-data-type=PduIdType
      sw service arg result: direction=IN, implementation-data-type=Std_ReturnType
    Dcm_TxConfirmation: service-id=64, call-type=REGULAR, execution-context=UNSPECIFIED
      sw service arg id: direction=IN, implementation-data-type=PduIdType
