AUTOSAR XML (schema 00048)
package /AUTOSAR/BswImplementations
  bsw implementation Imp_BswM: programming-language=C, sw-version=1.0.0, vendor-id=62, ar-release-version=1.0.0, behavior=IB_BswM
package /AUTOSAR/BswInterfaces
  bsw module entry BswM_MainFunction: service-id=3, is-reentrant=true, is-synchronous=true, call-type=SCHEDULED, execution-context=TASK, sw-service-impl-policy=STANDARD
package /AUTOSAR/BswOverviews
  bsw module description BswM: implemented-entrys=BswM_MainFunction
    bsw internal behavior IB_BswM
      bsw schedulable entity SE_BswM_Mainfunction: reentrancy-level=MULTICORE-REENTRANT, implemented-entry=BswM_MainFunction
      bsw timing event TE_BswM_MainFunction: starts-on-event=SE_BswM_Mainfunction, period=0.01
