AUTOSAR XML (schema 00048)
package /AUTOSAR/BswOverviews
  bsw module description CanSM: category=BSW_MODULE, implemented-entrys=CanSM_MainFunction, module-id=140
    bsw internal behavior CanSMBehavior
      exclusive area Context
      bsw schedulable entity CanSM_MainFunction: implemented-entry=CanSM_MainFunction
      bsw timing event TimingEvent_MainFunction: starts-on-event=CanSM_MainFunction, period=0.001
package /AUTOSAR/BswImplementations
  bsw implementation CanSMImplementation: programming-language=C, sw-version=1.0.0, vendor-id=62, ar-release-version=1.0.0, behavior=CanSMBehavior
    code-descriptors:
      code Code: artifact-descriptors=autosar-engineering-object={short-label=Label, category=Category}
package /AUTOSAR/BswInterfaces
  bsw module entry CanSM_MainFunction: service-id=5, is-synchronous=true, call-type=SCHEDULED, execution-context=TASK, sw-service-impl-policy=STANDARD
