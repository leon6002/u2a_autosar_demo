AUTOSAR XML (schema 00048)
package /AUTOSAR/BswOverviews
  bsw module description EcuM: implemented-entrys=EcuM_MainFunction
    bsw internal behavior IB_EcuM
      exclusive area WkEv
      exclusive area GlobalClock
      bsw schedulable entity SE_EcuM_MainFunction: reentrancy-level=MULTICORE-REENTRANT, implemented-entry=EcuM_MainFunction
      bsw timing event TE_EcuM_MainFunction: starts-on-event=SE_EcuM_MainFunction, period=0.01
package /AUTOSAR/BswImplementations
  bsw implementation Imp_EcuM: programming-language=C, sw-version=62, vendor-id=10, ar-release-version=1.0.0, behavior=IB_EcuM
package /AUTOSAR/BswInterfaces
  bsw module entry EcuM_MainFunction: service-id=3, is-reentrant=true, is-synchronous=true, call-type=SCHEDULED, execution-context=TASK, sw-service-impl-policy=STANDARD
