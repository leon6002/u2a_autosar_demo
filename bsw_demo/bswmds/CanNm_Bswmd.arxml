AUTOSAR XML (schema 00048)
package /AUTOSAR/BswOverviews
  bsw module description CanNm: category=BSW_MODULE, implemented-entrys=CanNm_MainFunction, module-id=80  # CanNm Driver
    provided-client-server-entrys:
      bsw module client server entry pCanNm_NetworkRequest: encapsulated-entry=CanNm_NetworkRequest
      bsw module client server entry pCanNm_NetworkRelease: encapsulated-entry=CanNm_NetworkRelease, is-synchronous=false
    bsw internal behavior CanNmBehavior
      exclusive area PnEiraCalc
      exclusive area Context
      bsw schedulable entity CanNm_MainFunction: implemented-entry=CanNm_MainFunction
      bsw called entity CanNm_NetworkRequest: implemented-entry=CanNm_NetworkRequest
      bsw called entity CanNm_NetworkRelease: implemented-entry=CanNm_NetworkRelease
      bsw timing event TimingEvent_MainFunction: starts-on-event=CanNm_MainFunction, period=0.005
      bsw operation invoked event OperationInvokedEvent_NetworkRequest: starts-on-event=CanNm_NetworkRequest, entry=pCanNm_NetworkRequest
      bsw operation invoked event OperationInvokedEvent_NetworkRelease: starts-on-event=CanNm_NetworkRelease, entry=pCanNm_NetworkRelease
package /AUTOSAR/BswImplementations
  bsw implementation CanNmImplementation: programming-language=C, sw-version=1.0.0, vendor-id=62, ar-release-version=1.0.0, behavior=CanNmBehavior
    code-descriptors:
      code Code: artifact-descriptors=autosar-engineering-object={short-label=Label, category=Category}
    resource consumption resourceConsumption
package /AUTOSAR/BswInterfaces
  bsw module entry CanNm_MainFunction: service-id=19, is-synchronous=true, call-type=SCHEDULED, execution-context=TASK, sw-service-impl-policy=STANDARD
  bsw module entry CanNm_NetworkRequest: service-id=2, is-reentrant=false, is-synchronous=true, call-type=REGULAR, execution-context=TASK, sw-service-impl-policy=STANDARD
    return type retval: direction=OUT, implementation-data-type=Std_ReturnType
    sw service arg nmChannelHandle: direction=IN, implementation-data-type=NetworkHandleType
  bsw module entry CanNm_NetworkRelease: service-id=3, is-synchronous=true, call-type=REGULAR, execution-context=TASK, sw-service-impl-policy=STANDARD
    return type retval: direction=OUT, implementation-data-type=Std_ReturnType
    sw service arg nmChannelHandle: direction=IN, implementation-data-type=NetworkHandleType
