AUTOSAR XML (schema 00048)
package /AUTOSAR/BswOverviews
  bsw module description PduR: module-id=51, provided-entrys=PduR_Init
    bsw internal behavior IB_PduR
      exclusive area ExclusiveArea_Route
      exclusive area ExclusiveArea_Group
package /AUTOSAR/BswImplementations
  bsw implementation Imp_PduR: programming-language=C, sw-version=2.2.0, vendor-id=62, ar-release-version=4.5.0, behavior=IB_PduR
package /AUTOSAR/BswInterfaces
  bsw module entry PduR_Init: service-id=240, is-synchronous=true, call-type=REGULAR, execution-context=UNSPECIFIED, sw-service-impl-policy=STANDARD
