AUTOSAR XML (schema 00048)
package /AUTOSAR/BswOverviews
  bsw module description Nm: category=BSW_MODULE, implemented-entrys=Nm_MainFunction, module-id=29
    bsw internal behavior NmBehavior
      exclusive area Coordinator
      exclusive area IRA
      bsw schedulable entity Nm_MainFunction: implemented-entry=Nm_MainFunction
      bsw timing event TimingEvent_MainFunction: starts-on-event=Nm_MainFunction, period=0.0
package /AUTOSAR/BswImplementations
  bsw implementation NmImplementation: programming-language=C, sw-version=1.0.0, vendor-id=62, ar-release-version=1.0.0, behavior=NmBehavior
    code-descriptors:
      code Code: artifact-descriptors=autosar-engineering-object={short-label=Label, category=Category}
    resource consumption resourceConsumption
package /AUTOSAR/BswInterfaces
  bsw module entry Nm_MainFunction: service-id=16, is-synchronous=true, call-type=SCHEDULED, execution-context=TASK, sw-service-impl-policy=STANDARD
