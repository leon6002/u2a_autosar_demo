AUTOSAR XML (schema 00048)
package /AUTOSAR/BswOverviews
  bsw module description Det: category=BSW_MODULE, module-id=34  # Det Driver
    bsw internal behavior IB_Det
      exclusive area LogError
      bsw distinguished partition Det_EcucPartition
package /AUTOSAR/BswImplementations
  bsw implementation Imp_Det: programming-language=C, sw-version=1.0.0, vendor-id=62, ar-release-version=1.0.0, behavior=IB_Det, vendor-api-infix=abc
    code-descriptors:
      code Code: artifact-descriptors=autosar-engineering-object={short-label=ComStack_Types.h, category=SWHDR}
