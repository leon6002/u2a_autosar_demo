AUTOSAR XML (schema 00048)
package /RH850U2A16
  module config Dem
    DemGeneral:
      DemAgingRequieresTestedCycle = true
      DemAvailabilitySupport = DEM_EVENT_AVAILABILITY
      DemClearDTCBehavior = DEM_CLRRESP_NONVOLATILE_FINISH
      DemClearDTCLimitation = DEM_ALL_SUPPORTED_DTCS
      DemDataElementDefaultEndianness = BIG_ENDIAN
      DemDebounceCounterBasedSupport = true
      DemDebounceTimeBasedSupport = true
      DemDevErrorDetect = true
      DemEventCombinationSupport = DEM_EVCOMB_DISABLED
      DemGeneralInterfaceSupport = false
      DemMaxNumberPrestoredFF = 0
      DemOBDSupport = DEM_OBD_NO_OBD_SUPPORT
      DemOperationCycleStatusStorage = false
      DemPTOSupport = false
      DemResetConfirmedBitOnOverflow = true
      DemStatusBitHandlingTestFailedSinceLastClear = DEM_STATUS_BIT_NORMAL
      DemStatusBitStorageTestFailed = false
      DemSuppressionSupport = DEM_DTC_SUPPRESSION
      DemTaskTime = 0.01
      DemTriggerDcmReports = false
      DemTriggerDltReports = false
      DemTriggerFiMReports = false
      DemTriggerMonitorInitBeforeClearOk = false
      DemVersionInfoApi = false
      DemEnableSoftFilterOfPass = false
      DemNvRAMDivaded = false
      DemBswErrorBufferSize = 3
      DemAgingRequiresNotFailedCycle = true
      DemConfigType = PC_CONFIG
      DEMPOWER (DemOperationCycle): DemOperationCycleAutomaticEnd=false, DemOperationCycleAutostart=true, DemOperationCycleId=0, DemOperationCycleType=DEM_OPCYC_IGNITION
      DidClass_0x0110 (DemDidClass): DemDidIdentifier=272, DemDidDataElementClassRef=DataElementClass_DID_0x0110_Data
      DataElementClass_DID_0x0110_Data (DemDataElementClass)
        ExternalCSDataElementClass_DID_0x0110_Data (DemExternalCSDataElementClass):
          DemDataElementReadFnc = Rte_Call_CS_DataServices_DataElementClass_DID_0x0110_Data_ReadData
          DemDataElementUsePort = true
          DemDataElementArraySize = 1
          DemDataElementDataType = UINT8_N
          DemDataElementProvideMonitorData = false
      DidClass_0x0111 (DemDidClass): DemDidIdentifier=273, DemDidDataElementClassRef=DataElementClass_DID_0x0111_Data
      DataElementClass_DID_0x0111_Data (DemDataElementClass)
        ExternalCSDataElementClass_DID_0x0111_Data (DemExternalCSDataElementClass):
          DemDataElementReadFnc = Rte_Call_CS_DataServices_DataElementClass_DID_0x0111_Data_ReadData
          DemDataElementUsePort = true
          DemDataElementArraySize = 3
          DemDataElementDataType = UINT8_N
          DemDataElementProvideMonitorData = false
      ExtendedDataClass_DTCExtendedDataRecordNumber (DemExtendedDataClass):
        DemExtendedDataRecordClassRef = ExtendedDataRecordClass_0x000001
        DemExtendedDataRecordClassRef = ExtendedDataRecordClass_0x{000003..000008}
      ExtendedDataRecordClass_0x000001 (DemExtendedDataRecordClass):
        DemExtendedDataRecordNumber = 1
        DemExtendedDataRecordTrigger = DEM_TRIGGER_ON_TEST_FAILED
        DemExtendedDataRecordUpdate = DEM_UPDATE_RECORD_YES
        DemDataElementClassRef = DemDataElementClass_FailedCycles
        DemDataElementClassRef = DemDataElementClass_OccurrenceCounter
      DataElementClass_AgeingCounter (DemDataElementClass)
        DemInternalDataElementClass_AgeingCounter (DemInternalDataElementClass): DemDataElementDataSize=1, DemInternalDataElement=DEM_AGINGCTR_UPCNT
      DemFreezeFrameRecNumClass_01 (DemFreezeFrameRecNumClass): DemFreezeFrameRecordClassRef=DemFreezeFrameRecordClass_01, DemFreezeFrameRecordClassRef=DemFreezeFrameRecordClass_02
      DemFreezeFrameRecordClass_01 (DemFreezeFrameRecordClass): DemFreezeFrameRecordNumber=1, DemFreezeFrameRecordTrigger=DEM_TRIGGER_ON_TEST_FAILED, DemFreezeFrameRecordUpdate=DEM_UPDATE_RECORD_YES
      FreezeFrameClass_ENVDATA (DemFreezeFrameClass): DemDidClassRef=DidClass_0x0110, DemDidClassRef=DidClass_0x0111
      3 x DemEnableCondition, all with DemEnableConditionStatus=true:
        DemEnableCondition_UnequalDriveMode: DemEnableConditionId=0
        DemEnableCondition_9VTp16V: DemEnableConditionId=1
        DemEnableCondition_DiagEnable3000ms: DemEnableConditionId=2
      DemEnableConditionGroup_0 (DemEnableConditionGroup):
        DemEnableConditionRef = DemEnableCondition_UnequalDriveMode
        DemEnableConditionRef = DemEnableCondition_9VTp16V
        DemEnableConditionRef = DemEnableCondition_DiagEnable3000ms
      DemFreezeFrameRecordClass_02 (DemFreezeFrameRecordClass): DemFreezeFrameRecordNumber=2, DemFreezeFrameRecordTrigger=DEM_TRIGGER_ON_TEST_FAILED, DemFreezeFrameRecordUpdate=DEM_UPDATE_RECORD_NO
      7 x DemDataElementClass:
        DemDataElementClass_CurrentFDC
          DemInternalDataElementClass_CurrentFDC (DemInternalDataElementClass): DemDataElementDataSize=1, DemInternalDataElement=DEM_CURRENT_FDC
        DemDataElementClass_CyclesFirstFailed
          DemInternalDataElementClass_CyclesFirstFailed (DemInternalDataElementClass): DemDataElementDataSize=1, DemInternalDataElement=DEM_CYCLES_SINCE_FIRST_FAILED
        DemDataElementClass_CyclesLastFailed
          DemInternalDataElementClass_CyclesLastFailed (DemInternalDataElementClass): DemDataElementDataSize=1, DemInternalDataElement=DEM_CYCLES_SINCE_LAST_FAILED
        DemDataElementClass_FailedCycles
          DemInternalDataElementClass_FailedCycles (DemInternalDataElementClass): DemDataElementDataSize=1, DemInternalDataElement=DEM_FAILED_CYCLES
        DemDataElementClass_MAXFDCCurrentCycle
          DemInternalDataElementClass_MAXFDCCurrentCycle (DemInternalDataElementClass): DemDataElementDataSize=1, DemInternalDataElement=DEM_MAX_FDC_DURING_CURRENT_CYCLE
        DemDataElementClass_MAXFDCLastClear
          DemInternalDataElementClass_MAXFDCLastClear (DemInternalDataElementClass): DemDataElementDataSize=1, DemInternalDataElement=DEM_MAX_FDC_SINCE_LAST_CLEAR
        DemDataElementClass_OccurrenceCounter
          DemInternalDataElementClass_OccurrenceCounter (DemInternalDataElementClass): DemDataElementDataSize=1, DemInternalDataElement=DEM_OCCCTR
      6 x DemExtendedDataRecordClass, all with DemExtendedDataRecordUpdate=DEM_UPDATE_RECORD_YES:
        ExtendedDataRecordClass_0x000003: DemExtendedDataRecordNumber=3, DemExtendedDataRecordTrigger=DEM_TRIGGER_ON_TEST_FAILED, DemDataElementClassRef=DemDataElementClass_CyclesFirstFailed
        ExtendedDataRecordClass_0x000004: DemExtendedDataRecordNumber=4, DemExtendedDataRecordTrigger=DEM_TRIGGER_ON_TEST_FAILED, DemDataElementClassRef=DemDataElementClass_CyclesLastFailed
        ExtendedDataRecordClass_0x000005: DemExtendedDataRecordNumber=5, DemExtendedDataRecordTrigger=DEM_TRIGGER_ON_TEST_FAILED, DemDataElementClassRef=DataElementClass_AgeingCounter
        ExtendedDataRecordClass_0x000006: DemExtendedDataRecordNumber=6, DemExtendedDataRecordTrigger=DEM_TRIGGER_ON_FDC_THRESHOLD, DemDataElementClassRef=DemDataElementClass_MAXFDCCurrentCycle
        ExtendedDataRecordClass_0x000007: DemExtendedDataRecordNumber=7, DemExtendedDataRecordTrigger=DEM_TRIGGER_ON_FDC_THRESHOLD, DemDataElementClassRef=DemDataElementClass_MAXFDCLastClear
        ExtendedDataRecordClass_0x000008: DemExtendedDataRecordNumber=8, DemExtendedDataRecordTrigger=DEM_TRIGGER_ON_FDC_THRESHOLD, DemDataElementClassRef=DemDataElementClass_CurrentFDC
      DemClient: DemClientFunctionality=DEM_CLIENT_USES_FULL_FUNCTIONALITY, DemClientId=0, DemClientUsesRte=false
      DemEventMemorySet: DemMaxNumberEventEntryPermanent=1, DemTypeOfDTCSupported=DEM_DTC_TRANSLATION_ISO14229_1
        DemPrimaryMemory:
          DemDtcStatusAvailabilityMask = 127
          DemEnvironmentDataCapture = DEM_CAPTURE_ASYNCHRONOUS_TO_REPORTING
          DemEventDisplacementStrategy = DEM_DISPLACEMENT_FULL
          DemEventMemoryEntryStorageTrigger = DEM_TRIGGER_ON_FDC_THRESHOLD
          DemMaxNumberEventEntryPrimary = 17
          DemOccurrenceCounterProcessing = DEM_PROCESS_OCCCTR_TF
          DemOperationCycleStatusStorage = false
          DemTypeOfFreezeFrameRecordNumeration = DEM_FF_RECNUM_CONFIGURED
      DemNvRamBlockId_All_EventEntry (DemNvRamBlockId): DemNvRamBlockIdRef=NvMBlock_All_EventEntry
      DemNvRamBlockId_UDS_InternalData (DemNvRamBlockId): DemNvRamBlockIdRef=NvMBlock_UDS_InternalData
    DemConfigSet
      EventParameter_0xC07388 (DemEventParameter):
        DemEventAvailable = true
        DemEventFailureCycleCounterThreshold = 0
        DemEventId = 1
        DemEventKind = DEM_EVENT_KIND_BSW
        DemFFPrestorageSupported = false
        DemReportBehavior = REPORT_BEFORE_INIT
        DemOperationCycleRef = DEMPOWER
        DemDTCRef = DTC_0xC07388
        DemEnableConditionGroupRef = DemEnableConditionGroup_0
        DemDebounceAlgorithmClass
          DebounceCounterBased_0xC07388 (DemDebounceCounterBased): DemDebounceCounterBasedClassRef=DemDebounceCounterBasedClass_Up10Down1
      DTC_0xC07388 (DemDTC): DemDtcValue=12612488, DemDTCSeverity=DEM_SEVERITY_NO_SEVERITY, DemDTCFunctionalUnit=255, DemDTCAttributesRef=DTCAttributes_P1Aged_FDC13
      DTC_0xC18787 (DemDTC): DemDtcValue=12683143, DemDTCSeverity=DEM_SEVERITY_NO_SEVERITY, DemDTCFunctionalUnit=255, DemDTCAttributesRef=DTCAttributes_P1Aged_FDC26
      EventParameter_0xC18787 (DemEventParameter):
        DemEventAvailable = true
        DemEventFailureCycleCounterThreshold = 0
        DemEventId = 2
        DemEventKind = DEM_EVENT_KIND_SWC
        DemFFPrestorageSupported = false
        DemOperationCycleRef = DEMPOWER
        DemDTCRef = DTC_0xC18787
        DemEnableConditionGroupRef = DemEnableConditionGroup_0
        DemDebounceAlgorithmClass
          DebounceCounterBased_0xC18787 (DemDebounceCounterBased): DemDebounceCounterBasedClassRef=DemDebounceCounterBasedClass_Up5Down1
      DemDebounceCounterBasedClass_Up10Down1 (DemDebounceCounterBasedClass):
        DemDebounceBehavior = DEM_DEBOUNCE_RESET
        DemDebounceCounterDecrementStepSize = 128
        DemDebounceCounterFailedThreshold = 127
        DemDebounceCounterIncrementStepSize = 13
        DemDebounceCounterJumpDown = true
        DemDebounceCounterJumpDownValue = 0
        DemDebounceCounterJumpUp = true
        DemDebounceCounterJumpUpValue = 0
        DemDebounceCounterPassedThreshold = -128
        DemDebounceCounterStorage = false
      DTCAttributes_P1Aged_FDC26 (DemDTCAttributes):
        DemAgingAllowed = true
        DemDTCPriority = 1
        DemDTCSignificance = DEM_EVENT_SIGNIFICANCE_FAULT
        DemImmediateNvStorage = false
        DemAgingCycleCounterThreshold = 40
        DemEventMemoryEntryFdcThresholdStorageValue = 26
        DemMemoryDestinationRef = DemPrimaryMemory
        DemAgingCycleRef = DEMPOWER
        DemFreezeFrameRecNumClassRef = DemFreezeFrameRecNumClass_01
        DemFreezeFrameClassRef = FreezeFrameClass_ENVDATA
        DemExtendedDataClassRef = ExtendedDataClass_DTCExtendedDataRecordNumber
      DemDebounceCounterBasedClass_Up5Down1 (DemDebounceCounterBasedClass):
        DemDebounceBehavior = DEM_DEBOUNCE_RESET
        DemDebounceCounterDecrementStepSize = 128
        DemDebounceCounterFailedThreshold = 127
        DemDebounceCounterIncrementStepSize = 26
        DemDebounceCounterJumpDown = true
        DemDebounceCounterJumpDownValue = 0
        DemDebounceCounterJumpUp = true
        DemDebounceCounterJumpUpValue = 0
        DemDebounceCounterPassedThreshold = -128
        DemDebounceCounterStorage = false
      5 x DemDTCAttributes, all with DemDTCSignificance=DEM_EVENT_SIGNIFICANCE_FAULT, DemImmediateNvStorage=false, DemMemoryDestinationRef=DemPrimaryMemory, DemFreezeFrameRecNumClassRef=DemFreezeFrameRecNumClass_01, DemFreezeFrameClassRef=FreezeFrameClass_ENVDATA, DemExtendedDataClassRef=ExtendedDataClass_DTCExtendedDataRecordNumber:
        DTCAttributes_P1Aged_FDC13: DemAgingAllowed=true, DemDTCPriority=1, DemAgingCycleCounterThreshold=40, DemEventMemoryEntryFdcThresholdStorageValue=13, DemAgingCycleRef=DEMPOWER
        DTCAttributes_P1NoAged_FDC8: DemAgingAllowed=false, DemDTCPriority=1, DemEventMemoryEntryFdcThresholdStorageValue=8
        DTCAttributes_P2Aged_FDC1: DemAgingAllowed=true, DemDTCPriority=2, DemAgingCycleCounterThreshold=40, DemEventMemoryEntryFdcThresholdStorageValue=1, DemAgingCycleRef=DEMPOWER
        DTCAttributes_P3Aged_FDC6: DemAgingAllowed=true, DemDTCPriority=3, DemAgingCycleCounterThreshold=40, DemEventMemoryEntryFdcThresholdStorageValue=6, DemAgingCycleRef=DEMPOWER
        DTCAttributes_P4Aged_FDC43: DemAgingAllowed=true, DemDTCPriority=4, DemAgingCycleCounterThreshold=40, DemEventMemoryEntryFdcThresholdStorageValue=43, DemAgingCycleRef=DEMPOWER
      15 x DemDTC, all with DemDTCSeverity=DEM_SEVERITY_NO_SEVERITY, DemDTCFunctionalUnit=255:
        DTC_0xC10001: DemDtcValue=12648449, DemDTCAttributesRef=DTCAttributes_P1NoAged_FDC8
        DTC_0xC10002: DemDtcValue=12648450, DemDTCAttributesRef=DTCAttributes_P1NoAged_FDC8
        DTC_0xC10003: DemDtcValue=12648451, DemDTCAttributesRef=DTCAttributes_P1NoAged_FDC8
        DTC_0xC10004: DemDtcValue=12648452, DemDTCAttributesRef=DTCAttributes_P2Aged_FDC1
        DTC_0xC10005: DemDtcValue=12648453, DemDTCAttributesRef=DTCAttributes_P2Aged_FDC1
        DTC_0xC10006: DemDtcValue=12648454, DemDTCAttributesRef=DTCAttributes_P2Aged_FDC1
        DTC_0xC10007: DemDtcValue=12648455, DemDTCAttributesRef=DTCAttributes_P2Aged_FDC1
        DTC_0xC10008: DemDtcValue=12648456, DemDTCAttributesRef=DTCAttributes_P2Aged_FDC1
        DTC_0xC10009: DemDtcValue=12648457, DemDTCAttributesRef=DTCAttributes_P3Aged_FDC6
        DTC_0xC1000A: DemDtcValue=12648458, DemDTCAttributesRef=DTCAttributes_P3Aged_FDC6
        DTC_0xC1000B: DemDtcValue=12648459, DemDTCAttributesRef=DTCAttributes_P3Aged_FDC6
        DTC_0xC1000C: DemDtcValue=12648460, DemDTCAttributesRef=DTCAttributes_P3Aged_FDC6
        DTC_0xC1000D: DemDtcValue=12648461, DemDTCAttributesRef=DTCAttributes_P4Aged_FDC43
        DTC_0xC1000E: DemDtcValue=12648462, DemDTCAttributesRef=DTCAttributes_P4Aged_FDC43
        DTC_0xC1000F: DemDtcValue=12648463, DemDTCAttributesRef=DTCAttributes_P4Aged_FDC43
      DemDebounceCounterBasedClass_Up32Down32 (DemDebounceCounterBasedClass):
        DemDebounceBehavior = DEM_DEBOUNCE_RESET
        DemDebounceCounterDecrementStepSize = 4
        DemDebounceCounterFailedThreshold = 127
        DemDebounceCounterIncrementStepSize = 4
        DemDebounceCounterJumpDown = true
        DemDebounceCounterJumpDownValue = 0
        DemDebounceCounterJumpUp = true
        DemDebounceCounterJumpUpValue = 0
        DemDebounceCounterPassedThreshold = -128
        DemDebounceCounterStorage = false
      DemDebounceTimeBaseClass_Fail2000Pass2000 (DemDebounceTimeBaseClass): DemDebounceBehavior=DEM_DEBOUNCE_RESET, DemDebounceTimeFailedThreshold=2.0, DemDebounceTimePassedThreshold=2.0
      DemDebounceCounterBasedClass_Up20Down3 (DemDebounceCounterBasedClass):
        DemDebounceBehavior = DEM_DEBOUNCE_RESET
        DemDebounceCounterDecrementStepSize = 43
        DemDebounceCounterFailedThreshold = 20
        DemDebounceCounterIncrementStepSize = 1
        DemDebounceCounterJumpDown = true
        DemDebounceCounterJumpDownValue = 0
        DemDebounceCounterJumpUp = true
        DemDebounceCounterJumpUpValue = 0
        DemDebounceCounterPassedThreshold = -128
        DemDebounceCounterStorage = false
      DemDebounceCounterBasedClass_Up3Down1 (DemDebounceCounterBasedClass):
        DemDebounceBehavior = DEM_DEBOUNCE_RESET
        DemDebounceCounterDecrementStepSize = 128
        DemDebounceCounterFailedThreshold = 127
        DemDebounceCounterIncrementStepSize = 43
        DemDebounceCounterJumpDown = true
        DemDebounceCounterJumpDownValue = 0
        DemDebounceCounterJumpUp = true
        DemDebounceCounterJumpUpValue = 0
        DemDebounceCounterPassedThreshold = -128
        DemDebounceCounterStorage = false
      15 x DemEventParameter, all with DemEventAvailable=true, DemEventFailureCycleCounterThreshold=0, DemEventKind=DEM_EVENT_KIND_SWC, DemFFPrestorageSupported=false, DemOperationCycleRef=DEMPOWER, DemEnableConditionGroupRef=DemEnableConditionGroup_0:
        EventParameter_0xC10001: DemEventId=3, DemDTCRef=DTC_0xC10001
          DemDebounceAlgorithmClass
            DemDebounceCounterBased: DemDebounceCounterBasedClassRef=DemDebounceCounterBasedClass_Up32Down32
        EventParameter_0xC10002: DemEventId=4, DemDTCRef=DTC_0xC10002
          DemDebounceAlgorithmClass
            DemDebounceCounterBased: DemDebounceCounterBasedClassRef=DemDebounceCounterBasedClass_Up32Down32
        EventParameter_0xC10003: DemEventId=5, DemDTCRef=DTC_0xC10003
          DemDebounceAlgorithmClass
            DemDebounceCounterBased: DemDebounceCounterBasedClassRef=DemDebounceCounterBasedClass_Up32Down32
        EventParameter_0xC10004: DemEventId=6, DemDTCRef=DTC_0xC10004
          DemDebounceAlgorithmClass
            DemDebounceTimeBase: DemDebounceTimeBaseRef=DemDebounceTimeBaseClass_Fail2000Pass2000
        EventParameter_0xC10005: DemEventId=7, DemDTCRef=DTC_0xC10005
          DemDebounceAlgorithmClass
            DemDebounceTimeBase: DemDebounceTimeBaseRef=DemDebounceTimeBaseClass_Fail2000Pass2000
        EventParameter_0xC10006: DemEventId=8, DemDTCRef=DTC_0xC10006
          DemDebounceAlgorithmClass
            DemDebounceTimeBase: DemDebounceTimeBaseRef=DemDebounceTimeBaseClass_Fail2000Pass2000
        EventParameter_0xC10007: DemEventId=9, DemDTCRef=DTC_0xC10007
          DemDebounceAlgorithmClass
            DemDebounceTimeBase: DemDebounceTimeBaseRef=DemDebounceTimeBaseClass_Fail2000Pass2000
        EventParameter_0xC10008: DemEventId=10, DemDTCRef=DTC_0xC10008
          DemDebounceAlgorithmClass
            DemDebounceTimeBase: DemDebounceTimeBaseRef=DemDebounceTimeBaseClass_Fail2000Pass2000
        EventParameter_0xC10009: DemEventId=11, DemDTCRef=DTC_0xC10009
          DemDebounceAlgorithmClass
            DemDebounceCounterBased: DemDebounceCounterBasedClassRef=DemDebounceCounterBasedClass_Up20Down3
        EventParameter_0xC1000A: DemEventId=12, DemDTCRef=DTC_0xC1000A
          DemDebounceAlgorithmClass
            DemDebounceCounterBased: DemDebounceCounterBasedClassRef=DemDebounceCounterBasedClass_Up20Down3
        EventParameter_0xC1000B: DemEventId=13, DemDTCRef=DTC_0xC1000B
          DemDebounceAlgorithmClass
            DemDebounceCounterBased: DemDebounceCounterBasedClassRef=DemDebounceCounterBasedClass_Up20Down3
        EventParameter_0xC1000C: DemEventId=14, DemDTCRef=DTC_0xC1000C
          DemDebounceAlgorithmClass
            DemDebounceCounterBased: DemDebounceCounterBasedClassRef=DemDebounceCounterBasedClass_Up20Down3
        EventParameter_0xC1000D: DemEventId=15, DemDTCRef=DTC_0xC1000D
          DemDebounceAlgorithmClass
            DemDebounceCounterBased: DemDebounceCounterBasedClassRef=DemDebounceCounterBasedClass_Up3Down1
        EventParameter_0xC1000E: DemEventId=16, DemDTCRef=DTC_0xC1000E
          DemDebounceAlgorithmClass
            DemDebounceCounterBased: DemDebounceCounterBasedClassRef=DemDebounceCounterBasedClass_Up3Down1
        EventParameter_0xC1000F: DemEventId=17, DemDTCRef=DTC_0xC1000F
          DemDebounceAlgorithmClass
            DemDebounceCounterBased: DemDebounceCounterBasedClassRef=DemDebounceCounterBasedClass_Up3Down1
