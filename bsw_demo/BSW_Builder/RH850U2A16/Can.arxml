AUTOSAR XML (schema 00048)
package /RH850U2A16
  module config Can: implementation-config-variant=VARIANT-POST-BUILD, module-description=Can_Impl
    CanConfigSet0 (CanConfigSet):
      CanControllerMainClockImmediateValue = 20000000
      CanControllerPplClockImmediateValue = 80000000
      CanControllerPclkClockImmediateValue = 80000000
      CanControllerMainClock = McuRCANClk
      CanControllerPclkClock = McuHighSpeedPeriClk
      CanControllerPplClock = McuHighSpeedPeriClk
      11 x CanHardwareObject, all with CanHwObjectCount=1, CanIdType=STANDARD, CanTriggerTransmitEnable=false, CanHardwareObjectUsesPolling=false, CanControllerRef=CanController_CAN0:
        CanHardwareObject_CAN0_Tx_0x501_NM_ECU: CanHandleType=FULL, CanObjectId=11, CanObjectType=TRANSMIT, CanMemoryMode=BUFFER_MODE, CanObjectPayloadLength=CAN_OBJECT_PL_64
        CanHardwareObject_CAN0_Tx_0x709_Diag_Phy_Response: CanHandleType=FULL, CanObjectId=12, CanObjectType=TRANSMIT, CanMemoryMode=BUFFER_MODE, CanObjectPayloadLength=CAN_OBJECT_PL_64
        CanHardwareObject_CAN0_Tx_0x302_Mixed: CanHandleType=FULL, CanObjectId=6, CanObjectType=TRANSMIT, CanMemoryMode=BUFFER_MODE, CanObjectPayloadLength=CAN_OBJECT_PL_64
        CanHardwareObject_CAN0_Tx_0x351_Cyclic_PN29: CanHandleType=FULL, CanObjectId=9, CanObjectType=TRANSMIT, CanMemoryMode=BUFFER_MODE, CanObjectPayloadLength=CAN_OBJECT_PL_64
        CanHardwareObject_CAN0_Tx_0x360_E2E_P01: CanHandleType=FULL, CanObjectId=10, CanObjectType=TRANSMIT, CanMemoryMode=BUFFER_MODE, CanObjectPayloadLength=CAN_OBJECT_PL_64
        CanHardwareObject_CAN0_Tx_0x303_Cyclic_Counter: CanHandleType=FULL, CanObjectId=7, CanObjectType=TRANSMIT, CanMemoryMode=BUFFER_MODE, CanObjectPayloadLength=CAN_OBJECT_PL_64
        CanHardwareObject_CAN0_Tx_0x350_Cyclic_PN17: CanHandleType=FULL, CanObjectId=8, CanObjectType=TRANSMIT, CanMemoryMode=BUFFER_MODE, CanObjectPayloadLength=CAN_OBJECT_PL_64
        CanHardwareObject_CAN0_Tx_0x301_Event: CanHandleType=FULL, CanObjectId=5, CanObjectType=TRANSMIT, CanMemoryMode=BUFFER_MODE, CanObjectPayloadLength=CAN_OBJECT_PL_64
        CanHardwareObject_CAN0_Rx_0x5xx_NM_ECU: CanHandleType=BASIC, CanMemoryMode=RECEIVE_FIFO_MODE, CanObjectId=0, CanObjectType=RECEIVE, CanObjectPayloadLength=CAN_OBJECT_PL_8
          CanHwFilter: CanHwFilterCode=1280, CanHwFilterDLCCheckValue=0, CanHwFilterMask=1792, CanHwFilterReceiveIdType=STANDARD, CanHwFilterSourceNode=FROM_OTHER_NODE
          CanReceiveFIFOConfiguration:
            CanEnableReceiveFIFOInterrupt = true
            CanReceiveFIFOBufferDepth = BUFFER_8
            CanReceiveFIFOPayloadLength = PAYLOAD_8
            CanReceiveFIFOInterruptRatioSel = FIFO_1_BY_8
            CanReceiveFIFOInterruptSrcSel = EACH_MESSAGE
        CanHardwareObject_CAN0_Rx_0x708_Diag_Phy_Request: CanHandleType=FULL, CanMemoryMode=RECEIVE_FIFO_MODE, CanObjectId=2, CanObjectType=RECEIVE, CanObjectPayloadLength=CAN_OBJECT_PL_8
          CanReceiveFIFOConfiguration:
            CanEnableReceiveFIFOInterrupt = true
            CanReceiveFIFOBufferDepth = BUFFER_8
            CanReceiveFIFOPayloadLength = PAYLOAD_8
            CanReceiveFIFOInterruptRatioSel = FIFO_1_BY_8
            CanReceiveFIFOInterruptSrcSel = EACH_MESSAGE
          CanHwFilter: CanHwFilterCode=1800, CanHwFilterDLCCheckValue=0, CanHwFilterMask=2047, CanHwFilterReceiveIdType=STANDARD, CanHwFilterSourceNode=FROM_OTHER_NODE
        CanHardwareObject_CAN0_Rx_0x7df_Diag_Fun_Request: CanHandleType=FULL, CanMemoryMode=RECEIVE_FIFO_MODE, CanObjectId=1, CanObjectType=RECEIVE, CanObjectPayloadLength=CAN_OBJECT_PL_8
          CanReceiveFIFOConfiguration:
            CanEnableReceiveFIFOInterrupt = true
            CanReceiveFIFOBufferDepth = BUFFER_8
            CanReceiveFIFOPayloadLength = PAYLOAD_8
            CanReceiveFIFOInterruptRatioSel = FIFO_1_BY_8
            CanReceiveFIFOInterruptSrcSel = EACH_MESSAGE
          CanHwFilter: CanHwFilterCode=2015, CanHwFilterDLCCheckValue=0, CanHwFilterMask=2047, CanHwFilterReceiveIdType=STANDARD, CanHwFilterSourceNode=FROM_OTHER_NODE
      CanController_CAN0 (CanController):
        CanBusoffProcessing = INTERRUPT
        CanControllerActivation = true
        CanControllerId = 0
        CanRxProcessing = INTERRUPT
        CanTxProcessing = INTERRUPT
        CanWakeupProcessing = POLLING
        CanWakeupSupport = false
        CanEnableTransmitHistoryInterrupt = false
        CanControllerSelection = RSCANFD02
        CanControllerInterfaceMode = CLASSICAL_CAN_ONLY
        CanEnableCanCanFDGateway = false
        CanFDGatewayForwardingFormat = CLASSICAL_CAN_FORMAT
        CanFDGatewayBRSBit = false
        CanControllerBaseAddress = 0
        CanWakeupFunctionalityAPI = false
        CanControllerDefaultBaudrate = CanControllerBaudrateConfig0
        CanCpuClockRef = McuClockReferencePoint
        CanControllerBaudrateConfig0 (CanControllerBaudrateConfig):
          CanControllerBaudRate = 500
          CanControllerBaudRateConfigID = 0
          CanControllerSeg1 = 15
          CanControllerSeg2 = 4
          CanControllerSyncJumpWidth = 1
          CanControllerPropSeg = 0
      4 x CanHardwareObject, all with CanHwObjectCount=1, CanTriggerTransmitEnable=false, CanHardwareObjectUsesPolling=false, CanControllerRef=CanController_CAN0:
        CanHardwareObject_CAN0_Tx_0x300_Cyclic: CanHandleType=FULL, CanIdType=STANDARD, CanObjectId=4, CanObjectType=TRANSMIT, CanMemoryMode=BUFFER_MODE, CanObjectPayloadLength=CAN_OBJECT_PL_64
        CanHardwareObject_CAN0_Rx_COM: CanHandleType=BASIC, CanIdType=STANDARD, CanMemoryMode=RECEIVE_FIFO_MODE, CanObjectId=3, CanObjectType=RECEIVE, CanObjectPayloadLength=CAN_OBJECT_PL_8
          CanReceiveFIFOConfiguration:
            CanEnableReceiveFIFOInterrupt = true
            CanReceiveFIFOBufferDepth = BUFFER_64
            CanReceiveFIFOPayloadLength = PAYLOAD_8
            CanReceiveFIFOInterruptRatioSel = FIFO_1_BY_8
            CanReceiveFIFOInterruptSrcSel = EACH_MESSAGE
          7 x CanHwFilter, all with CanHwFilterDLCCheckValue=0, CanHwFilterMask=2047, CanHwFilterReceiveIdType=STANDARD, CanHwFilterSourceNode=FROM_OTHER_NODE:
            CanHwFilter_0x200: CanHwFilterCode=512
            CanHwFilter_0x201: CanHwFilterCode=513
            CanHwFilter_0x202: CanHwFilterCode=514
            CanHwFilter_0x203: CanHwFilterCode=515
            CanHwFilter_0x250: CanHwFilterCode=592
            CanHwFilter_0x251: CanHwFilterCode=593
            CanHwFilter_0x260: CanHwFilterCode=608
        CanHardwareObject_CAN0_Tx_0x304_Cyclic_Counter: CanHandleType=FULL, CanIdType=STANDARD, CanObjectId=13, CanObjectType=TRANSMIT, CanMemoryMode=BUFFER_MODE, CanObjectPayloadLength=CAN_OBJECT_PL_64
        CanHardwareObject_CAN0_Tx_0x18C4D2D0_Cyclic_Counter: CanHandleType=FULL, CanIdType=EXTENDED, CanObjectId=14, CanObjectType=TRANSMIT, CanMemoryMode=BUFFER_MODE, CanObjectPayloadLength=CAN_OBJECT_PL_64
    Can (CanGeneral):
      CanIndex = 0
      CanMainFunctionModePeriod = 0.005
      CanMultiplexedTransmission = false
      CanTimeoutDuration = 5
      CanVersionInfoApi = false
      CanCriticalSectionProtection = true
      CanVersionCheckExternalModules = false
      CanDeviceName = R7F702300BFABA
      CanAlreadyInitDetCheck = true
      CanInterruptConsistencyCheck = false
      CanIsrCategory = CAT2
      CanEnableClkImmediateValue = true
      CanMultiCoreSupport = false
      CanSetBaudrateApi = false
      CanLPduReceiveCalloutFunction = 
      CanDevErrorDetect = false
      CanWakeUpFactorClearIsr = true
      CanEnableSecurityEventReporting = false
      CanGlobalTimeSupport = false
      CanMainFunctionBusoffPeriod = 0.005
      CanMainFunctionWakeupPeriod = 0.005
      CanPublicIcomSupport = false
      CanOsCounterRef = OsCounter
      CanSupportTTCANRef = (unset)
    CanGlobalConfiguration:
      CanHardwareUnitSelect = RSCANFD0
      CanClockSourceSelect = CLKC
      CanIntervalTimerPrescalerSet = 8
      CanMirrorFunctionSupport = false
      CanEnableDLCCheck = true
      CanTransmitPrioritySelect = DEPEND_ON_ID
      CanPayloadOverflowModeSelect = DISCARD
      CanRxBufferPayloadLength = PAYLOAD_8
