AUTOSAR XML (schema 00048)
package /RH850U2A16
  module config iRte
    RteOsInteraction
      6 x RteUsedOsActivation:
        iSoft_Auto_RteUsedOsActivation_BTE_0: RteActivationOsTaskRef=iSoft_Auto_OsTask_10ms_BSW
        iSoft_Auto_RteUsedOsActivation_OsAlarm_0: RteExpectedActivationOffset=0.001, RteExpectedTickDuration=0.01, RteActivationOsAlarmRef=iSoft_Auto_OsAlarm_10ms_BSW
        iSoft_Auto_RteUsedOsActivation_BTE_1: RteActivationOsTaskRef=iSoft_Auto_OsTask_5ms_BSW
        iSoft_Auto_RteUsedOsActivation_OsAlarm_1: RteExpectedActivationOffset=0.001, RteExpectedTickDuration=0.005, RteActivationOsAlarmRef=iSoft_Auto_OsAlarm_5ms_BSW
        iSoft_Auto_RteUsedOsActivation_BTE_2: RteActivationOsTaskRef=iSoft_Auto_OsTask_1ms_BSW
        iSoft_Auto_RteUsedOsActivation_OsAlarm_2: RteExpectedActivationOffset=0.001, RteExpectedTickDuration=0.001, RteActivationOsAlarmRef=iSoft_Auto_OsAlarm_1ms_BSW
    20 x RteBswModuleInstance:
      iSoft_Auto_BswM_Imp_BswM: RteBswImplementationRef=Imp_BswM
        iSoft_Auto_SE_BswM_Mainfunction_TE (RteBswEventToTaskMapping):
          RteBswPositionInTask = 0
          RteBswUsedOsAlarmRef = iSoft_Auto_OsAlarm_10ms_BSW
          RteBswEventRef = TE_BswM_MainFunction
          RteBswMappedToTaskRef = iSoft_Auto_OsTask_10ms_BSW
          RteBswUsedOsEventRef = iSoft_Auto_OsEvent_10ms_BSW
      iSoft_Auto_CanIf_Imp_CanIf: RteBswImplementationRef=Imp_CanIf
        iSoft_Auto_CE_CanIf_Transmit_OIE (RteBswEventToTaskMapping): RteBswPositionInTask=0, RteBswEventRef=OIE_CanIf_Transmit
        iSoft_Auto_ExclusiveArea_Channel (RteBswExclusiveAreaImpl): RteExclusiveAreaImplMechanism=ALL_INTERRUPT_BLOCKING, RteBswExclusiveAreaRef=ExclusiveArea_Channel
      iSoft_Auto_CanNm_CanNmImplementation: RteBswImplementationRef=CanNmImplementation
        3 x RteBswEventToTaskMapping, all with RteBswPositionInTask=0:
          iSoft_Auto_CanNm_MainFunction_TE: RteBswEventRef=TimingEvent_MainFunction, RteBswUsedOsAlarmRef=iSoft_Auto_OsAlarm_5ms_BSW, RteBswMappedToTaskRef=iSoft_Auto_OsTask_5ms_BSW, RteBswUsedOsEventRef=iSoft_Auto_OsEvent_5ms_BSW
          iSoft_Auto_CanNm_NetworkRequest_OIE: RteBswEventRef=OperationInvokedEvent_NetworkRequest
          iSoft_Auto_CanNm_NetworkRelease_OIE: RteBswEventRef=OperationInvokedEvent_NetworkRelease
        iSoft_Auto_PnEiraCalc (RteBswExclusiveAreaImpl): RteExclusiveAreaImplMechanism=ALL_INTERRUPT_BLOCKING, RteBswExclusiveAreaRef=PnEiraCalc
        iSoft_Auto_Context (RteBswExclusiveAreaImpl): RteExclusiveAreaImplMechanism=ALL_INTERRUPT_BLOCKING, RteBswExclusiveAreaRef=Context
      iSoft_Auto_CanSM_CanSMImplementation: RteBswImplementationRef=CanSMImplementation
        iSoft_Auto_CanSM_MainFunction_TE (RteBswEventToTaskMapping):
          RteBswPositionInTask = 0
          RteBswEventRef = TimingEvent_MainFunction
          RteBswUsedOsAlarmRef = iSoft_Auto_OsAlarm_1ms_BSW
          RteBswMappedToTaskRef = iSoft_Auto_OsTask_1ms_BSW
          RteBswUsedOsEventRef = iSoft_Auto_OsEvent_1ms_BSW
        iSoft_Auto_Context (RteBswExclusiveAreaImpl): RteExclusiveAreaImplMechanism=ALL_INTERRUPT_BLOCKING, RteBswExclusiveAreaRef=Context
      iSoft_Auto_CanTp_Imp_CanTp: RteBswImplementationRef=Imp_CanTp
        6 x RteBswEventToTaskMapping:
          iSoft_Auto_SE_CanTp_MainFunction_TE: RteBswPositionInTask=1, RteBswEventRef=TE_CanTp_MainFunction, RteBswUsedOsAlarmRef=iSoft_Auto_OsAlarm_5ms_BSW, RteBswMappedToTaskRef=iSoft_Auto_OsTask_5ms_BSW, RteBswUsedOsEventRef=iSoft_Auto_OsEvent_5ms_BSW
          iSoft_Auto_CE_CanTp_RxIndication_OIE: RteBswPositionInTask=0, RteBswEventRef=OIE_CanTp_RxIndication
          iSoft_Auto_CE_CanTp_TxConfirmation_OIE: RteBswPositionInTask=0, RteBswEventRef=OIE_CanTp_TxConfirmation
          iSoft_Auto_CE_CanTp_CancelReceive_OIE: RteBswPositionInTask=0, RteBswEventRef=OIE_CanTp_CancelReceive
          iSoft_Auto_CE_CanTp_CancelTransmit_OIE: RteBswPositionInTask=0, RteBswEventRef=OIE_CanTp_CancelTransmit
          iSoft_Auto_CE_CanTp_Transmit_OIE: RteBswPositionInTask=0, RteBswEventRef=OIE_CanTp_Transmit
        iSoft_Auto_ExclusiveArea (RteBswExclusiveAreaImpl): RteExclusiveAreaImplMechanism=ALL_INTERRUPT_BLOCKING, RteBswExclusiveAreaRef=ExclusiveArea
      iSoft_Auto_Com_Imp_Com_IB_Com: RteBswImplementationRef=Imp_Com_IB_Com
        iSoft_Auto_SE_ComMainFunctionRx_0_TE (RteBswEventToTaskMapping):
          RteBswPositionInTask = 2
          RteBswEventRef = TE_ComMainFunctionRx_0
          RteBswUsedOsAlarmRef = iSoft_Auto_OsAlarm_5ms_BSW
          RteBswMappedToTaskRef = iSoft_Auto_OsTask_5ms_BSW
          RteBswUsedOsEventRef = iSoft_Auto_OsEvent_5ms_BSW
        iSoft_Auto_SE_ComMainFunctionTx_0_TE (RteBswEventToTaskMapping):
          RteBswPositionInTask = 3
          RteBswEventRef = TE_ComMainFunctionTx_0
          RteBswUsedOsAlarmRef = iSoft_Auto_OsAlarm_5ms_BSW
          RteBswMappedToTaskRef = iSoft_Auto_OsTask_5ms_BSW
          RteBswUsedOsEventRef = iSoft_Auto_OsEvent_5ms_BSW
        iSoft_Auto_MultiCore_Lock (RteBswExclusiveAreaImpl): RteExclusiveAreaImplMechanism=ALL_INTERRUPT_BLOCKING, RteBswExclusiveAreaRef=MultiCore_Lock
        iSoft_Auto_Context (RteBswExclusiveAreaImpl): RteExclusiveAreaImplMechanism=ALL_INTERRUPT_BLOCKING, RteBswExclusiveAreaRef=Context
      iSoft_Auto_ComM_ComMImplementation: RteBswImplementationRef=ComMImplementation
        iSoft_Auto_ComM_MainFunction_Channel_CanController_0_TE (RteBswEventToTaskMapping):
          RteBswPositionInTask = 4
          RteBswEventRef = TimingEvent_MainFunction_Channel_CanController_0
          RteBswUsedOsAlarmRef = iSoft_Auto_OsAlarm_5ms_BSW
          RteBswMappedToTaskRef = iSoft_Auto_OsTask_5ms_BSW
          RteBswUsedOsEventRef = iSoft_Auto_OsEvent_5ms_BSW
        iSoft_Auto_COMM_EXCLUSIVE_AREA_0 (RteBswExclusiveAreaImpl): RteExclusiveAreaImplMechanism=ALL_INTERRUPT_BLOCKING, RteBswExclusiveAreaRef=COMM_EXCLUSIVE_AREA_0
        iSoft_Auto_COMM_EXCLUSIVE_AREA_1 (RteBswExclusiveAreaImpl): RteExclusiveAreaImplMechanism=ALL_INTERRUPT_BLOCKING, RteBswExclusiveAreaRef=COMM_EXCLUSIVE_AREA_1
      iSoft_Auto_Dcm_Imp_Dcm: RteBswImplementationRef=Imp_Dcm
        7 x RteBswEventToTaskMapping:
          iSoft_Auto_SE_Dcm_MainFunction_TE: RteBswPositionInTask=5, RteBswEventRef=TE_Dcm_MainFunction, RteBswUsedOsAlarmRef=iSoft_Auto_OsAlarm_5ms_BSW, RteBswMappedToTaskRef=iSoft_Auto_OsTask_5ms_BSW, RteBswUsedOsEventRef=iSoft_Auto_OsEvent_5ms_BSW
          iSoft_Auto_CE_Dcm_StartOfReception_OIE: RteBswPositionInTask=0, RteBswEventRef=OIE_Dcm_StartOfReception
          iSoft_Auto_CE_Dcm_CopyRxData_OIE: RteBswPositionInTask=0, RteBswEventRef=OIE_Dcm_CopyRxData
          iSoft_Auto_CE_Dcm_TpRxIndication_OIE: RteBswPositionInTask=0, RteBswEventRef=OIE_Dcm_TpRxIndication
          iSoft_Auto_CE_Dcm_CopyTxData_OIE: RteBswPositionInTask=0, RteBswEventRef=OIE_Dcm_CopyTxData
          iSoft_Auto_CE_Dcm_TpTxConfirmation_OIE: RteBswPositionInTask=0, RteBswEventRef=OIE_Dcm_TpTxConfirmation
          iSoft_Auto_CE_Dcm_TxConfirmation_OIE: RteBswPositionInTask=0, RteBswEventRef=OIE_Dcm_TxConfirmation
        iSoft_Auto_ExclusiveArea (RteBswExclusiveAreaImpl): RteExclusiveAreaImplMechanism=ALL_INTERRUPT_BLOCKING, RteBswExclusiveAreaRef=ExclusiveArea
      iSoft_Auto_Dem_Imp_Dem: RteBswImplementationRef=Imp_Dem
        iSoft_Auto_SE_Dem_MainFunction_TE (RteBswEventToTaskMapping):
          RteBswPositionInTask = 1
          RteBswEventRef = TE_Dem_MainFunction
          RteBswUsedOsAlarmRef = iSoft_Auto_OsAlarm_10ms_BSW
          RteBswMappedToTaskRef = iSoft_Auto_OsTask_10ms_BSW
          RteBswUsedOsEventRef = iSoft_Auto_OsEvent_10ms_BSW
        iSoft_Auto_ExclusiveArea (RteBswExclusiveAreaImpl): RteExclusiveAreaImplMechanism=ALL_INTERRUPT_BLOCKING, RteBswExclusiveAreaRef=ExclusiveArea
      iSoft_Auto_Det_Imp_Det: RteBswImplementationRef=Imp_Det
        iSoft_Auto_LogError (RteBswExclusiveAreaImpl): RteExclusiveAreaImplMechanism=ALL_INTERRUPT_BLOCKING, RteBswExclusiveAreaRef=LogError
      iSoft_Auto_EcuM_Imp_EcuM: RteBswImplementationRef=Imp_EcuM
        iSoft_Auto_SE_EcuM_MainFunction_TE (RteBswEventToTaskMapping):
          RteBswPositionInTask = 2
          RteBswEventRef = TE_EcuM_MainFunction
          RteBswUsedOsAlarmRef = iSoft_Auto_OsAlarm_10ms_BSW
          RteBswMappedToTaskRef = iSoft_Auto_OsTask_10ms_BSW
          RteBswUsedOsEventRef = iSoft_Auto_OsEvent_10ms_BSW
        iSoft_Auto_WkEv (RteBswExclusiveAreaImpl): RteExclusiveAreaImplMechanism=ALL_INTERRUPT_BLOCKING, RteBswExclusiveAreaRef=WkEv
        iSoft_Auto_GlobalClock (RteBswExclusiveAreaImpl): RteExclusiveAreaImplMechanism=ALL_INTERRUPT_BLOCKING, RteBswExclusiveAreaRef=GlobalClock
      iSoft_Auto_Fee_Imp_Fee: RteBswImplementationRef=Imp_Fee
        iSoft_Auto_SE_Fee_MainFunction_TE (RteBswEventToTaskMapping):
          RteBswPositionInTask = 6
          RteBswEventRef = TE_Fee_MainFunction
          RteBswUsedOsAlarmRef = iSoft_Auto_OsAlarm_5ms_BSW
          RteBswMappedToTaskRef = iSoft_Auto_OsTask_5ms_BSW
          RteBswUsedOsEventRef = iSoft_Auto_OsEvent_5ms_BSW
      iSoft_Auto_Nm_NmImplementation: RteBswImplementationRef=NmImplementation
        iSoft_Auto_Coordinator (RteBswExclusiveAreaImpl): RteExclusiveAreaImplMechanism=ALL_INTERRUPT_BLOCKING, RteBswExclusiveAreaRef=Coordinator
        iSoft_Auto_IRA (RteBswExclusiveAreaImpl): RteExclusiveAreaImplMechanism=ALL_INTERRUPT_BLOCKING, RteBswExclusiveAreaRef=IRA
      iSoft_Auto_NvM_Imp_NvM: RteBswImplementationRef=Imp_NvM
        iSoft_Auto_SE_NvM_MainFunction_TE (RteBswEventToTaskMapping):
          RteBswPositionInTask = 3
          RteBswEventRef = TE_NvM_MainFunction
          RteBswUsedOsAlarmRef = iSoft_Auto_OsAlarm_10ms_BSW
          RteBswMappedToTaskRef = iSoft_Auto_OsTask_10ms_BSW
          RteBswUsedOsEventRef = iSoft_Auto_OsEvent_10ms_BSW
        iSoft_Auto_Queue (RteBswExclusiveAreaImpl): RteExclusiveAreaImplMechanism=ALL_INTERRUPT_BLOCKING, RteBswExclusiveAreaRef=Queue
      iSoft_Auto_PduR_Imp_PduR: RteBswImplementationRef=Imp_PduR
        iSoft_Auto_ExclusiveArea_Route (RteBswExclusiveAreaImpl): RteExclusiveAreaImplMechanism=ALL_INTERRUPT_BLOCKING, RteBswExclusiveAreaRef=ExclusiveArea_Route
        iSoft_Auto_ExclusiveArea_Group (RteBswExclusiveAreaImpl): RteExclusiveAreaImplMechanism=ALL_INTERRUPT_BLOCKING, RteBswExclusiveAreaRef=ExclusiveArea_Group
      iSoft_Auto_WdgM_Imp_WdgM: RteBswImplementationRef=Imp_WdgM
        iSoft_Auto_Exclusive (RteBswExclusiveAreaImpl): RteExclusiveAreaImplMechanism=ALL_INTERRUPT_BLOCKING, RteBswExclusiveAreaRef=Exclusive
      iSoft_Auto_Fls_17_Dmu_Imp_Fls_17_Dmu: RteBswImplementationRef=Imp_Fls
        iSoft_Auto_SE_Fls_MainFunction_TE (RteBswEventToTaskMapping):
          RteBswPositionInTask = 7
          RteBswEventRef = TE_Fls_MainFunction
          RteBswUsedOsAlarmRef = iSoft_Auto_OsAlarm_5ms_BSW
          RteBswMappedToTaskRef = iSoft_Auto_OsTask_5ms_BSW
          RteBswUsedOsEventRef = iSoft_Auto_OsEvent_5ms_BSW
      iSoft_Auto_ComXf_Imp_ComXf: RteBswImplementationRef=Imp_ComXf
      iSoft_Auto_MemIf_Imp_MemIf: RteBswImplementationRef=Imp_MemIf
      iSoft_Auto_WdgIf_Imp_WdgIf: RteBswImplementationRef=Imp_WdgIf
