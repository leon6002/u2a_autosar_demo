AUTOSAR XML (schema 00048)
package /RH850U2A16
  module config Fls: implementation-config-variant=VARIANT-POST-BUILD-LOADABLE, module-description=Fls_Impl
    FlsConfigSet:
      FlsAcErase = 0
      FlsAcWrite = 0
      FlsCallCycle = 0.005
      FlsDefaultMode = MEMIF_MODE_SLOW
      FlsMaxReadFastMode = 512
      FlsMaxReadNormalMode = 256
      FlsMaxWriteFastMode = 4
      FlsMaxWriteNormalMode = 4
      FlsProtection = 0
      FlsSectorList
        FlsSector: FlsNumberOfSectors=128, FlsPageSize=4, FlsSectorSize=4096, FlsSectorStartaddress=0
    FlsGeneral:
      FlsAcLoadOnJobStart = false
      FlsBaseAddress = 0
      FlsBlankCheckApi = true
      FlsCancelApi = true
      FlsCompareApi = false
      FlsCriticalSectionProtection = true
      FlsDeInitApi = true
      FlsDevErrorDetect = false
      FlsDeviceName = R7F702300BFABA
      FlsDriverIndex = 0
      FlsEccCheck = true
      FlsEnableClkImmediateValue = false
      FlsEraseVerificationEnabled = false
      FlsGetJobResultApi = true
      FlsGetStatusApi = true
      FlsInterruptConsistencyCheck = false
      FlsIsrCategory = CAT2
      FlsReadImmediateApi = false
      FlsResumeApi = false
      FlsRuntimeErrorDetect = true
      FlsSetModeApi = true
      FlsShiftPEModeTime = 0
      FlsSuspendApi = false
      FlsTimeoutMonitoringEnable = false
      FlsTimeoutSupervisionEnabled = false
      FlsTotalSize = 524288
      FlsUseInterrupts = false
      FlsVersionCheckExternalModules = false
      FlsVersionInfoApi = false
      FlsWriteVerificationEnabled = false
      FlsCpuFrequencyImmediateValue = 400
      FlsCpuFrequency = McuClockSettingConfig
      FlsDataFlash:
        FlsDFAuthID{0..7} = 4294967295
        FlsDFBCAreaBaseAddress = 4282384384
        FlsDFBaseAddress_FACI0 = 4280287232
        FlsDFBaseAddress_FACI1 = 4280549376
        FlsDFBlockSize = 4096
        FlsDFOneEEPSize = 256
        FlsDFTotalBlocks = 128
    FlsPublishedInformation:
      FlsAcLocationErase = 0
      FlsAcLocationWrite = 0
      FlsAcSizeErase = 0
      FlsAcSizeWrite = 0
      FlsBlankCheckTime = 0.0176
      FlsCancelTime = 0.000022
      FlsEraseTime = 0.2387
      FlsErasedValue = 4294967295
      FlsExpectedHwId = NULL
      FlsSpecifiedEraseCycles = 125000
      FlsSuspendTime = 0.00033
      FlsWriteTime = 0.00154
