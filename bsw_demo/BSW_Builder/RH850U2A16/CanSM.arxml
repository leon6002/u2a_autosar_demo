AUTOSAR XML (schema 00048)
package /RH850U2A16
  module config CanSM
    CanSMGeneral:
      CanSMDevErrorDetect = false
      CanSMMainFunctionTimePeriod = 0.001
      CanSMPncSupport = false
      CanSMSetBaudrateApi = false
      CanSMTxOfflineActiveSupport = false
      CanSMVersionInfoApi = false
      CanSMMultipleControllerSupport = false
    CanSMConfiguration: CanSMModeRequestRepetitionMax=10, CanSMModeRequestRepetitionTime=0.01
      CanSM_ManagerNetwork_0 (CanSMManagerNetwork):
        CanSMBorCounterL1ToL2 = 10
        CanSMBorTimeL1 = 0.1
        CanSMBorTimeL2 = 1.0
        CanSMBorTimeTxEnsured = 1.0
        CanSMBorTxConfirmationPolling = false
        CanSMEnableBusOffDelay = false
        CanSMComMNetworkHandleRef = Channel_CanController_0
        CanSMController_0 (CanSMController): CanSMControllerId=CANIF_CTR_DRV_CanController_0
        CanSMDemEventParameterRefs: CANSM_E_BUS_OFF=EventParameter_0xC07388
