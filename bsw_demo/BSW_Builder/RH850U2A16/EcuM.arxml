AUTOSAR XML (schema 00048)
package /RH850U2A16
  module config EcuM
    EcuMGeneral: EcuMDevErrorDetect=true, EcuMMainFunctionPeriod=0.01, EcuMVersionInfoApi=false
    EcuMConfiguration
      EcuMCommonConfiguration: EcuMConfigConsistencyHash=666, EcuMOSResource=OsUseResScheduler, EcuMDefaultAppMode=OSDEFAULTAPPMODE
        EcuMDefaultShutdownTarget: EcuMDefaultShutdownTarget=EcuMShutdownTargetOff
        EcuMSleepMode: EcuMSleepModeId=0, EcuMSleepModeSuspend=true, EcuMWakeupSourceMask=EcuMWakeupSource_CAN, EcuMWakeupSourceMask=EcuMWakeupSource_Local
        EcuMWakeupSource_CAN (EcuMWakeupSource):
          EcuMCheckWakeupTimeout = 0.0
          EcuMValidationTimeout = 3.0
          EcuMWakeupSourceId = 5
          EcuMWakeupSourcePolling = false
          EcuMComMChannelRef = Channel_CanController_0
        EcuMDriverInitListOne
          6 x EcuMDriverInitItem, all with EcuMModuleParameter=POSTBUILD_PTR, EditModuleService=false, EditPbConfigName=false, EditHeaderFile=false:
            Mcu: EcuMModuleService=Mcu_Init, EcuMModulePbConfigName=Mcu_Config, IncludeHeaderFile=Mcu.h, EcuMModuleRef=Mcu
            Port: EcuMModuleService=Port_Init, EcuMModulePbConfigName=Port_Config, IncludeHeaderFile=Port.h, EcuMModuleRef=Port
            Gpt: EcuMModuleService=Gpt_Init, EcuMModulePbConfigName=Gpt_Config, IncludeHeaderFile=Gpt.h, EcuMModuleRef=Gpt
            Can: EcuMModuleService=Can_Init, EcuMModulePbConfigName=Can_Config, IncludeHeaderFile=Can.h, EcuMModuleRef=Can
            Fls: EcuMModuleService=Fls_Init, EcuMModulePbConfigName=Fls_Config, IncludeHeaderFile=Fls.h, EcuMModuleRef=Fls
            Wdg: EcuMModuleService=Wdg_Init, EcuMModulePbConfigName=Wdg_Config, IncludeHeaderFile=Wdg.h, EcuMModuleRef=Wdg
        EcuMDriverInitListZero
          Det (EcuMDriverInitItem):
            EcuMModuleParameter = NULL_PTR
            EcuMModuleService = Det_Init
            EditModuleService = false
            EcuMModulePbConfigName = NULL_PTR
            EditPbConfigName = false
            IncludeHeaderFile = Det.h
            EditHeaderFile = false
            EcuMModuleRef = Det
          Dem_PreInit (EcuMDriverInitItem):
            EcuMModuleParameter = VOID
            EcuMModuleService = Dem_PreInit
            EditModuleService = false
            EcuMModulePbConfigName = Null
            EditPbConfigName = false
            IncludeHeaderFile = Dem.h
            EditHeaderFile = false
            EcuMModuleRef = Dem
        EcuMWakeupSource_Local (EcuMWakeupSource): EcuMCheckWakeupTimeout=0.0, EcuMValidationTimeout=3.0, EcuMWakeupSourceId=6, EcuMWakeupSourcePolling=false
        EcuMDriverRestartList
          Can (EcuMDriverInitItem):
            EcuMModuleParameter = POSTBUILD_PTR
            EcuMModuleService = Can_Init
            EditModuleService = false
            EcuMModulePbConfigName = Can_Config
            EditPbConfigName = false
            IncludeHeaderFile = Can.h
            EditHeaderFile = false
            EcuMModuleRef = Can
      EcuMFlexConfiguration: EcuMTimerSrcSelect=OS
        EcuMFlexUserConfig: EcuMFlexUser=0
        EcuMResetMode: EcuMResetModeId=0
        ECUM_CAUSE_UNKNOWN (EcuMShutdownCause): EcuMShutdownCauseId=0
        EcuMDriverInitListBswM_0 (EcuMDriverInitListBswM)
          12 x EcuMDriverInitItem, all with EcuMModuleParameter=POSTBUILD_PTR, EditModuleService=false, EditPbConfigName=false, EditHeaderFile=false:
            CanIf: EcuMModuleService=CanIf_Init, EcuMModulePbConfigName=CanIf_InitCfgSet, IncludeHeaderFile=CanIf.h, EcuMModuleRef=CanIf
            CanSM: EcuMModuleService=CanSM_Init, EcuMModulePbConfigName=CanSM_Config, IncludeHeaderFile=CanSM.h, EcuMModuleRef=CanSM
            PduR: EcuMModuleService=PduR_Init, EcuMModulePbConfigName=PduR_PBConfigData, IncludeHeaderFile=PduR.h, EcuMModuleRef=PduR
            Com: EcuMModuleService=Com_Init, EcuMModulePbConfigName=Com_PBConfigData, IncludeHeaderFile=Com.h, EcuMModuleRef=Com
            ComM: EcuMModuleService=ComM_Init, EcuMModulePbConfigName=ComM_Config, IncludeHeaderFile=ComM.h, EcuMModuleRef=ComM
            CanTP: EcuMModuleService=CanTp_Init, EcuMModulePbConfigName=CanTp_Config, IncludeHeaderFile=CanTp.h, EcuMModuleRef=CanTp
            Nm: EcuMModuleService=Nm_Init, EcuMModulePbConfigName=Nm_Config, IncludeHeaderFile=Nm.h, EcuMModuleRef=Nm
            CanNm: EcuMModuleService=CanNm_Init, EcuMModulePbConfigName=CanNm_Config, IncludeHeaderFile=CanNm.h, EcuMModuleRef=CanNm
            Fee: EcuMModuleService=Fee_Init, EcuMModulePbConfigName=Fee_ConfigData, IncludeHeaderFile=Fee.h, EcuMModuleRef=Fee_62
            NvM: EcuMModuleService=NvM_Init, EcuMModulePbConfigName=NULL_PTR, IncludeHeaderFile=NvM.h, EcuMModuleRef=NvM
            Xfrm: EcuMModuleService=Xfrm_Init, EcuMModulePbConfigName=Xfrm_Config, IncludeHeaderFile=Xfrm.h, EcuMModuleRef=Xfrm
            WdgM: EcuMModuleService=WdgM_Init, EcuMModulePbConfigName=WdgMConfigRoot, IncludeHeaderFile=WdgM.h, EcuMModuleRef=WdgM
        EcuMGoDownAllowedUsers: EcuMGoDownAllowedUserRef=EcuMFlexUserConfig
        3 x EcuMShutdownCause:
          ECUM_CAUSE_ECU_STATE: EcuMShutdownCauseId=1
          ECUM_CAUSE_WDGM: EcuMShutdownCauseId=2
          ECUM_CAUSE_DCM: EcuMShutdownCauseId=3
    EcuMFlexGeneral: EcuMAlarmClockPresent=false, EcuMModeHandling=true, EcuMResetLoopDetection=false, EcuMSetProgrammableInterrupts=false
