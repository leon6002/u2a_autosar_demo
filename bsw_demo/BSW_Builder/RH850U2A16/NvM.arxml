AUTOSAR XML (schema 00048)
package /RH850U2A16
  module config NvM
    NvMCommon:
      NvMApiConfigClass = NVM_API_CONFIG_CLASS_3
      NvMBswMMultiBlockJobStatusInformation = false
      NvMCompiledConfigId = 43707
      NvMCrcNumOfBytes = 65535
      NvMDatasetSelectionBits = 8
      NvMDevErrorDetect = true
      NvMDrvModeSwitch = false
      NvMDynamicConfiguration = false
      NvMJobPrioritization = false
      NvMMainFunctionPeriod = 0.01
      NvMPollingMode = true
      NvMRepeatMirrorOperations = 5
      NvMSetRamBlockStatusApi = false
      NvMSizeStandardJobQueue = 20
      NvMVersionInfoApi = false
    8 x NvMBlockDescriptor, all with NvMBlockCrcType=NVM_CRC16, NvMBlockJobPriority=1, NvMBlockUseAutoValidation=false, NvMBlockUseCrc=true, NvMBlockUseSetRamBlockStatus=false, NvMBlockUseSyncMechanism=false, NvMBswMBlockStatusInformation=false, NvMMaxNumOfReadRetries=3, NvMMaxNumOfWriteRetries=3, NvMNvramDeviceId=0, NvMResistantToChangedSw=true, NvMSelectBlockForReadAll=true, NvMSelectBlockForWriteAll=true, NvMStaticBlockIDCheck=false, NvMWriteBlockOnce=false, NvMBlockWriteProt=false, NvMWriteVerification=false, NvMWriteVerificationDataSize=0, NvMBlockUsePort=false, NvMBlockUseCompression=false, NvMSelectBlockForFirstInitAll=false:
      NvMBlock_ConfigID: NvMBlockManagementType=NVM_BLOCK_REDUNDANT, NvMBlockUseCRCCompMechanism=false, NvMCalcRamBlockCrc=true, NvMNvBlockBaseNumber=1, NvMNvBlockLength=2, NvMNvBlockNum=2, NvMNvramBlockIdentifier=NvMBlock_ConfigID, NvMRamBlockDataBufferAutoFill=true, NvMRomBlockNum=0, NvMRamBlockDataAddress=NvMBlockRamBuffer1
        NvMTargetBlockReference
          NvMFeeRef: NvMNameOfFeeBlock=FeeBlockConfiguration_0
      NvMBlock_Dcm: NvMBlockManagementType=NVM_BLOCK_NATIVE, NvMBlockUseCRCCompMechanism=true, NvMCalcRamBlockCrc=true, NvMNvBlockBaseNumber=2, NvMNvBlockLength=128, NvMNvBlockNum=1, NvMNvramBlockIdentifier=NvMBlock_Dcm, NvMRamBlockDataBufferAutoFill=true, NvMRomBlockNum=0, NvMRamBlockDataAddress=NvMBlockRamBuffer2
        NvMTargetBlockReference
          NvMFeeRef: NvMNameOfFeeBlock=FeeBlockConfiguration_DCM
      NvMBlock_SecurityLevel01: NvMBlockManagementType=NVM_BLOCK_NATIVE, NvMBlockUseCRCCompMechanism=true, NvMCalcRamBlockCrc=true, NvMNvBlockBaseNumber=7, NvMNvBlockLength=1, NvMNvBlockNum=1, NvMNvramBlockIdentifier=NvMBlock_SecurityLevel01, NvMRamBlockDataBufferAutoFill=true, NvMRomBlockNum=0, NvMRamBlockDataAddress=NvMBlockRamBuffer3
        NvMTargetBlockReference
          NvMFeeRef: NvMNameOfFeeBlock=FeeBlock_SecurityLevel01
      NvMBlock_SecurityLevel02: NvMBlockManagementType=NVM_BLOCK_NATIVE, NvMBlockUseCRCCompMechanism=true, NvMCalcRamBlockCrc=true, NvMNvBlockBaseNumber=8, NvMNvBlockLength=1, NvMNvBlockNum=1, NvMNvramBlockIdentifier=NvMBlock_SecurityLevel02, NvMRamBlockDataBufferAutoFill=true, NvMRomBlockNum=0, NvMRamBlockDataAddress=NvMBlockRamBuffer4
        NvMTargetBlockReference
          NvMFeeRef: NvMNameOfFeeBlock=FeeBlock_SecurityLevel02
      NvMBlock_DIDF190: NvMBlockManagementType=NVM_BLOCK_NATIVE, NvMBlockUseCRCCompMechanism=true, NvMCalcRamBlockCrc=true, NvMNvBlockBaseNumber=6, NvMNvBlockLength=32, NvMNvBlockNum=1, NvMNvramBlockIdentifier=NvMBlock_DIDF190, NvMRamBlockDataBufferAutoFill=true, NvMRomBlockNum=1, NvMRamBlockDataAddress=NvMBlockRamBuffer5, NvMRomBlockDataAddress=NvMBlock_DIDF190_RomAddress, NvMBlockHeaderInclude=Rte_NvM
        NvMTargetBlockReference
          NvMFeeRef: NvMNameOfFeeBlock=Fee_DIDF190
      NvMBlock_DIDF183: NvMBlockManagementType=NVM_BLOCK_NATIVE, NvMBlockUseCRCCompMechanism=true, NvMCalcRamBlockCrc=true, NvMNvBlockBaseNumber=5, NvMNvBlockLength=32, NvMNvBlockNum=1, NvMNvramBlockIdentifier=NvMBlock_DIDF183, NvMRamBlockDataBufferAutoFill=true, NvMRomBlockNum=1, NvMRamBlockDataAddress=NvMBlockRamBuffer6, NvMRomBlockDataAddress=NvMBlock_DIDF183_RomAddress
        NvMTargetBlockReference
          NvMFeeRef: NvMNameOfFeeBlock=Fee_DIDF183
      NvMBlock_All_EventEntry: NvMBlockManagementType=NVM_BLOCK_NATIVE, NvMBlockUseCRCCompMechanism=false, NvMCalcRamBlockCrc=false, NvMNvBlockBaseNumber=4, NvMNvBlockLength=560, NvMNvBlockNum=1, NvMNvramBlockIdentifier=NvMBlock_All_EventEntry, NvMRamBlockDataBufferAutoFill=false, NvMRomBlockNum=0, NvMRamBlockDataAddress=DemEventMemoryEntryStorage
        NvMTargetBlockReference
          NvMFeeRef: NvMNameOfFeeBlock=FeeBlockConfiguration_DEM_2_All_EventEntry
      NvMBlock_UDS_InternalData: NvMBlockManagementType=NVM_BLOCK_NATIVE, NvMBlockUseCRCCompMechanism=false, NvMCalcRamBlockCrc=false, NvMNvBlockBaseNumber=3, NvMNvBlockLength=76, NvMNvBlockNum=1, NvMNvramBlockIdentifier=NvMBlock_UDS_InternalData, NvMRamBlockDataBufferAutoFill=false, NvMRomBlockNum=0, NvMRamBlockDataAddress=DemEventRelateInformationStorage
        NvMTargetBlockReference
          NvMFeeRef: NvMNameOfFeeBlock=FeeBlockConfiguration_DEM_1_UDS_InternalData
