AUTOSAR XML (schema 00048)
package /RH850U2A16
  module config Nm
    NmChannelConfig_0 (NmChannelConfig):
      NmChannelSleepMaster = false
      NmStateReportEnabled = false
      NmSynchronizingNetwork = false
      NmPnEnabled = true
      NmPassiveModeEnabled = false
      NmComMChannelRef = Channel_CanController_0
      NmBusType
        NmStandardBusNmConfig: NmStandardBusType=NM_BUSNM_CANNM
    NmGlobalConfig
      NmGlobalConstants: NmNumberOfChannels=1
      NmGlobalFeatures:
        NmBusSynchronizationEnabled = false
        NmCarWakeUpRxEnabled = false
        NmComControlEnabled = true
        NmCoordinatorSupportEnabled = false
        NmCoordinatorSyncSupport = false
        NmPduRxIndicationEnabled = true
        NmRemoteSleepIndEnabled = false
        NmStateChangeIndEnabled = true
        NmUserDataEnabled = false
        NmPartialNetworkSupportEnabled = true
      NmGlobalProperties: NmCycletimeMainFunction=0.0, NmDevErrorDetect=true, NmVersionInfoApi=false
