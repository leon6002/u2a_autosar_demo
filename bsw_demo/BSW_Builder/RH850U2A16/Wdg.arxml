AUTOSAR XML (schema 00048)
package /RH850U2A16
  module config Wdg: implementation-config-variant=VARIANT-POST-BUILD-LOADABLE, module-description=Wdg_Impl
    WdgGeneral:
      WdgActivationCodeMode = WDG_FIXED_ACTIVATION_CODE_MODE
      WdgArbitraryTimingInterruptMode = false
      WdgCriticalSectionProtection = false
      WdgDevErrorDetect = true
      WdgDeviceName = R7F702300BFABA
      WdgDisableAllowed = true
      WdgECMInterruptConsistencyCheck = false
      WdgEnableClkImmediateValue = false
      WdgEnableDelayTimerStart = false
      WdgErrorModeSetting = WDG_RESET_MODE
      WdgErrorOutputMask = false
      WdgFEINTDisableAllowed = false
      WdgIndex = 0
      WdgInitialTimeout = 5
      WdgInterruptConsistencyCheck = false
      WdgIsrCategory = CAT2
      WdgMaxTimeout = 10
      WdgRunArea = ROM
      WdgSelectWDTBUnit = WDTB0
      WdgTriggerLocation = NULL
      WdgVACSupport = false
      WdgVersionCheckExternalModules = false
      WdgVersionInfoApi = false
      WdgClockRefImmediateValue = WDTBTCKI_312_5KHZ
      WdgClockRef = McuWDTClk
    WdgPublishedInformation: WdgTriggerMode=WDG_WINDOW
    WdgSettingsConfig: WdgDefaultMode=WDGIF_OFF_MODE
      WdgSettingsFast: WdgClkSettingsFast=WDGCLK_DIVBY_2POWOF_9
      WdgSettingsOff
      WdgSettingsSlow: WdgClkSettingsSlow=WDGCLK_DIVBY_2POWOF_16
