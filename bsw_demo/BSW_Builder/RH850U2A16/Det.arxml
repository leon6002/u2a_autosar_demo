AUTOSAR XML (schema 00048)
package /RH850U2A16
  module config Det
    DetGeneral:
      DetForwardToDlt = false
      DetVersionInfoApi = false
      DetErrorHookEnabled = true
      DetRuntimeErrorCalloutEnabled = true
      DetTransientFaultCalloutEnabled = true
      DetUseExtendedDebugSupport = false
      DetLogAndTraceFilterSize = 10
      DetBreakFilterSize = 10
      DetGlobalFilterSize = 10
      DetLogBufferSize = 10
      DetReportErrorRecursionLimit = 10
      DetReportRuntimeErrorRecursionLimit = 10
      DetReportTransientFaultRecursionLimit = 10
      DetCheckFilterMatchEnabled = false
