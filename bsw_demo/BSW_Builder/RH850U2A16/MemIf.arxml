AUTOSAR XML (schema 00048)
package /RH850U2A16
  module config MemIf
    MemIfGeneral:
      MemIfGeneralDevErrorDetect = false
      MemIfGeneralNumberOfDevices = 1
      MemIfGeneralVersionInfoApi = false
      MemIfGeneralUseFunciontApi = false
      MemIfGeneralFeeMapSupport = true
      MemIfGeneralEaMapSupport = false
