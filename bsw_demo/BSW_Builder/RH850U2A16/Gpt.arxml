AUTOSAR XML (schema 00048)
package /RH850U2A16
  module config Gpt: implementation-config-variant=VARIANT-POST-BUILD-LOADABLE, module-description=Gpt_Impl
    GptChannelConfigSet
      GptChannelConfiguration_TAUJ0I0 (GptChannelConfiguration):
        GptChannelId = 0
        GptChannelMode = GPT_CH_MODE_CONTINUOUS
        GptChannelSelection = TAUJ0I0
        GptChannelTickFrequency = 1000
        GptChannelTickValueMax = 65535
        GptEnableWakeup = false
        GptChannelClk = CK0
        GptNotification = GptNotification_1ms
        GptChannelClkSrcRef = GptClockReferencePoint
      GptTauUnit_TAUJ0 (GptTauUnit):
        GptTauPrescalerCk0 = PCLK_DIVBY_2_POWOF_07
        GptTauPrescalerCk1 = PCLK_DIVBY_2_POWOF_00
        GptTauPrescalerCk2 = PCLK_DIVBY_2_POWOF_00
        GptTauPrescalerCk3BaudRate = 2
        GptTauPrescalerCk3Pre = PCLK_DIVBY_2_POWOF_00
        GptTauUnitSelection = TAUJ0
    GptConfigurationOfOptApiServices:
      GptDeinitApi = true
      GptEnableDisableNotificationApi = true
      GptGetPredefTimerValueApi = false
      GptTimeElapsedApi = true
      GptTimeRemainingApi = true
      GptVersionInfoApi = false
      GptWakeupFunctionalityApi = false
    GptDriverConfiguration:
      GptAlreadyInitDetCheck = true
      GptClearPendingInterrupts = true
      GptCriticalSectionProtection = true
      GptDevErrorDetect = false
      GptDeviceName = R7F702300BFABA
      GptInterruptConsistencyCheck = false
      GptIsrCategory = CAT2
      GptPeNumber = 0
      GptPredefTimer100us32bitEnable = false
      GptPredefTimer1usEnablingGrade = GPT_PREDEF_TIMER_1US_16_24_32BIT_ENABLED
      GptReportWakeupSource = false
      GptVersionCheckExternalModules = false
      GptClockReferencePoint: GptClockReference=McuClockReferencePoint
      GptTaujClockReferencePoint:
        GptEnableTauj01ClockImmediateValue = false
        GptEnableTauj23ClockImmediateValue = false
        GptTauj01ClockReference = McuHighSpeedPeriClk
        GptTauj23ClockReference = McuTAUJClk
