AUTOSAR XML (schema 00048)
package /RH850U2A16
  module config CanNm
    CanNmGlobalConfig:
      CanNmGlobalPnSupport = true
      CanNmBusLoadReductionEnabled = false
      CanNmBusSynchronizationEnabled = false
      CanNmComControlEnabled = true
      CanNmComUserDataSupport = false
      CanNmCoordinatorSyncSupport = false
      CanNmDevErrorDetect = false
      CanNmImmediateRestartEnabled = false
      CanNmImmediateTxconfEnabled = false
      CanNmMainFunctionPeriod = 0.005
      CanNmPassiveModeEnabled = false
      CanNmPduRxIndicationEnabled = true
      CanNmRemoteSleepIndEnabled = false
      CanNmStateChangeIndEnabled = true
      CanNmUserDataEnabled = false
      CanNmVersionInfoApi = false
      CanNmPnEiraCalcEnabled = true
      CanNmPnResetTime = 2.5
      CanNmPnEiraRxNSduRef = CANNM_CAN0_Rx_CanNmEiraRx
      CanNmChannelConfig_0 (CanNmChannelConfig):
        CanNmStayInPbsEnabled = false
        CanNmBusLoadReductionActive = false
        CanNmCarWakeUpRxEnabled = false
        CanNmImmediateNmTransmissions = 10
        CanNmMsgCycleOffset = 0.0
        CanNmMsgCycleTime = 1.0
        CanNmMsgReducedTime = 0.001
        CanNmNodeId = 1
        CanNmPduCbvPosition = CANNM_PDU_BYTE_1
        CanNmPduNidPosition = CANNM_PDU_BYTE_0
        CanNmRepeatMessageTime = 3.0
        CanNmTimeoutTime = 3.0
        CanNmWaitBusSleepTime = 1.5
        CanNmActiveWakeupBitEnabled = true
        CanNmRetryFirstMessageRequest = true
        CanNmImmediateNmCycleTime = 0.02
        CanNmPnEnabled = true
        CanNmPnHandleMultipleNetworkRequests = false
        CanNmNodeDetectionEnabled = true
        CanNmNodeIdEnabled = true
        CanNmRepeatMsgIndEnabled = true
        CanNmMsgTimeoutTime = 0.5
        CanNmAllNmMessagesKeepAwake = true
        CanNmPnEraCalcEnabled = false
        CanNmComMNetworkHandleRef = Channel_CanController_0
        CanNmRxPdu: CanNmRxPduId=0, CanNmRxPduRef=CAN0_Rx_0x5xx_NM_ECU
        CanNmTxPdu: CanNmTxConfirmationPduId=0, CanNmTxPduRef=CAN0_Tx_0x501_NM_ECU
      CanNmPnInfo: CanNmPnInfoLength=6, CanNmPnInfoOffset=2
        6 x CanNmPnFilterMaskByte:
          CanNmPnFilterMaskByte_0: CanNmPnFilterMaskByteIndex=0, CanNmPnFilterMaskByteValue=2
          CanNmPnFilterMaskByte_1: CanNmPnFilterMaskByteIndex=1, CanNmPnFilterMaskByteValue=32
          CanNmPnFilterMaskByte_{2..5}: CanNmPnFilterMaskByteIndex={2..5}, CanNmPnFilterMaskByteValue=0
