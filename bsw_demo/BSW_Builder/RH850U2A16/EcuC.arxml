AUTOSAR XML (schema 00048)
package /RH850U2A16
  module config EcuC
    EcuCGeneral: ByteOrder=LITTLE_ENDIAN
    EcucConfigSet
      EcucPduCollection: PduIdTypeEnum=UINT16, PduLengthTypeEnum=UINT16
        50 x Pdu:
          CAN0_Rx_0x251_Cyclic_PN29: PduLength=8
          CAN0_Rx_0x250_Cyclic_PN17: PduLength=8
          CAN0_Rx_0x200_Cyclic: PduLength=8
          CAN0_Rx_0x201_Event: PduLength=8
          CAN0_Rx_0x202_Mixed: PduLength=8
          CAN0_Rx_0x203_Cyclic_Counter: PduLength=8
          CAN0_Tx_0x351_Cyclic_PN29: PduLength=8
          CAN0_Tx_0x350_Cyclic_PN17: PduLength=8
          CAN0_Tx_0x300_Cyclic: PduLength=8
          CAN0_Tx_0x301_Event: PduLength=8
          CAN0_Tx_0x302_Mixed: PduLength=8
          CAN0_Tx_0x303_Cyclic_Counter: PduLength=8
          COM_CAN0_Rx_0x251_Cyclic_PN29: PduLength=8
          COM_CAN0_Rx_0x250_Cyclic_PN17: PduLength=8
          COM_CAN0_Rx_0x200_Cyclic: PduLength=8
          COM_CAN0_Rx_0x201_Event: PduLength=8
          COM_CAN0_Rx_0x202_Mixed: PduLength=8
          COM_CAN0_Rx_0x203_Cyclic_Counter: PduLength=8
          COM_CAN0_Tx_0x351_Cyclic_PN29: PduLength=8
          COM_CAN0_Tx_0x350_Cyclic_PN17: PduLength=8
          COM_CAN0_Tx_0x300_Cyclic: PduLength=8
          COM_CAN0_Tx_0x301_Event: PduLength=8
          COM_CAN0_Tx_0x302_Mixed: PduLength=8
          COM_CAN0_Tx_0x303_Cyclic_Counter: PduLength=8
          CAN0_Rx_0x708_Diag_Phy_Request: PduLength=8
          CAN0_Rx_0x7df_Diag_Fun_Request: PduLength=8
          CAN0_Tx_0x709_Diag_Phy_Response: PduLength=8
          CANTP_CAN0_Rx_0x708_Diag_Phy_Request: PduLength=8
          CANTP_CAN0_Rx_0x7df_Diag_Fun_Request: PduLength=8
          CANTP_CAN0_Tx_0x709_Diag_Phy_Response: PduLength=8
          DCM_CAN0_Rx_0x708_Diag_Phy_Request: PduLength=1024
          DCM_CAN0_Rx_0x7df_Diag_Fun_Request: PduLength=8
          DCM_CAN0_Tx_0x709_Diag_Phy_Response: PduLength=1024
          CAN0_Rx_0x5xx_NM_ECU: PduLength=8
          CAN0_Tx_0x501_NM_ECU: PduLength=8
          CANNMCAN0_Tx_UserData: PduLength=6
          COM_CAN0_Tx_CanNmUserData: PduLength=6
          CANNM_CAN0_Rx_CanNmEiraRx: PduLength=6
          COM_CAN0_Rx_ComCanNmEiraRx: PduLength=6
          CAN0_Rx_0x260_E2E_P01: PduLength=8
          CAN0_Tx_0x360_E2E_P01: PduLength=8
          COM_CAN0_Rx_0x260_E2E_P01: PduLength=8
          COM_CAN0_Tx_0x360_E2E_P01: PduLength=8
          CAN0_Rx_Reserved_0x261: PduLength=8
          CAN0_Rx_Reserved_0x270: PduLength=8
          CAN0_Rx_Reserved_0x601: PduLength=8
          CAN0_Tx_0x304_Cyclic_Counter: PduLength=8
          COM_CAN0_Tx_0x304_Cyclic_Counter: PduLength=8
          CAN0_Tx_0x18C4D2D0_Cyclic_Counter: PduLength=8
          COM_CAN0_Tx_0x18C4D2D0_Cyclic_Counter: PduLength=8
