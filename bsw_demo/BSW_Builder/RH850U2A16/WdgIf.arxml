AUTOSAR XML (schema 00048)
package /RH850U2A16
  module config WdgIf
    WdgIfGeneral: WdgIfDevErrorDetect=true, WdgIfVersionInfoApi=false, WdgIfNumberOfDevices=1, WdgIfIncludeHeader=Wdg.h
    WdgIfInternalDevice_0 (WdgIfInternalDevice): WdgIfDeviceIndex=0, TriggerConditionFunction=Wdg_SetTriggerCondition, SetModeFunction=Wdg_SetMode, WdgIfDriverRef=WdgGeneral
