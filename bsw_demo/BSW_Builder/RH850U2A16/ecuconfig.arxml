AUTOSAR XML (schema 00048)
package /RH850U2A16
  ecuc value collection RH850U2A16
    ecuc-values:
      Os
      Wdg
      Fee_62
      Xfrm
      Com
      NvM
      iRte
      ComM
      EcuC
      Dem
      Dcm
      WdgIf
      CanIf
      CanTp
      CanNm
      Det
      PduR
      Crc
      EcuM
      CanSM
      BswM
      WdgM
      MemIf
      Nm
      Can
      Port
      Gpt
      Fls
      Mcu
