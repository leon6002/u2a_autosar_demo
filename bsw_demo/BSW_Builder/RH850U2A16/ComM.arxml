AUTOSAR XML (schema 00048)
package /RH850U2A16
  module config ComM
    ComMGeneral:
      ComMDevErrorDetect = false
      ComMDirectUserMapping = false
      ComMEcuGroupClassification = 3
      ComMModeLimitationEnabled = false
      ComMPncGatewayEnabled = false
      ComMPncSupport = true
      ComMResetAfterForcingNoComm = false
      ComMSynchronousWakeUp = true
      ComMVersionInfoApi = false
      ComMWakeupInhibitionEnabled = false
      ComMMultiplePartitionEnabled = false
    ComMConfigSet: ComMPncEnabled=true
      ComMUser_ECU (ComMUser): ComMUserIdentifier=ComMUser_ECU, ComMUserModeNotification=false
      Channel_CanController_0 (ComMChannel):
        ComMBusType = COMM_BUS_TYPE_CAN
        ComMChannelId = Channel_CanController_0
        ComMFullCommRequestNotificationEnabled = false
        ComMMainFunctionPeriod = 0.005
        ComMNoCom = false
        ComMNoWakeUpInhibitionNvmStorage = false
        ComMNoWakeup = false
        ComMNetworkManagement: ComMNmVariant=FULL, ComMPncNmRequest=false
        ComMUserPerChannel_0 (ComMUserPerChannel): ComMUserChannel=ComMUser_ECU
      ComMPnc_17 (ComMPnc): ComMPncId=17, ComMChannelPerPnc=Channel_CanController_0, ComMUserPerPnc=PNCUser_ComMPnc_17
        ComMPncComSignal_Rx (ComMPncComSignal): ComMPncComSignalKind=EIRA, ComMPncComSignalRef=ComSignal_CanNmEira_Rx
      ComMPnc_29 (ComMPnc): ComMPncId=29, ComMChannelPerPnc=Channel_CanController_0, ComMUserPerPnc=PNCUser_ComMPnc_29
        ComMPncComSignal_Rx (ComMPncComSignal): ComMPncComSignalKind=EIRA, ComMPncComSignalRef=ComSignal_CanNmEira_Rx
      PNCUser_ComMPnc_17 (ComMUser): ComMUserIdentifier=PNCUser_ComMPnc_17, ComMUserModeNotification=false
      PNCUser_ComMPnc_29 (ComMUser): ComMUserIdentifier=PNCUser_ComMPnc_29, ComMUserModeNotification=false
