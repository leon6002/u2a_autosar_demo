AUTOSAR XML (schema 00048)
package /RH850U2A16
  module config CanIf
    CanIfCtrlDrvCfg: CanIfCtrlDrvInitHohConfigRef=CanIfInitHohCfg, CanIfCtrlDrvNameRef=Can
      CANIF_CTR_DRV_CanController_0 (CanIfCtrlCfg): CanIfCtrlId=CANIF_CANDRV_0_CANIF_CTR_DRV_CanController_0, CanIfCtrlWakeupSupport=false, CanIfCtrlCanCtrlRef=CanController_CAN0
    CanIfDispatchCfg:
      CanIfDispatchUserCtrlBusOffName = CanSM_ControllerBusOff
      CanIfDispatchUserCtrlBusOffUL = CAN_SM
      CanIfDispatchUserCtrlModeIndicationName = CanSM_ControllerModeIndication
      CanIfDispatchUserCtrlModeIndicationUL = CAN_SM
      CanIfDispatchUserCheckTrcvWakeFlagIndicationName = User_CheckTransceiverWakeFlagIndication
      CanIfDispatchUserClearTrcvWufFlagIndicationName = User_ClearTrcvWufFlagIndication
      CanIfDispatchUserConfirmPnAvailabilityName = User_ConfirmPnAvailability
      CanIfDispatchUserTrcvModeIndicationName = User_TrcvModeIndication
      CanIfDispatchUserValidateWakeupEventName = User_ValidateWakeupEvent
    CanIfInitCfg: CanIfInitCfgSet=CanIfInitCfgSet
      CanIfInitHohCfg
        HRH_CAN0_Rx_COM (CanIfHrhCfg): CanIfHrhSoftwareFilter=false, CanIfHrhCanCtrlIdRef=CANIF_CTR_DRV_CanController_0, CanIfHrhIdSymRef=CanHardwareObject_CAN0_Rx_COM
        6 x CanIfHthCfg, all with CanIfHthCanCtrlIdRef=CANIF_CTR_DRV_CanController_0:
          HTH_CAN0_Tx_0x351_Cyclic_PN29: CanIfHthIdSymRef=CanHardwareObject_CAN0_Tx_0x351_Cyclic_PN29
          HTH_CAN0_Tx_0x350_Cyclic_PN17: CanIfHthIdSymRef=CanHardwareObject_CAN0_Tx_0x350_Cyclic_PN17
          HTH_CAN0_Tx_0x300_Cyclic: CanIfHthIdSymRef=CanHardwareObject_CAN0_Tx_0x300_Cyclic
          HTH_CAN0_Tx_0x301_Event: CanIfHthIdSymRef=CanHardwareObject_CAN0_Tx_0x301_Event
          HTH_CAN0_Tx_0x302_Mixed: CanIfHthIdSymRef=CanHardwareObject_CAN0_Tx_0x302_Mixed
          HTH_CAN0_Tx_0x303_Cyclic_Counter: CanIfHthIdSymRef=CanHardwareObject_CAN0_Tx_0x303_Cyclic_Counter
        HRH_CAN0_Rx_0x708_Diag_Phy_Request (CanIfHrhCfg):
          CanIfHrhSoftwareFilter = false
          CanIfHrhCanCtrlIdRef = CANIF_CTR_DRV_CanController_0
          CanIfHrhIdSymRef = CanHardwareObject_CAN0_Rx_0x708_Diag_Phy_Request
        HRH_CAN0_Rx_0x7df_Diag_Fun_Request (CanIfHrhCfg):
          CanIfHrhSoftwareFilter = false
          CanIfHrhCanCtrlIdRef = CANIF_CTR_DRV_CanController_0
          CanIfHrhIdSymRef = CanHardwareObject_CAN0_Rx_0x7df_Diag_Fun_Request
        HTH_CAN0_Tx_0x709_Diag_Phy_Response (CanIfHthCfg): CanIfHthCanCtrlIdRef=CANIF_CTR_DRV_CanController_0, CanIfHthIdSymRef=CanHardwareObject_CAN0_Tx_0x709_Diag_Phy_Response
        HRH_CAN0_Rx_0x5xx_NM_ECU (CanIfHrhCfg): CanIfHrhSoftwareFilter=false, CanIfHrhCanCtrlIdRef=CANIF_CTR_DRV_CanController_0, CanIfHrhIdSymRef=CanHardwareObject_CAN0_Rx_0x5xx_NM_ECU
        4 x CanIfHthCfg, all with CanIfHthCanCtrlIdRef=CANIF_CTR_DRV_CanController_0:
          HTH_CAN0_Tx_0x501_NM_ECU: CanIfHthIdSymRef=CanHardwareObject_CAN0_Tx_0x501_NM_ECU
          HTH_CAN0_Tx_0x360_E2E_P01: CanIfHthIdSymRef=CanHardwareObject_CAN0_Tx_0x360_E2E_P01
          HTH_CAN0_Tx_0x304_Cyclic_Counter: CanIfHthIdSymRef=CanHardwareObject_CAN0_Tx_0x304_Cyclic_Counter
          HTH_CAN0_Tx_0x18C4D2D0_Cyclic_Counter: CanIfHthIdSymRef=CanHardwareObject_CAN0_Tx_0x18C4D2D0_Cyclic_Counter
      6 x CanIfRxPduCfg, all with CanIfRxPduCanIdType=STANDARD_CAN, CanIfRxPduReadData=false, CanIfRxPduReadNotifyStatus=false, CanIfRxPduUserRxIndicationName=PduR_CanIfRxIndication, CanIfRxPduUserRxIndicationUL=PDUR, CanIfRxPduDataLength=8, CanIfRxPduDataLengthCheck=true, CanIfRxPduHrhIdRef=HRH_CAN0_Rx_COM:
        RX_PDU_CAN0_Rx_0x251_Cyclic_PN29: CanIfRxPduCanId=593, CanIfRxPduId=CANIF_RXPDU_CAN0_Rx_0x251_Cyclic_PN29, CanIfRxPduRef=CAN0_Rx_0x251_Cyclic_PN29
        RX_PDU_CAN0_Rx_0x250_Cyclic_PN17: CanIfRxPduCanId=592, CanIfRxPduId=CANIF_RXPDU_CAN0_Rx_0x250_Cyclic_PN17, CanIfRxPduRef=CAN0_Rx_0x250_Cyclic_PN17
        RX_PDU_CAN0_Rx_0x200_Cyclic: CanIfRxPduCanId=512, CanIfRxPduId=CANIF_RXPDU_CAN0_Rx_0x200_Cyclic, CanIfRxPduRef=CAN0_Rx_0x200_Cyclic
        RX_PDU_CAN0_Rx_0x201_Event: CanIfRxPduCanId=513, CanIfRxPduId=CANIF_RXPDU_CAN0_Rx_0x201_Event, CanIfRxPduRef=CAN0_Rx_0x201_Event
        RX_PDU_CAN0_Rx_0x202_Mixed: CanIfRxPduCanId=514, CanIfRxPduId=CANIF_RXPDU_CAN0_Rx_0x202_Mixed, CanIfRxPduRef=CAN0_Rx_0x202_Mixed
        RX_PDU_CAN0_Rx_0x203_Cyclic_Counter: CanIfRxPduCanId=515, CanIfRxPduId=CANIF_RXPDU_CAN0_Rx_0x203_Cyclic_Counter, CanIfRxPduRef=CAN0_Rx_0x203_Cyclic_Counter
      BUFFER_CAN0_Tx_0x351_Cyclic_PN29 (CanIfBufferCfg): CanIfBufferSize=0, CanIfBufferHthRef=HTH_CAN0_Tx_0x351_Cyclic_PN29
      TX_PDU_CAN0_Tx_0x351_Cyclic_PN29 (CanIfTxPduCfg):
        CanIfTxPduCanId = 849
        CanIfTxPduCanIdType = STANDARD_CAN
        CanIfTxPduId = CANIF_TXPDU_CAN0_Tx_0x351_Cyclic_PN29
        CanIfTxPduPnFilterPdu = false
        CanIfTxPduReadNotifyStatus = false
        CanIfTxPduTriggerTransmit = false
        CanIfTxPduType = STATIC
        CanIfTxPduUserTriggerTransmitName = PduR_CanIfTriggerTransmit
        CanIfTxPduUserTxConfirmationName = PduR_CanIfTxConfirmation
        CanIfTxPduUserTxConfirmationUL = PDUR
        CanIfTxPduTruncation = true
        CanIfTxPduBufferRef = BUFFER_CAN0_Tx_0x351_Cyclic_PN29
        CanIfTxPduRef = CAN0_Tx_0x351_Cyclic_PN29
      BUFFER_CAN0_Tx_0x350_Cyclic_PN17 (CanIfBufferCfg): CanIfBufferSize=0, CanIfBufferHthRef=HTH_CAN0_Tx_0x350_Cyclic_PN17
      TX_PDU_CAN0_Tx_0x350_Cyclic_PN17 (CanIfTxPduCfg):
        CanIfTxPduCanId = 848
        CanIfTxPduCanIdType = STANDARD_CAN
        CanIfTxPduId = CANIF_TXPDU_CAN0_Tx_0x350_Cyclic_PN17
        CanIfTxPduPnFilterPdu = false
        CanIfTxPduReadNotifyStatus = false
        CanIfTxPduTriggerTransmit = false
        CanIfTxPduType = STATIC
        CanIfTxPduUserTriggerTransmitName = PduR_CanIfTriggerTransmit
        CanIfTxPduUserTxConfirmationName = PduR_CanIfTxConfirmation
        CanIfTxPduUserTxConfirmationUL = PDUR
        CanIfTxPduTruncation = true
        CanIfTxPduBufferRef = BUFFER_CAN0_Tx_0x350_Cyclic_PN17
        CanIfTxPduRef = CAN0_Tx_0x350_Cyclic_PN17
      BUFFER_CAN0_Tx_0x300_Cyclic (CanIfBufferCfg): CanIfBufferSize=0, CanIfBufferHthRef=HTH_CAN0_Tx_0x300_Cyclic
      TX_PDU_CAN0_Tx_0x300_Cyclic (CanIfTxPduCfg):
        CanIfTxPduCanId = 768
        CanIfTxPduCanIdType = STANDARD_CAN
        CanIfTxPduId = CANIF_TXPDU_CAN0_Tx_0x300_Cyclic
        CanIfTxPduPnFilterPdu = false
        CanIfTxPduReadNotifyStatus = false
        CanIfTxPduTriggerTransmit = false
        CanIfTxPduType = STATIC
        CanIfTxPduUserTriggerTransmitName = PduR_CanIfTriggerTransmit
        CanIfTxPduUserTxConfirmationName = PduR_CanIfTxConfirmation
        CanIfTxPduUserTxConfirmationUL = PDUR
        CanIfTxPduTruncation = true
        CanIfTxPduBufferRef = BUFFER_CAN0_Tx_0x300_Cyclic
        CanIfTxPduRef = CAN0_Tx_0x300_Cyclic
      BUFFER_CAN0_Tx_0x301_Event (CanIfBufferCfg): CanIfBufferSize=0, CanIfBufferHthRef=HTH_CAN0_Tx_0x301_Event
      TX_PDU_CAN0_Tx_0x301_Event (CanIfTxPduCfg):
        CanIfTxPduCanId = 769
        CanIfTxPduCanIdType = STANDARD_CAN
        CanIfTxPduId = CANIF_TXPDU_CAN0_Tx_0x301_Event
        CanIfTxPduPnFilterPdu = false
        CanIfTxPduReadNotifyStatus = false
        CanIfTxPduTriggerTransmit = false
        CanIfTxPduType = STATIC
        CanIfTxPduUserTriggerTransmitName = PduR_CanIfTriggerTransmit
        CanIfTxPduUserTxConfirmationName = PduR_CanIfTxConfirmation
        CanIfTxPduUserTxConfirmationUL = PDUR
        CanIfTxPduTruncation = true
        CanIfTxPduBufferRef = BUFFER_CAN0_Tx_0x301_Event
        CanIfTxPduRef = CAN0_Tx_0x301_Event
      BUFFER_CAN0_Tx_0x302_Mixed (CanIfBufferCfg): CanIfBufferSize=0, CanIfBufferHthRef=HTH_CAN0_Tx_0x302_Mixed
      TX_PDU_CAN0_Tx_0x302_Mixed (CanIfTxPduCfg):
        CanIfTxPduCanId = 770
        CanIfTxPduCanIdType = STANDARD_CAN
        CanIfTxPduId = CANIF_TXPDU_CAN0_Tx_0x302_Mixed
        CanIfTxPduPnFilterPdu = false
        CanIfTxPduReadNotifyStatus = false
        CanIfTxPduTriggerTransmit = false
        CanIfTxPduType = STATIC
        CanIfTxPduUserTriggerTransmitName = PduR_CanIfTriggerTransmit
        CanIfTxPduUserTxConfirmationName = PduR_CanIfTxConfirmation
        CanIfTxPduUserTxConfirmationUL = PDUR
        CanIfTxPduTruncation = true
        CanIfTxPduBufferRef = BUFFER_CAN0_Tx_0x302_Mixed
        CanIfTxPduRef = CAN0_Tx_0x302_Mixed
      BUFFER_CAN0_Tx_0x303_Cyclic_Counter (CanIfBufferCfg): CanIfBufferSize=0, CanIfBufferHthRef=HTH_CAN0_Tx_0x303_Cyclic_Counter
      TX_PDU_CAN0_Tx_0x303_Cyclic_Counter (CanIfTxPduCfg):
        CanIfTxPduCanId = 771
        CanIfTxPduCanIdType = STANDARD_CAN
        CanIfTxPduId = CANIF_TXPDU_CAN0_Tx_0x303_Cyclic_Counter
        CanIfTxPduPnFilterPdu = false
        CanIfTxPduReadNotifyStatus = false
        CanIfTxPduTriggerTransmit = false
        CanIfTxPduType = STATIC
        CanIfTxPduUserTriggerTransmitName = PduR_CanIfTriggerTransmit
        CanIfTxPduUserTxConfirmationName = PduR_CanIfTxConfirmation
        CanIfTxPduUserTxConfirmationUL = PDUR
        CanIfTxPduTruncation = true
        CanIfTxPduBufferRef = BUFFER_CAN0_Tx_0x303_Cyclic_Counter
        CanIfTxPduRef = CAN0_Tx_0x303_Cyclic_Counter
      RX_PDU_CAN0_Rx_0x708_Diag_Phy_Request (CanIfRxPduCfg):
        CanIfRxPduCanId = 1800
        CanIfRxPduCanIdType = STANDARD_NO_FD_CAN
        CanIfRxPduId = CANIF_RXPDU_CAN0_Rx_0x708_Diag_Phy_Request
        CanIfRxPduReadData = false
        CanIfRxPduReadNotifyStatus = false
        CanIfRxPduUserRxIndicationName = CanTp_RxIndication
        CanIfRxPduUserRxIndicationUL = CAN_TP
        CanIfRxPduDataLength = 8
        CanIfRxPduDataLengthCheck = true
        CanIfRxPduHrhIdRef = HRH_CAN0_Rx_0x708_Diag_Phy_Request
        CanIfRxPduRef = CAN0_Rx_0x708_Diag_Phy_Request
      RX_PDU_CAN0_Rx_0x7df_Diag_Fun_Request (CanIfRxPduCfg):
        CanIfRxPduCanId = 2015
        CanIfRxPduCanIdType = STANDARD_NO_FD_CAN
        CanIfRxPduId = CANIF_RXPDU_CAN0_Rx_0x7df_Diag_Fun_Request
        CanIfRxPduReadData = false
        CanIfRxPduReadNotifyStatus = false
        CanIfRxPduUserRxIndicationName = CanTp_RxIndication
        CanIfRxPduUserRxIndicationUL = CAN_TP
        CanIfRxPduDataLength = 8
        CanIfRxPduDataLengthCheck = true
        CanIfRxPduHrhIdRef = HRH_CAN0_Rx_0x7df_Diag_Fun_Request
        CanIfRxPduRef = CAN0_Rx_0x7df_Diag_Fun_Request
      TX_PDU_CAN0_Tx_0x709_Diag_Phy_Response (CanIfTxPduCfg):
        CanIfTxPduCanId = 1801
        CanIfTxPduCanIdType = STANDARD_CAN
        CanIfTxPduId = CANIF_TXPDU_CAN0_Tx_0x709_Diag_Phy_Response
        CanIfTxPduPnFilterPdu = false
        CanIfTxPduReadNotifyStatus = false
        CanIfTxPduTriggerTransmit = false
        CanIfTxPduType = STATIC
        CanIfTxPduUserTriggerTransmitName = CanTp_TriggerTransmit
        CanIfTxPduUserTxConfirmationName = CanTp_TxConfirmation
        CanIfTxPduUserTxConfirmationUL = CAN_TP
        CanIfTxPduTruncation = true
        CanIfTxPduBufferRef = BUFFER_CAN0_Tx_0x709_Diag_Phy_Response
        CanIfTxPduRef = CAN0_Tx_0x709_Diag_Phy_Response
      BUFFER_CAN0_Tx_0x709_Diag_Phy_Response (CanIfBufferCfg): CanIfBufferSize=2, CanIfBufferHthRef=HTH_CAN0_Tx_0x709_Diag_Phy_Response
      RX_PDU_CAN0_Rx_0x5xx_NM_ECU (CanIfRxPduCfg):
        CanIfRxPduCanId = 1280
        CanIfRxPduCanIdType = STANDARD_CAN
        CanIfRxPduId = CANIF_RXPDU_CAN0_Rx_0x5xx_NM_ECU
        CanIfRxPduReadData = false
        CanIfRxPduReadNotifyStatus = false
        CanIfRxPduUserRxIndicationName = CanNm_RxIndication
        CanIfRxPduUserRxIndicationUL = CAN_NM
        CanIfRxPduCanIdMask = 1792
        CanIfRxPduDataLength = 8
        CanIfRxPduDataLengthCheck = true
        CanIfRxPduHrhIdRef = HRH_CAN0_Rx_0x5xx_NM_ECU
        CanIfRxPduRef = CAN0_Rx_0x5xx_NM_ECU
      BUFFER_CAN0_Tx_0x501_NM_ECU (CanIfBufferCfg): CanIfBufferSize=0, CanIfBufferHthRef=HTH_CAN0_Tx_0x501_NM_ECU
      TX_PDU_CAN0_Tx_0x501_NM_ECU (CanIfTxPduCfg):
        CanIfTxPduCanId = 1281
        CanIfTxPduCanIdType = STANDARD_CAN
        CanIfTxPduId = CANIF_TXPDU_CAN0_Tx_0x501_NM_ECU
        CanIfTxPduPnFilterPdu = false
        CanIfTxPduReadNotifyStatus = false
        CanIfTxPduTriggerTransmit = false
        CanIfTxPduType = STATIC
        CanIfTxPduUserTriggerTransmitName = CanNm_TriggerTransmit
        CanIfTxPduUserTxConfirmationName = CanNm_TxConfirmation
        CanIfTxPduUserTxConfirmationUL = CAN_NM
        CanIfTxPduTruncation = true
        CanIfTxPduBufferRef = BUFFER_CAN0_Tx_0x501_NM_ECU
        CanIfTxPduRef = CAN0_Tx_0x501_NM_ECU
      RX_PDU_CAN0_Rx_0x260_E2E_P01 (CanIfRxPduCfg):
        CanIfRxPduCanId = 608
        CanIfRxPduCanIdType = STANDARD_CAN
        CanIfRxPduId = CANIF_RXPDU_CAN0_Rx_0x260_E2E_P01
        CanIfRxPduReadData = false
        CanIfRxPduReadNotifyStatus = false
        CanIfRxPduUserRxIndicationName = PduR_CanIfRxIndication
        CanIfRxPduUserRxIndicationUL = PDUR
        CanIfRxPduDataLength = 8
        CanIfRxPduDataLengthCheck = true
        CanIfRxPduHrhIdRef = HRH_CAN0_Rx_COM
        CanIfRxPduRef = CAN0_Rx_0x260_E2E_P01
      BUFFER_CAN0_Tx_0x360_E2E_P01 (CanIfBufferCfg): CanIfBufferSize=0, CanIfBufferHthRef=HTH_CAN0_Tx_0x360_E2E_P01
      TX_PDU_CAN0_Tx_0x360_E2E_P01 (CanIfTxPduCfg):
        CanIfTxPduCanId = 864
        CanIfTxPduCanIdType = STANDARD_CAN
        CanIfTxPduId = CANIF_TXPDU_CAN0_Tx_0x360_E2E_P01
        CanIfTxPduPnFilterPdu = false
        CanIfTxPduReadNotifyStatus = false
        CanIfTxPduTriggerTransmit = false
        CanIfTxPduType = STATIC
        CanIfTxPduUserTriggerTransmitName = PduR_CanIfTriggerTransmit
        CanIfTxPduUserTxConfirmationName = PduR_CanIfTxConfirmation
        CanIfTxPduUserTxConfirmationUL = PDUR
        CanIfTxPduTruncation = true
        CanIfTxPduBufferRef = BUFFER_CAN0_Tx_0x360_E2E_P01
        CanIfTxPduRef = CAN0_Tx_0x360_E2E_P01
      TX_PDU_CAN0_Tx_0x304_Cyclic_Counter (CanIfTxPduCfg):
        CanIfTxPduCanId = 772
        CanIfTxPduCanIdType = STANDARD_CAN
        CanIfTxPduId = CANIF_TXPDU_CAN0_Tx_0x304_Cyclic_Counter
        CanIfTxPduPnFilterPdu = false
        CanIfTxPduReadNotifyStatus = false
        CanIfTxPduTriggerTransmit = false
        CanIfTxPduType = STATIC
        CanIfTxPduUserTriggerTransmitName = PduR_CanIfTriggerTransmit
        CanIfTxPduUserTxConfirmationName = PduR_CanIfTxConfirmation
        CanIfTxPduUserTxConfirmationUL = PDUR
        CanIfTxPduTruncation = true
        CanIfTxPduBufferRef = BUFFER_CAN0_Tx_0x304_Cyclic_Counter
        CanIfTxPduRef = CAN0_Tx_0x304_Cyclic_Counter
      BUFFER_CAN0_Tx_0x304_Cyclic_Counter (CanIfBufferCfg): CanIfBufferSize=0, CanIfBufferHthRef=HTH_CAN0_Tx_0x304_Cyclic_Counter
      TX_PDU_CAN0_Tx_0x18C4D2D0_Cyclic_Counter (CanIfTxPduCfg):
        CanIfTxPduCanId = 415552208
        CanIfTxPduCanIdType = EXTENDED_CAN
        CanIfTxPduId = CANIF_TXPDU_CAN0_Tx_0x18C4D2D0_Cyclic_Counter
        CanIfTxPduPnFilterPdu = false
        CanIfTxPduReadNotifyStatus = false
        CanIfTxPduTriggerTransmit = false
        CanIfTxPduType = STATIC
        CanIfTxPduUserTriggerTransmitName = PduR_CanIfTriggerTransmit
        CanIfTxPduUserTxConfirmationName = PduR_CanIfTxConfirmation
        CanIfTxPduUserTxConfirmationUL = PDUR
        CanIfTxPduTruncation = true
        CanIfTxPduBufferRef = BUFFER_CAN0_Tx_0x18C4D2D0_Cyclic_Counter
        CanIfTxPduRef = CAN0_Tx_0x18C4D2D0_Cyclic_Counter
      BUFFER_CAN0_Tx_0x18C4D2D0_Cyclic_Counter (CanIfBufferCfg): CanIfBufferSize=0, CanIfBufferHthRef=HTH_CAN0_Tx_0x18C4D2D0_Cyclic_Counter
    CanIfPrivateCfg: CanIfPrivateSoftwareFilterType=LINEAR, CanIfSupportTTCAN=false, CanIfPrivateDataLengthCheck=true
    CanIfPublicCfg:
      CanIfMetaDataSupport = false
      CanIfPublicCancelTransmitSupport = false
      CanIfPublicHandleTypeEnum = UINT16
      CanIfPublicIcomSupport = false
      CanIfPublicMultipleDrvSupport = true
      CanIfPublicPnSupport = false
      CanIfPublicReadRxPduDataApi = false
      CanIfPublicReadRxPduNotifyStatusApi = false
      CanIfPublicReadTxPduNotifyStatusApi = false
      CanIfPublicSetDynamicTxIdApi = false
      CanIfPublicTxBuffering = true
      CanIfPublicTxConfirmPollingSupport = true
      CanIfPublicWakeupCheckValidByNM = false
      CanIfPublicWakeupCheckValidSupport = false
      CanIfSetBaudrateApi = false
      CanIfTriggerTransmitSupport = false
      CanIfTxOfflineActiveSupport = false
      CanIfWakeupSupport = true
      CanIfPublicCanIdTypeEnum = UINT32
      CanIfConfigType = PC_CONFIG
      CanIfPublicCtrlDrvVersion = AUTOSAR431
      CanIfBusMirroringSupport = false
      CanIfDevErrorDetect = false
      CanIfVersionInfoApi = false
