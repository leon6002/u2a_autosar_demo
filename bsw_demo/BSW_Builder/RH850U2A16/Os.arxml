AUTOSAR XML (schema 00048)
package /RH850U2A16
  module config Os
    OsOS:
      OsMaxNumberOfCores = 4
      OsPhyIdOfCores = 0,1,2,3
      OsLoadRatio = false
      OsNumberOfCores = 4
      OsScalabilityClass = SC1
      Compiler = GreenHills
      SingleCore = 0
      OsSystemStackSize = 2048
      OsStackMonitoring = false
      OsStatus = STANDARD
      OsUseOrti = false
      OsUseGetServiceId = false
      OsUseParameterAccess = false
      OsUseResScheduler = true
      OsStackUsageMeasurement = false
      OsHooks: OsErrorHook=true, OsPostTaskHook=false, OsPreTaskHook=false, OsShutdownHook=true, OsStartupHook=true
      OsTrace: Os_Trace=false
    OSDEFAULTAPPMODE (OsAppMode)
    Counter (OsCounter)
      4 x SystemTimer_Core, all with OsCounterMaxAllowedValue=2147483647, OsCounterMinCycle=1, OsCounterTicksPerBase=1, OsCounterType=HARDWARE, OsSecondsPerTick=0.001:
        SystemTimer_Core_{0..3}
    SystemIsr
      4 x OsTimerSourceCore, all with OsPriority=9, OsNestedEnable=false, OsSystemTimerCpuFrequency=80, OsSecondsTick=0.001, OsIsrStackSize=512:
        OsTimerSourceCore_{0..3}: OsTimerSource=OSTM{0..3}TINT
      4 x OsTimingProtTimerSourceCore, all with OsTimingProtPriority=10, OsTimingProtNestedEnable=false, OsTimingProtCpuFrequency=60, OsTimingProtSecondsTick=0.001, OsTimingProtTimerSource=NULL, OsIsrStackSize=512:
        OsTimingProtTimerSourceCore_{0..3}
      4 x OsRemoteSource, all with OsRemotePriority=1, OsRemoteNestedEnable=false, OsRemoteTimerSource=IPIR0, OsIsrStackSize=512:
        OsRemoteSource_{0..3}
    RES_SCHEDULER_CORE0 (OsResource): OsResourceProperty=STANDARD
    RCANGERR0 (OsIsr): OsIsrCategory=CATEGORY_2
      OsIsrSettings: OsIsrStackSize=512, OsInterruptSource=RCANGERR0, OsInterruptSourceId=296, OsInterruptLevel=1, OsIsrNestedEnable=false
    RCANGRECC0 (OsIsr): OsIsrCategory=CATEGORY_2
      OsIsrSettings: OsIsrStackSize=512, OsInterruptSource=RCANGRECC0, OsInterruptSourceId=297, OsInterruptLevel=2, OsIsrNestedEnable=false
    iSoft_Auto_OsTask_10ms_BSW (OsTask): OsTaskActivation=1, OsTaskPriority=25, OsTaskSchedule=FULL, OsTaskStackSize=256, OsTaskPeriod=0.01, OsTaskEventRef=iSoft_Auto_OsEvent_10ms_BSW
    iSoft_Auto_OsEvent_10ms_BSW (OsEvent)
    iSoft_Auto_OsAlarm_10ms_BSW (OsAlarm): OsAlarmCounterRef=SystemTimer_Core_0
      OsAlarmAction
        OsAlarmSetEvent: OsAlarmSetEventRef=iSoft_Auto_OsEvent_10ms_BSW, OsAlarmSetEventTaskRef=iSoft_Auto_OsTask_10ms_BSW
    iSoft_Auto_OsTask_5ms_BSW (OsTask): OsTaskActivation=1, OsTaskPriority=25, OsTaskSchedule=FULL, OsTaskStackSize=256, OsTaskPeriod=0.005, OsTaskEventRef=iSoft_Auto_OsEvent_5ms_BSW
    iSoft_Auto_OsEvent_5ms_BSW (OsEvent)
    iSoft_Auto_OsAlarm_5ms_BSW (OsAlarm): OsAlarmCounterRef=SystemTimer_Core_0
      OsAlarmAction
        OsAlarmSetEvent: OsAlarmSetEventRef=iSoft_Auto_OsEvent_5ms_BSW, OsAlarmSetEventTaskRef=iSoft_Auto_OsTask_5ms_BSW
    iSoft_Auto_OsTask_1ms_BSW (OsTask): OsTaskActivation=1, OsTaskPriority=25, OsTaskSchedule=FULL, OsTaskStackSize=256, OsTaskPeriod=0.001, OsTaskEventRef=iSoft_Auto_OsEvent_1ms_BSW
    iSoft_Auto_OsEvent_1ms_BSW (OsEvent)
    iSoft_Auto_OsAlarm_1ms_BSW (OsAlarm): OsAlarmCounterRef=SystemTimer_Core_0
      OsAlarmAction
        OsAlarmSetEvent: OsAlarmSetEventRef=iSoft_Auto_OsEvent_1ms_BSW, OsAlarmSetEventTaskRef=iSoft_Auto_OsTask_1ms_BSW
    OsIoc
    iSoft_Auto_DEFAULT_OsTask_Init (OsTask): OsTaskActivation=1, OsTaskPriority=63, OsTaskSchedule=NON, OsTaskStackSize=1024
      OsTaskAutostart: OsTaskAppModeRef=OSDEFAULTAPPMODE
    iSoft_Auto_OsTask_100ms (OsTask): OsTaskActivation=1, OsTaskPriority=1, OsTaskSchedule=FULL, OsTaskStackSize=256, OsTaskPeriod=0.1
    iSoft_Auto_OsAlarm_100ms (OsAlarm): OsAlarmCounterRef=SystemTimer_Core_0
      OsAlarmAction
        OsAlarmActivateTask: OsAlarmActivateTaskRef=iSoft_Auto_OsTask_100ms
      OsAlarmAutostart: OsAlarmAlarmTime=100, OsAlarmAutostartType=ABSOLUTE, OsAlarmCycleTime=100, OsAlarmAppModeRef=OSDEFAULTAPPMODE
    4 x OsIsr, all with OsIsrCategory=CATEGORY_2:
      RCAN2ERR
        OsIsrSettings: OsIsrStackSize=512, OsInterruptSource=RCAN2ERR, OsInterruptSourceId=304, OsInterruptLevel=3, OsIsrNestedEnable=false
      RCAN2REC
        OsIsrSettings: OsIsrStackSize=512, OsInterruptSource=RCAN2REC, OsInterruptSourceId=305, OsInterruptLevel=4, OsIsrNestedEnable=false
      RCAN2TRX
        OsIsrSettings: OsIsrStackSize=512, OsInterruptSource=RCAN2TRX, OsInterruptSourceId=306, OsInterruptLevel=5, OsIsrNestedEnable=false
      WDTB0TIT
        OsIsrSettings: OsIsrStackSize=512, OsInterruptSource=WDTB0TIT, OsInterruptSourceId=22, OsInterruptLevel=6, OsIsrNestedEnable=false
    3 x OsResource, all with OsResourceProperty=STANDARD:
      RES_SCHEDULER_CORE{1..3}
    4 x OsApplication, all with OsTrusted=false, OsTrustedApplicationDelayTimingViolationCall=false, OsTrustedApplicationWithProtection=false:
      OsApplication_0: OsApplicationCoreRef=0, OsAppAlarmRef=iSoft_Auto_OsAlarm_10ms_BSW, OsAppAlarmRef=iSoft_Auto_OsAlarm_5ms_BSW, OsAppAlarmRef=iSoft_Auto_OsAlarm_1ms_BSW, OsAppAlarmRef=iSoft_Auto_OsAlarm_100ms, OsAppIsrRef=RCANGERR0, OsAppIsrRef=RCANGRECC0, OsAppIsrRef=RCAN2ERR, OsAppIsrRef=RCAN2REC, OsAppIsrRef=RCAN2TRX, OsAppIsrRef=WDTB0TIT, OsAppTaskRef=iSoft_Auto_OsTask_10ms_BSW, OsAppTaskRef=iSoft_Auto_OsTask_5ms_BSW, OsAppTaskRef=iSoft_Auto_OsTask_1ms_BSW, OsAppTaskRef=iSoft_Auto_DEFAULT_OsTask_Init, OsAppTaskRef=iSoft_Auto_OsTask_100ms
        OsApplicationHooks
      OsApplication_1: OsApplicationCoreRef=1, OsAppAlarmRef=OsAlarm_100ms_c1, OsAppTaskRef=OsTask_100ms_c1
        OsApplicationHooks
      OsApplication_2: OsApplicationCoreRef=2, OsAppTaskRef=OsTask_100ms_c2, OsAppAlarmRef=OsAlarm_100ms_c2
        OsApplicationHooks
      OsApplication_3: OsApplicationCoreRef=3, OsAppAlarmRef=OsAlarm_100ms_c3, OsAppTaskRef=OsTask_100ms_c3
        OsApplicationHooks
    3 x OsTask, all with OsTaskActivation=1, OsTaskPriority=1, OsTaskSchedule=FULL, OsTaskStackSize=256:
      OsTask_100ms_c{1..3}
    3 x OsAlarm:
      OsAlarm_100ms_c1: OsAlarmCounterRef=SystemTimer_Core_1
        OsAlarmAction
          OsAlarmActivateTask: OsAlarmActivateTaskRef=OsTask_100ms_c1
        OsAlarmAutostart: OsAlarmAlarmTime=100, OsAlarmAutostartType=ABSOLUTE, OsAlarmCycleTime=100, OsAlarmAppModeRef=OSDEFAULTAPPMODE
      OsAlarm_100ms_c2: OsAlarmCounterRef=SystemTimer_Core_2
        OsAlarmAction
          OsAlarmActivateTask: OsAlarmActivateTaskRef=OsTask_100ms_c2
        OsAlarmAutostart: OsAlarmAlarmTime=100, OsAlarmAutostartType=ABSOLUTE, OsAlarmCycleTime=100, OsAlarmAppModeRef=OSDEFAULTAPPMODE
      OsAlarm_100ms_c3: OsAlarmCounterRef=SystemTimer_Core_3
        OsAlarmAction
          OsAlarmActivateTask: OsAlarmActivateTaskRef=OsTask_100ms_c3
        OsAlarmAutostart: OsAlarmAlarmTime=100, OsAlarmAutostartType=ABSOLUTE, OsAlarmCycleTime=100, OsAlarmAppModeRef=OSDEFAULTAPPMODE
    iSoft_Auto_OsSpinlock_SchM (OsSpinlock):
      OsSpinlockLockMethod = LOCK_CAT2_INTERRUPTS
      OsSpinlockAccessingApplication = OsApplication_{0..3}
    iSoft_Auto_OsSpinlock_Rte (OsSpinlock):
      OsSpinlockLockMethod = LOCK_CAT2_INTERRUPTS
      OsSpinlockAccessingApplication = OsApplication_{0..3}
