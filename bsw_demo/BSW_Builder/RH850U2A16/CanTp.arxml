AUTOSAR XML (schema 00048)
package /RH850U2A16
  module config CanTp
    CanTpGeneral:
      CanTpConfigType = PC_CONFIG
      CanTpDevErrorDetect = false
      CanTpReadParameterApi = false
      CanTpChangeParameterApi = true
      CanTpVersionInfoApi = false
      CanTpPaddingByte = 170
      CanTpDiagGWResEnable = false
      CanTpSynchronousRxIndication = false
      CanTpRuntimeErrorDetect = false
      CanTpRxQueue = false
      CanTpSynchronousTransmission = false
      CanTpTimerType = MainFunction
    CanTpConfig: CanTpMainFunctionPeriod=0.005, CanTpMaxChannelCnt=1
      CanTpChannel: CanTpChannelMode=CANTP_MODE_HALF_DUPLEX
        CanTpRxNSdu_Phys_Req (CanTpRxNSdu):
          CanTpNbr = 0.01
          CanTpRxAddressingFormat = CANTP_STANDARD
          CanTpRxNSduId = CANTP_CANTP_CAN0_Rx_0x708_Diag_Phy_Request
          CanTpRxPaddingActivation = CANTP_ON
          CanTpRxTaType = CANTP_PHYSICAL
          CanTpBs = 0
          CanTpNar = 0.07
          CanTpNcr = 0.15
          CanTpRxWftMax = 255
          CanTpSTmin = 0.01
          CanTpRxNSduRef = CANTP_CAN0_Rx_0x708_Diag_Phy_Request
          CanTpRxNPdu: CanTpRxNPduId=CANTP_CAN0_Rx_0x708_Diag_Phy_Request, CanTpRxNPduRef=CAN0_Rx_0x708_Diag_Phy_Request
          CanTpTxFcNPdu: CanTpTxFcNPduConfirmationPduId=CANTP_CAN0_Tx_0x709_Diag_Phy_Response, CanTpTxFcNPduRef=CAN0_Tx_0x709_Diag_Phy_Response
        CanTpRxNSdu_Func_Req (CanTpRxNSdu):
          CanTpNbr = 0.01
          CanTpRxAddressingFormat = CANTP_STANDARD
          CanTpRxNSduId = CANTP_CANTP_CAN0_Rx_0x7df_Diag_Fun_Request
          CanTpRxPaddingActivation = CANTP_ON
          CanTpRxTaType = CANTP_FUNCTIONAL
          CanTpBs = 0
          CanTpNar = 0.07
          CanTpNcr = 0.15
          CanTpRxWftMax = 255
          CanTpSTmin = 0.01
          CanTpRxNSduRef = CANTP_CAN0_Rx_0x7df_Diag_Fun_Request
          CanTpRxNPdu: CanTpRxNPduId=CANTP_CAN0_Rx_0x7df_Diag_Fun_Request, CanTpRxNPduRef=CAN0_Rx_0x7df_Diag_Fun_Request
        CanTpTxNSdu_Resp_USDT (CanTpTxNSdu):
          CanTpNas = 0.07
          CanTpTc = false
          CanTpTxAddressingFormat = CANTP_STANDARD
          CanTpTxNSduId = CANTP_CANTP_CAN0_Tx_0x709_Diag_Phy_Response
          CanTpTxPaddingActivation = CANTP_ON
          CanTpTxTaType = CANTP_PHYSICAL
          CanTpNbs = 0.15
          CanTpNcs = 0.15
          CanTpTxNSduRef = CANTP_CAN0_Tx_0x709_Diag_Phy_Response
          CanTpTxNPdu: CanTpTxNPduConfirmationPduId=CANTP_CAN0_Tx_0x709_Diag_Phy_Response, CanTpTxNPduRef=CAN0_Tx_0x709_Diag_Phy_Response
          CanTpRxFcNPdu: CanTpRxFcNPduId=CANTP_CAN0_Rx_0x708_Diag_Phy_Request, CanTpRxFcNPduRef=CAN0_Rx_0x708_Diag_Phy_Request
