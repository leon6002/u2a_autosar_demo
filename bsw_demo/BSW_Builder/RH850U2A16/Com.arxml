AUTOSAR XML (schema 00048)
package /RH850U2A16
  module config Com
    ComGeneral:
      ComCancellationSupport = true
      ComConfigurationUseDet = true
      ComVersionInfoApi = false
      ComEnableMDTForCyclicTransmission = true
      ComEnableSignalGroupArrayApi = false
      ComMetaDataSupport = false
      ComRetryFailedTransmitRequests = false
      ComSupportedIPduGroups = 6
      ComConfigType = PC_CONFIG
    ComConfig
      Com_RxPduGroup_CanController_0 (ComIPduGroup): ComIPduGroupHandleId=Com_RxPduGroup_CanController_0
      Com_TxPduGroup_CanController_0 (ComIPduGroup): ComIPduGroupHandleId=Com_TxPduGroup_CanController_0
      IPDU_COM_CAN0_Rx_0x251_Cyclic_PN29 (ComIPdu):
        ComIPduCancellationSupport = false
        ComIPduDirection = RECEIVE
        ComIPduHandleId = COM_RXPDU_COM_CAN0_Rx_0x251_Cyclic_PN29
        ComIPduSignalProcessing = DEFERRED
        ComIPduType = NORMAL
        ComPduIdRef = COM_CAN0_Rx_0x251_Cyclic_PN29
        ComIPduSignalRef = CAN0_Rx_0x251_Cyclic_PN29_Sig_IPDU_COM_CAN0_Rx_0x251_Cyclic_PN29
        ComIPduGroupRef = ComIPduGroup_PN29_Rx
      CAN0_Rx_0x251_Cyclic_PN29_Sig_IPDU_COM_CAN0_Rx_0x251_Cyclic_PN29 (ComSignal):
        ComBitPosition = 8
        ComBitSize = 16
        ComHandleId = CAN0_Rx_0x251_Cyclic_PN29_Sig_IPDU_COM_CAN0_Rx_0x251_Cyclic_PN29
        ComSignalEndianness = BIG_ENDIAN
        ComSignalInitValue = 0x0
        ComSignalLength = 0
        ComSignalType = UINT16
        ComInvalidNotification = NULL_PTR
        ComRxDataTimeoutAction = NONE
        ComInitialValueOnly = false
        ComTransferProperty = PENDING
        ComNotification = Rte_COMCbk
        ComDataInvalidAction = NOTIFY
      IPDU_COM_CAN0_Rx_0x250_Cyclic_PN17 (ComIPdu):
        ComIPduCancellationSupport = false
        ComIPduDirection = RECEIVE
        ComIPduHandleId = COM_RXPDU_COM_CAN0_Rx_0x250_Cyclic_PN17
        ComIPduSignalProcessing = DEFERRED
        ComIPduType = NORMAL
        ComPduIdRef = COM_CAN0_Rx_0x250_Cyclic_PN17
        ComIPduSignalRef = CAN0_Rx_0x250_Cyclic_PN17_Sig_IPDU_COM_CAN0_Rx_0x250_Cyclic_PN17
        ComIPduGroupRef = ComIPduGroup_PN17_Rx
      CAN0_Rx_0x250_Cyclic_PN17_Sig_IPDU_COM_CAN0_Rx_0x250_Cyclic_PN17 (ComSignal):
        ComBitPosition = 8
        ComBitSize = 16
        ComHandleId = CAN0_Rx_0x250_Cyclic_PN17_Sig_IPDU_COM_CAN0_Rx_0x250_Cyclic_PN17
        ComSignalEndianness = BIG_ENDIAN
        ComSignalInitValue = 0x0
        ComSignalLength = 0
        ComSignalType = UINT16
        ComInvalidNotification = NULL_PTR
        ComRxDataTimeoutAction = NONE
        ComInitialValueOnly = false
        ComTransferProperty = PENDING
        ComNotification = Rte_COMCbk
        ComDataInvalidAction = NOTIFY
      IPDU_COM_CAN0_Rx_0x200_Cyclic (ComIPdu):
        ComIPduCancellationSupport = false
        ComIPduDirection = RECEIVE
        ComIPduHandleId = COM_RXPDU_COM_CAN0_Rx_0x200_Cyclic
        ComIPduSignalProcessing = DEFERRED
        ComIPduType = NORMAL
        ComPduIdRef = COM_CAN0_Rx_0x200_Cyclic
        ComIPduSignalRef = CAN0_Rx_0x200_Sig_4_U31_IPDU_COM_CAN0_Rx_0x200_Cyclic
        ComIPduSignalRef = CAN0_Rx_0x200_Sig_3_U15_IPDU_COM_CAN0_Rx_0x200_Cyclic
        ComIPduSignalRef = CAN0_Rx_0x200_Sig_2_U6_IPDU_COM_CAN0_Rx_0x200_Cyclic
        ComIPduSignalRef = CAN0_Rx_0x200_Sig_1_U4_IPDU_COM_CAN0_Rx_0x200_Cyclic
        ComIPduGroupRef = Com_RxPduGroup_CanController_0
      4 x ComSignal, all with ComSignalEndianness=BIG_ENDIAN, ComSignalInitValue=0x0, ComSignalLength=0, ComInvalidNotification=NULL_PTR, ComRxDataTimeoutAction=NONE, ComInitialValueOnly=false, ComTransferProperty=PENDING, ComNotification=Rte_COMCbk, ComDataInvalidAction=NOTIFY:
        CAN0_Rx_0x200_Sig_4_U31_IPDU_COM_CAN0_Rx_0x200_Cyclic: ComBitPosition=57, ComBitSize=31, ComHandleId=CAN0_Rx_0x200_Sig_4_U31_IPDU_COM_CAN0_Rx_0x200_Cyclic, ComSignalType=UINT32, ComUpdateBitPosition=56, ComFirstTimeout=5.0
        CAN0_Rx_0x200_Sig_3_U15_IPDU_COM_CAN0_Rx_0x200_Cyclic: ComBitPosition=25, ComBitSize=15, ComHandleId=CAN0_Rx_0x200_Sig_3_U15_IPDU_COM_CAN0_Rx_0x200_Cyclic, ComSignalType=UINT16, ComUpdateBitPosition=24
        CAN0_Rx_0x200_Sig_2_U6_IPDU_COM_CAN0_Rx_0x200_Cyclic: ComBitPosition=10, ComBitSize=6, ComHandleId=CAN0_Rx_0x200_Sig_2_U6_IPDU_COM_CAN0_Rx_0x200_Cyclic, ComSignalType=UINT8, ComUpdateBitPosition=9
        CAN0_Rx_0x200_Sig_1_U4_IPDU_COM_CAN0_Rx_0x200_Cyclic: ComBitPosition=4, ComBitSize=4, ComHandleId=CAN0_Rx_0x200_Sig_1_U4_IPDU_COM_CAN0_Rx_0x200_Cyclic, ComSignalType=UINT8, ComUpdateBitPosition=3
      IPDU_COM_CAN0_Rx_0x201_Event (ComIPdu):
        ComIPduCancellationSupport = false
        ComIPduDirection = RECEIVE
        ComIPduHandleId = COM_RXPDU_COM_CAN0_Rx_0x201_Event
        ComIPduSignalProcessing = DEFERRED
        ComIPduType = NORMAL
        ComIPduCallout = IPDU_COM_CAN0_Rx_0x201_Callout
        ComPduIdRef = COM_CAN0_Rx_0x201_Event
        ComIPduSignalRef = CAN0_Rx_0x201_Sig_4_U32_IPDU_COM_CAN0_Rx_0x201_Event
        ComIPduSignalRef = CAN0_Rx_0x201_Sig_3_U16_IPDU_COM_CAN0_Rx_0x201_Event
        ComIPduSignalRef = CAN0_Rx_0x201_Sig_2_U8_IPDU_COM_CAN0_Rx_0x201_Event
        ComIPduSignalRef = CAN0_Rx_0x201_Sig_1_U3_IPDU_COM_CAN0_Rx_0x201_Event
        ComIPduGroupRef = Com_RxPduGroup_CanController_0
      4 x ComSignal, all with ComSignalEndianness=BIG_ENDIAN, ComSignalInitValue=0x0, ComSignalLength=0, ComInvalidNotification=NULL_PTR, ComRxDataTimeoutAction=NONE, ComInitialValueOnly=false, ComTransferProperty=PENDING, ComNotification=Rte_COMCbk:
        CAN0_Rx_0x201_Sig_4_U32_IPDU_COM_CAN0_Rx_0x201_Event: ComBitPosition=56, ComBitSize=32, ComHandleId=CAN0_Rx_0x201_Sig_4_U32_IPDU_COM_CAN0_Rx_0x201_Event, ComSignalType=UINT32
        CAN0_Rx_0x201_Sig_3_U16_IPDU_COM_CAN0_Rx_0x201_Event: ComBitPosition=28, ComBitSize=16, ComHandleId=CAN0_Rx_0x201_Sig_3_U16_IPDU_COM_CAN0_Rx_0x201_Event, ComSignalType=UINT16
        CAN0_Rx_0x201_Sig_2_U8_IPDU_COM_CAN0_Rx_0x201_Event: ComBitPosition=12, ComBitSize=8, ComHandleId=CAN0_Rx_0x201_Sig_2_U8_IPDU_COM_CAN0_Rx_0x201_Event, ComSignalType=UINT8, ComDataInvalidAction=NOTIFY, ComSignalDataInvalidValue=0xff
        CAN0_Rx_0x201_Sig_1_U3_IPDU_COM_CAN0_Rx_0x201_Event: ComBitPosition=5, ComBitSize=3, ComHandleId=CAN0_Rx_0x201_Sig_1_U3_IPDU_COM_CAN0_Rx_0x201_Event, ComSignalType=UINT8, ComDataInvalidAction=NOTIFY
      IPDU_COM_CAN0_Rx_0x202_Mixed (ComIPdu):
        ComIPduCancellationSupport = false
        ComIPduDirection = RECEIVE
        ComIPduHandleId = COM_RXPDU_COM_CAN0_Rx_0x202_Mixed
        ComIPduSignalProcessing = DEFERRED
        ComIPduType = NORMAL
        ComIPduCallout = IPDU_COM_CAN0_Rx_0x202_Mixed_Callout
        ComPduIdRef = COM_CAN0_Rx_0x202_Mixed
        ComIPduSignalRef = CAN0_Rx_0x202_Sig_7_U2_IPDU_COM_CAN0_Rx_0x202_Mixed
        ComIPduSignalRef = CAN0_Rx_0x202_Sig_6_U1_IPDU_COM_CAN0_Rx_0x202_Mixed
        ComIPduSignalRef = CAN0_Rx_0x202_Sig_4_U8_IPDU_COM_CAN0_Rx_0x202_Mixed
        ComIPduSignalRef = CAN0_Rx_0x202_Sig_3_U16_IPDU_COM_CAN0_Rx_0x202_Mixed
        ComIPduSignalRef = CAN0_Rx_0x202_Sig_2_U8_IPDU_COM_CAN0_Rx_0x202_Mixed
        ComIPduSignalRef = CAN0_Rx_0x202_Sig_1_U4_IPDU_COM_CAN0_Rx_0x202_Mixed
        ComIPduSignalRef = CAN0_Rx_0x202_Sig_5_U1_IPDU_COM_CAN0_Rx_0x202_Mixed
        ComIPduGroupRef = Com_RxPduGroup_CanController_0
      7 x ComSignal, all with ComSignalEndianness=BIG_ENDIAN, ComSignalInitValue=0x0, ComSignalLength=0, ComInvalidNotification=NULL_PTR, ComRxDataTimeoutAction=NONE, ComInitialValueOnly=false, ComTransferProperty=PENDING, ComNotification=Rte_COMCbk:
        CAN0_Rx_0x202_Sig_7_U2_IPDU_COM_CAN0_Rx_0x202_Mixed: ComBitPosition=51, ComBitSize=2, ComHandleId=CAN0_Rx_0x202_Sig_7_U2_IPDU_COM_CAN0_Rx_0x202_Mixed, ComSignalType=UINT8, ComTimeout=2.5, ComTimeoutNotification=Rte_COMCbkRxTOut, ComFirstTimeout=2.5
        CAN0_Rx_0x202_Sig_6_U1_IPDU_COM_CAN0_Rx_0x202_Mixed: ComBitPosition=11, ComBitSize=1, ComHandleId=CAN0_Rx_0x202_Sig_6_U1_IPDU_COM_CAN0_Rx_0x202_Mixed, ComSignalType=BOOLEAN, ComDataInvalidAction=NOTIFY
        CAN0_Rx_0x202_Sig_4_U8_IPDU_COM_CAN0_Rx_0x202_Mixed: ComBitPosition=32, ComBitSize=8, ComHandleId=CAN0_Rx_0x202_Sig_4_U8_IPDU_COM_CAN0_Rx_0x202_Mixed, ComSignalType=UINT8, ComDataInvalidAction=NOTIFY
        CAN0_Rx_0x202_Sig_3_U16_IPDU_COM_CAN0_Rx_0x202_Mixed: ComBitPosition=24, ComBitSize=16, ComHandleId=CAN0_Rx_0x202_Sig_3_U16_IPDU_COM_CAN0_Rx_0x202_Mixed, ComSignalType=UINT16, ComDataInvalidAction=NOTIFY
        CAN0_Rx_0x202_Sig_2_U8_IPDU_COM_CAN0_Rx_0x202_Mixed: ComBitPosition=12, ComBitSize=8, ComHandleId=CAN0_Rx_0x202_Sig_2_U8_IPDU_COM_CAN0_Rx_0x202_Mixed, ComSignalType=UINT8, ComDataInvalidAction=NOTIFY
        CAN0_Rx_0x202_Sig_1_U4_IPDU_COM_CAN0_Rx_0x202_Mixed: ComBitPosition=4, ComBitSize=4, ComHandleId=CAN0_Rx_0x202_Sig_1_U4_IPDU_COM_CAN0_Rx_0x202_Mixed, ComSignalType=UINT8, ComDataInvalidAction=NOTIFY
        CAN0_Rx_0x202_Sig_5_U1_IPDU_COM_CAN0_Rx_0x202_Mixed: ComBitPosition=47, ComBitSize=1, ComHandleId=CAN0_Rx_0x202_Sig_5_U1_IPDU_COM_CAN0_Rx_0x202_Mixed, ComSignalType=BOOLEAN, ComDataInvalidAction=NOTIFY
      IPDU_COM_CAN0_Rx_0x203_Cyclic_Counter (ComIPdu):
        ComIPduCancellationSupport = false
        ComIPduDirection = RECEIVE
        ComIPduHandleId = COM_RXPDU_COM_CAN0_Rx_0x203_Cyclic_Counter
        ComIPduSignalProcessing = DEFERRED
        ComIPduType = NORMAL
        ComPduIdRef = COM_CAN0_Rx_0x203_Cyclic_Counter
        ComIPduSignalRef = CAN0_Rx_0x203_Sig_4_U32_IPDU_COM_CAN0_Rx_0x203_Cyclic_Counter
        ComIPduSignalRef = CAN0_Rx_0x203_Sig_3_U16_IPDU_COM_CAN0_Rx_0x203_Cyclic_Counter
        ComIPduSignalRef = CAN0_Rx_0x203_Sig_2_U8_IPDU_COM_CAN0_Rx_0x203_Cyclic_Counter
        ComIPduSignalRef = CAN0_Rx_0x203_Sig_1_U4_IPDU_COM_CAN0_Rx_0x203_Cyclic_Counter
        ComIPduGroupRef = Com_RxPduGroup_CanController_0
        ComIPduCounter: ComIPduCounterSize=4, ComIPduCounterStartPosition=8, ComIPduCounterThreshold=15
      4 x ComSignal, all with ComSignalEndianness=BIG_ENDIAN, ComSignalInitValue=0x0, ComSignalLength=0, ComDataInvalidAction=NOTIFY, ComInvalidNotification=NULL_PTR, ComRxDataTimeoutAction=NONE, ComInitialValueOnly=false, ComTransferProperty=PENDING, ComNotification=Rte_COMCbk:
        CAN0_Rx_0x203_Sig_4_U32_IPDU_COM_CAN0_Rx_0x203_Cyclic_Counter: ComBitPosition=56, ComBitSize=32, ComHandleId=CAN0_Rx_0x203_Sig_4_U32_IPDU_COM_CAN0_Rx_0x203_Cyclic_Counter, ComSignalType=UINT32
        CAN0_Rx_0x203_Sig_3_U16_IPDU_COM_CAN0_Rx_0x203_Cyclic_Counter: ComBitPosition=24, ComBitSize=16, ComHandleId=CAN0_Rx_0x203_Sig_3_U16_IPDU_COM_CAN0_Rx_0x203_Cyclic_Counter, ComSignalType=UINT16
        CAN0_Rx_0x203_Sig_2_U8_IPDU_COM_CAN0_Rx_0x203_Cyclic_Counter: ComBitPosition=12, ComBitSize=8, ComHandleId=CAN0_Rx_0x203_Sig_2_U8_IPDU_COM_CAN0_Rx_0x203_Cyclic_Counter, ComSignalType=UINT8
        CAN0_Rx_0x203_Sig_1_U4_IPDU_COM_CAN0_Rx_0x203_Cyclic_Counter: ComBitPosition=4, ComBitSize=4, ComHandleId=CAN0_Rx_0x203_Sig_1_U4_IPDU_COM_CAN0_Rx_0x203_Cyclic_Counter, ComSignalType=UINT8
      IPDU_COM_CAN0_Tx_0x351_Cyclic_PN29 (ComIPdu):
        ComIPduCancellationSupport = false
        ComIPduDirection = SEND
        ComIPduHandleId = COM_TXPDU_COM_CAN0_Tx_0x351_Cyclic_PN29
        ComIPduSignalProcessing = DEFERRED
        ComIPduType = NORMAL
        ComPduIdRef = COM_CAN0_Tx_0x351_Cyclic_PN29
        ComIPduSignalRef = CAN0_Tx_0x351_Cyclic_PN29_Sig_IPDU_COM_CAN0_Tx_0x351_Cyclic_PN29
        ComIPduGroupRef = ComIPduGroup_PN29_Tx
        ComTxIPdu: ComMinimumDelayTime=0.0, ComTxIPduClearUpdateBit=Confirmation, ComTxIPduUnusedAreasDefault=0
          ComTxModeTrue
            ComTxMode: ComTxModeMode=PERIODIC, ComTxModeNumberOfRepetitions=0, ComTxModeRepetitionPeriod=0.0, ComTxModeTimeOffset=0.005, ComTxModeTimePeriod=0.1
      CAN0_Tx_0x351_Cyclic_PN29_Sig_IPDU_COM_CAN0_Tx_0x351_Cyclic_PN29 (ComSignal):
        ComBitPosition = 8
        ComBitSize = 16
        ComHandleId = CAN0_Tx_0x351_Cyclic_PN29_Sig_IPDU_COM_CAN0_Tx_0x351_Cyclic_PN29
        ComSignalEndianness = BIG_ENDIAN
        ComSignalInitValue = 0x0
        ComSignalLength = 0
        ComSignalType = UINT16
        ComDataInvalidAction = NOTIFY
        ComInvalidNotification = NULL_PTR
        ComRxDataTimeoutAction = NONE
        ComInitialValueOnly = false
        ComTransferProperty = PENDING
      IPDU_COM_CAN0_Tx_0x350_Cyclic_PN17 (ComIPdu):
        ComIPduCancellationSupport = false
        ComIPduDirection = SEND
        ComIPduHandleId = COM_TXPDU_COM_CAN0_Tx_0x350_Cyclic_PN17
        ComIPduSignalProcessing = DEFERRED
        ComIPduType = NORMAL
        ComPduIdRef = COM_CAN0_Tx_0x350_Cyclic_PN17
        ComIPduSignalRef = CAN0_Tx_0x350_Cyclic_PN17_Sig_IPDU_COM_CAN0_Tx_0x350_Cyclic_PN17
        ComIPduGroupRef = ComIPduGroup_PN17_Tx
        ComTxIPdu: ComMinimumDelayTime=0.0, ComTxIPduClearUpdateBit=Confirmation, ComTxIPduUnusedAreasDefault=0
          ComTxModeTrue
            ComTxMode: ComTxModeMode=PERIODIC, ComTxModeNumberOfRepetitions=0, ComTxModeRepetitionPeriod=0.0, ComTxModeTimeOffset=0.01, ComTxModeTimePeriod=0.1
      CAN0_Tx_0x350_Cyclic_PN17_Sig_IPDU_COM_CAN0_Tx_0x350_Cyclic_PN17 (ComSignal):
        ComBitPosition = 8
        ComBitSize = 16
        ComHandleId = CAN0_Tx_0x350_Cyclic_PN17_Sig_IPDU_COM_CAN0_Tx_0x350_Cyclic_PN17
        ComSignalEndianness = BIG_ENDIAN
        ComSignalInitValue = 0x0
        ComSignalLength = 0
        ComSignalType = UINT16
        ComDataInvalidAction = NOTIFY
        ComInvalidNotification = NULL_PTR
        ComRxDataTimeoutAction = NONE
        ComInitialValueOnly = false
        ComTransferProperty = PENDING
      IPDU_COM_CAN0_Tx_0x300_Cyclic (ComIPdu):
        ComIPduCancellationSupport = false
        ComIPduDirection = SEND
        ComIPduHandleId = COM_TXPDU_COM_CAN0_Tx_0x300_Cyclic
        ComIPduSignalProcessing = DEFERRED
        ComIPduType = NORMAL
        ComPduIdRef = COM_CAN0_Tx_0x300_Cyclic
        ComIPduSignalRef = CAN0_Tx_0x300_Sig_4_U31_IPDU_COM_CAN0_Tx_0x300_Cyclic
        ComIPduSignalRef = CAN0_Tx_0x300_Sig_3_U15_IPDU_COM_CAN0_Tx_0x300_Cyclic
        ComIPduSignalRef = CAN0_Tx_0x300_Sig_2_U6_IPDU_COM_CAN0_Tx_0x300_Cyclic
        ComIPduSignalRef = CAN0_Tx_0x300_Sig_1_U4_IPDU_COM_CAN0_Tx_0x300_Cyclic
        ComIPduGroupRef = Com_TxPduGroup_CanController_0
        ComTxIPdu: ComMinimumDelayTime=0.0, ComTxIPduClearUpdateBit=Confirmation, ComTxIPduUnusedAreasDefault=0
          ComTxModeTrue
            ComTxMode: ComTxModeMode=PERIODIC, ComTxModeNumberOfRepetitions=0, ComTxModeRepetitionPeriod=0.0, ComTxModeTimeOffset=0.0, ComTxModeTimePeriod=0.1
      4 x ComSignal, all with ComSignalEndianness=BIG_ENDIAN, ComSignalInitValue=0x0, ComSignalLength=0, ComDataInvalidAction=NOTIFY, ComInvalidNotification=NULL_PTR, ComRxDataTimeoutAction=NONE, ComInitialValueOnly=false, ComTransferProperty=PENDING:
        CAN0_Tx_0x300_Sig_4_U31_IPDU_COM_CAN0_Tx_0x300_Cyclic: ComBitPosition=57, ComBitSize=31, ComHandleId=CAN0_Tx_0x300_Sig_4_U31_IPDU_COM_CAN0_Tx_0x300_Cyclic, ComSignalType=UINT32, ComUpdateBitPosition=56
        CAN0_Tx_0x300_Sig_3_U15_IPDU_COM_CAN0_Tx_0x300_Cyclic: ComBitPosition=25, ComBitSize=15, ComHandleId=CAN0_Tx_0x300_Sig_3_U15_IPDU_COM_CAN0_Tx_0x300_Cyclic, ComSignalType=UINT16, ComUpdateBitPosition=24
        CAN0_Tx_0x300_Sig_2_U6_IPDU_COM_CAN0_Tx_0x300_Cyclic: ComBitPosition=10, ComBitSize=6, ComHandleId=CAN0_Tx_0x300_Sig_2_U6_IPDU_COM_CAN0_Tx_0x300_Cyclic, ComSignalType=UINT8, ComUpdateBitPosition=9
        CAN0_Tx_0x300_Sig_1_U4_IPDU_COM_CAN0_Tx_0x300_Cyclic: ComBitPosition=4, ComBitSize=4, ComHandleId=CAN0_Tx_0x300_Sig_1_U4_IPDU_COM_CAN0_Tx_0x300_Cyclic, ComSignalType=UINT8, ComUpdateBitPosition=3
      IPDU_COM_CAN0_Tx_0x301_Event (ComIPdu):
        ComIPduCancellationSupport = false
        ComIPduDirection = SEND
        ComIPduHandleId = COM_TXPDU_COM_CAN0_Tx_0x301_Event
        ComIPduSignalProcessing = DEFERRED
        ComIPduType = NORMAL
        ComPduIdRef = COM_CAN0_Tx_0x301_Event
        ComIPduSignalRef = CAN0_Tx_0x301_Sig_4_U32_IPDU_COM_CAN0_Tx_0x301_Event
        ComIPduSignalRef = CAN0_Tx_0x301_Sig_3_U16_IPDU_COM_CAN0_Tx_0x301_Event
        ComIPduSignalRef = CAN0_Tx_0x301_Sig_2_U8_IPDU_COM_CAN0_Tx_0x301_Event
        ComIPduSignalRef = CAN0_Tx_0x301_Sig_1_U3_IPDU_COM_CAN0_Tx_0x301_Event
        ComIPduGroupRef = Com_TxPduGroup_CanController_0
        ComTxIPdu: ComMinimumDelayTime=0.01, ComTxIPduClearUpdateBit=Confirmation, ComTxIPduUnusedAreasDefault=0
          ComTxModeTrue
            ComTxMode: ComTxModeMode=DIRECT, ComTxModeNumberOfRepetitions=2, ComTxModeRepetitionPeriod=0.05, ComTxModeTimeOffset=0.0, ComTxModeTimePeriod=0.0
      4 x ComSignal, all with ComSignalEndianness=BIG_ENDIAN, ComSignalInitValue=0x0, ComSignalLength=0, ComInvalidNotification=NULL_PTR, ComRxDataTimeoutAction=NONE, ComInitialValueOnly=false, ComTransferProperty=TRIGGERED, ComDataInvalidAction=NOTIFY:
        CAN0_Tx_0x301_Sig_4_U32_IPDU_COM_CAN0_Tx_0x301_Event: ComBitPosition=56, ComBitSize=32, ComHandleId=CAN0_Tx_0x301_Sig_4_U32_IPDU_COM_CAN0_Tx_0x301_Event, ComSignalType=UINT32
        CAN0_Tx_0x301_Sig_3_U16_IPDU_COM_CAN0_Tx_0x301_Event: ComBitPosition=28, ComBitSize=16, ComHandleId=CAN0_Tx_0x301_Sig_3_U16_IPDU_COM_CAN0_Tx_0x301_Event, ComSignalType=UINT16
        CAN0_Tx_0x301_Sig_2_U8_IPDU_COM_CAN0_Tx_0x301_Event: ComBitPosition=12, ComBitSize=8, ComHandleId=CAN0_Tx_0x301_Sig_2_U8_IPDU_COM_CAN0_Tx_0x301_Event, ComSignalType=UINT8
        CAN0_Tx_0x301_Sig_1_U3_IPDU_COM_CAN0_Tx_0x301_Event: ComBitPosition=5, ComBitSize=3, ComHandleId=CAN0_Tx_0x301_Sig_1_U3_IPDU_COM_CAN0_Tx_0x301_Event, ComSignalType=UINT8
      IPDU_COM_CAN0_Tx_0x302_Mixed (ComIPdu):
        ComIPduCancellationSupport = false
        ComIPduDirection = SEND
        ComIPduHandleId = COM_TXPDU_COM_CAN0_Tx_0x302_Mixed
        ComIPduSignalProcessing = DEFERRED
        ComIPduType = NORMAL
        ComPduIdRef = COM_CAN0_Tx_0x302_Mixed
        ComIPduSignalRef = CAN0_Tx_0x302_Sig_7_U2_IPDU_COM_CAN0_Tx_0x302_Mixed
        ComIPduSignalRef = CAN0_Tx_0x302_Sig_6_U1_IPDU_COM_CAN0_Tx_0x302_Mixed
        ComIPduSignalRef = CAN0_Tx_0x302_Sig_4_U8_IPDU_COM_CAN0_Tx_0x302_Mixed
        ComIPduSignalRef = CAN0_Tx_0x302_Sig_3_U16_IPDU_COM_CAN0_Tx_0x302_Mixed
        ComIPduSignalRef = CAN0_Tx_0x302_Sig_2_U8_IPDU_COM_CAN0_Tx_0x302_Mixed
        ComIPduSignalRef = CAN0_Tx_0x302_Sig_1_U4_IPDU_COM_CAN0_Tx_0x302_Mixed
        ComIPduSignalRef = CAN0_Tx_0x302_Sig_5_U1_IPDU_COM_CAN0_Tx_0x302_Mixed
        ComIPduGroupRef = Com_TxPduGroup_CanController_0
        ComTxIPdu: ComMinimumDelayTime=0.01, ComTxIPduClearUpdateBit=Confirmation, ComTxIPduUnusedAreasDefault=0
          ComTxModeTrue
            ComTxMode: ComTxModeMode=MIXED, ComTxModeNumberOfRepetitions=2, ComTxModeRepetitionPeriod=0.05, ComTxModeTimeOffset=0.02, ComTxModeTimePeriod=0.5
      7 x ComSignal, all with ComSignalEndianness=BIG_ENDIAN, ComSignalInitValue=0x0, ComSignalLength=0, ComDataInvalidAction=NOTIFY, ComInvalidNotification=NULL_PTR, ComRxDataTimeoutAction=NONE, ComInitialValueOnly=false, ComTransferProperty=TRIGGERED:
        CAN0_Tx_0x302_Sig_7_U2_IPDU_COM_CAN0_Tx_0x302_Mixed: ComBitPosition=51, ComBitSize=2, ComHandleId=CAN0_Tx_0x302_Sig_7_U2_IPDU_COM_CAN0_Tx_0x302_Mixed, ComSignalType=UINT8
        CAN0_Tx_0x302_Sig_6_U1_IPDU_COM_CAN0_Tx_0x302_Mixed: ComBitPosition=11, ComBitSize=1, ComHandleId=CAN0_Tx_0x302_Sig_6_U1_IPDU_COM_CAN0_Tx_0x302_Mixed, ComSignalType=BOOLEAN
        CAN0_Tx_0x302_Sig_4_U8_IPDU_COM_CAN0_Tx_0x302_Mixed: ComBitPosition=32, ComBitSize=8, ComHandleId=CAN0_Tx_0x302_Sig_4_U8_IPDU_COM_CAN0_Tx_0x302_Mixed, ComSignalType=UINT8
        CAN0_Tx_0x302_Sig_3_U16_IPDU_COM_CAN0_Tx_0x302_Mixed: ComBitPosition=24, ComBitSize=16, ComHandleId=CAN0_Tx_0x302_Sig_3_U16_IPDU_COM_CAN0_Tx_0x302_Mixed, ComSignalType=UINT16
        CAN0_Tx_0x302_Sig_2_U8_IPDU_COM_CAN0_Tx_0x302_Mixed: ComBitPosition=12, ComBitSize=8, ComHandleId=CAN0_Tx_0x302_Sig_2_U8_IPDU_COM_CAN0_Tx_0x302_Mixed, ComSignalType=UINT8
        CAN0_Tx_0x302_Sig_1_U4_IPDU_COM_CAN0_Tx_0x302_Mixed: ComBitPosition=4, ComBitSize=4, ComHandleId=CAN0_Tx_0x302_Sig_1_U4_IPDU_COM_CAN0_Tx_0x302_Mixed, ComSignalType=UINT8
        CAN0_Tx_0x302_Sig_5_U1_IPDU_COM_CAN0_Tx_0x302_Mixed: ComBitPosition=47, ComBitSize=1, ComHandleId=CAN0_Tx_0x302_Sig_5_U1_IPDU_COM_CAN0_Tx_0x302_Mixed, ComSignalType=BOOLEAN
      IPDU_COM_CAN0_Tx_0x303_Cyclic_Counter (ComIPdu):
        ComIPduCancellationSupport = false
        ComIPduDirection = SEND
        ComIPduHandleId = COM_TXPDU_COM_CAN0_Tx_0x303_Cyclic_Counter
        ComIPduSignalProcessing = DEFERRED
        ComIPduType = NORMAL
        ComPduIdRef = COM_CAN0_Tx_0x303_Cyclic_Counter
        ComIPduSignalRef = CAN0_Tx_0x303_Sig_4_U32_IPDU_COM_CAN0_Tx_0x303_Cyclic_Counter
        ComIPduSignalRef = CAN0_Tx_0x303_Sig_3_U16_IPDU_COM_CAN0_Tx_0x303_Cyclic_Counter
        ComIPduSignalRef = CAN0_Tx_0x303_Sig_2_U8_IPDU_COM_CAN0_Tx_0x303_Cyclic_Counter
        ComIPduSignalRef = CAN0_Tx_0x303_Sig_1_U4_IPDU_COM_CAN0_Tx_0x303_Cyclic_Counter
        ComIPduGroupRef = Com_TxPduGroup_CanController_0
        ComTxIPdu: ComMinimumDelayTime=0.0, ComTxIPduClearUpdateBit=Confirmation, ComTxIPduUnusedAreasDefault=0
          ComTxModeTrue
            ComTxMode: ComTxModeMode=PERIODIC, ComTxModeNumberOfRepetitions=0, ComTxModeRepetitionPeriod=0.0, ComTxModeTimeOffset=0.025, ComTxModeTimePeriod=0.05
        ComIPduCounter: ComIPduCounterSize=4, ComIPduCounterStartPosition=8, ComIPduCounterThreshold=15
      4 x ComSignal, all with ComSignalEndianness=BIG_ENDIAN, ComSignalInitValue=0x0, ComSignalLength=0, ComInvalidNotification=NULL_PTR, ComRxDataTimeoutAction=NONE, ComInitialValueOnly=false, ComTransferProperty=PENDING:
        CAN0_Tx_0x303_Sig_4_U32_IPDU_COM_CAN0_Tx_0x303_Cyclic_Counter: ComBitPosition=56, ComBitSize=32, ComHandleId=CAN0_Tx_0x303_Sig_4_U32_IPDU_COM_CAN0_Tx_0x303_Cyclic_Counter, ComSignalType=UINT32
        CAN0_Tx_0x303_Sig_3_U16_IPDU_COM_CAN0_Tx_0x303_Cyclic_Counter: ComBitPosition=24, ComBitSize=16, ComHandleId=CAN0_Tx_0x303_Sig_3_U16_IPDU_COM_CAN0_Tx_0x303_Cyclic_Counter, ComSignalType=UINT16
        CAN0_Tx_0x303_Sig_2_U8_IPDU_COM_CAN0_Tx_0x303_Cyclic_Counter: ComBitPosition=12, ComBitSize=8, ComHandleId=CAN0_Tx_0x303_Sig_2_U8_IPDU_COM_CAN0_Tx_0x303_Cyclic_Counter, ComSignalType=UINT8
        CAN0_Tx_0x303_Sig_1_U4_IPDU_COM_CAN0_Tx_0x303_Cyclic_Counter: ComBitPosition=4, ComBitSize=4, ComHandleId=CAN0_Tx_0x303_Sig_1_U4_IPDU_COM_CAN0_Tx_0x303_Cyclic_Counter, ComSignalType=UINT8
      4 x ComIPduGroup:
        ComIPduGroup_PN17_Tx: ComIPduGroupHandleId=ComIPduGroup_PN17_Tx
        ComIPduGroup_PN29_Tx: ComIPduGroupHandleId=ComIPduGroup_PN29_Tx
        ComIPduGroup_PN17_Rx: ComIPduGroupHandleId=ComIPduGroup_PN17_Rx
        ComIPduGroup_PN29_Rx: ComIPduGroupHandleId=ComIPduGroup_PN29_Rx
      ComSignal_CanNmEira_Rx (ComSignal):
        ComBitPosition = 0
        ComBitSize = 0
        ComHandleId = ComSignal_CanNmEira_Rx
        ComSignalEndianness = opaque
        ComSignalInitValue = 0x00,0x00,0x00,0x00,0x00,0x00
        ComSignalLength = 6
        ComSignalType = UINT8_N
        ComDataInvalidAction = NOTIFY
        ComInvalidNotification = NULL_PTR
        ComRxDataTimeoutAction = NONE
        ComInitialValueOnly = false
        ComTransferProperty = PENDING
        ComNotification = Rte_COMCbk
      ComSignal_CanNmUserData_Tx (ComSignal):
        ComBitPosition = 0
        ComBitSize = 0
        ComHandleId = ComSignal_CanNmUserData_Tx
        ComSignalEndianness = opaque
        ComSignalInitValue = 0x00,0x00,0x00,0x00,0x00,0x00
        ComSignalLength = 6
        ComSignalType = UINT8_N
        ComDataInvalidAction = NOTIFY
        ComInvalidNotification = NULL_PTR
        ComRxDataTimeoutAction = NONE
        ComInitialValueOnly = false
        ComTransferProperty = PENDING
      ComIPdu_CanNmEiraRx (ComIPdu):
        ComIPduCancellationSupport = false
        ComIPduDirection = RECEIVE
        ComIPduHandleId = COM_RXPDU_COM_CAN0_Rx_ComCanNmEiraRx
        ComIPduSignalProcessing = IMMEDIATE
        ComIPduType = NORMAL
        ComPduIdRef = COM_CAN0_Rx_ComCanNmEiraRx
        ComIPduSignalRef = ComSignal_CanNmEira_Rx
      IPDU_COM_CAN0_Rx_0x260_E2E_P01 (ComIPdu):
        ComIPduCancellationSupport = false
        ComIPduDirection = RECEIVE
        ComIPduHandleId = COM_RXPDU_COM_CAN0_Rx_0x260_E2E_P01
        ComIPduSignalProcessing = DEFERRED
        ComIPduType = NORMAL
        ComIPduCallout = E2E_Rx_0x260_P01_0x1234_IpduCallOut
        ComPduIdRef = COM_CAN0_Rx_0x260_E2E_P01
        ComIPduSignalGroupRef = Rx_0x260_E2E_P01_IPDU_COM_CAN0_Rx_0x260_E2E_P01
        ComIPduGroupRef = Com_RxPduGroup_CanController_0
      Rx_0x260_E2E_P01_IPDU_COM_CAN0_Rx_0x260_E2E_P01 (ComSignalGroup):
        ComHandleId = Rx_0x260_E2E_P01_IPDU_COM_CAN0_Rx_0x260_E2E_P01
        ComInvalidNotification = NULL_PTR
        ComRxDataTimeoutAction = NONE
        ComInitialValueOnly = false
        ComTransferProperty = PENDING
        ComNotification = Rte_COMCbk
        ComDataInvalidAction = NOTIFY
        10 x ComGroupSignal, all with ComSignalEndianness=BIG_ENDIAN, ComSignalInitValue=0x0, ComSignalLength=0:
          CAN0_Rx_0x260_Sig_8_U8_IPDU_COM_CAN0_Rx_0x260_E2E_P01: ComBitPosition=56, ComBitSize=8, ComHandleId=Rx_0x260_E2E_P01_IPDU_COM_CAN0_Rx_0x260_E2E_P01_CAN0_Rx_0x260_Sig_8_U8_IPDU_COM_CAN0_Rx_0x260_E2E_P01, ComSignalType=UINT8
          CAN0_Rx_0x260_Sig_7_U5_IPDU_COM_CAN0_Rx_0x260_E2E_P01: ComBitPosition=50, ComBitSize=5, ComHandleId=Rx_0x260_E2E_P01_IPDU_COM_CAN0_Rx_0x260_E2E_P01_CAN0_Rx_0x260_Sig_7_U5_IPDU_COM_CAN0_Rx_0x260_E2E_P01, ComSignalType=UINT8
          CAN0_Rx_0x260_Sig_6_U2_IPDU_COM_CAN0_Rx_0x260_E2E_P01: ComBitPosition=48, ComBitSize=2, ComHandleId=Rx_0x260_E2E_P01_IPDU_COM_CAN0_Rx_0x260_E2E_P01_CAN0_Rx_0x260_Sig_6_U2_IPDU_COM_CAN0_Rx_0x260_E2E_P01, ComSignalType=UINT8
          CAN0_Rx_0x260_Sig_5_U16_IPDU_COM_CAN0_Rx_0x260_E2E_P01: ComBitPosition=40, ComBitSize=16, ComHandleId=Rx_0x260_E2E_P01_IPDU_COM_CAN0_Rx_0x260_E2E_P01_CAN0_Rx_0x260_Sig_5_U16_IPDU_COM_CAN0_Rx_0x260_E2E_P01, ComSignalType=UINT16
          CAN0_Rx_0x260_Sig_4_U8_IPDU_COM_CAN0_Rx_0x260_E2E_P01: ComBitPosition=24, ComBitSize=8, ComHandleId=Rx_0x260_E2E_P01_IPDU_COM_CAN0_Rx_0x260_E2E_P01_CAN0_Rx_0x260_Sig_4_U8_IPDU_COM_CAN0_Rx_0x260_E2E_P01, ComSignalType=UINT8
          CAN0_Rx_0x260_Sig_2_U3_IPDU_COM_CAN0_Rx_0x260_E2E_P01: ComBitPosition=17, ComBitSize=3, ComHandleId=Rx_0x260_E2E_P01_IPDU_COM_CAN0_Rx_0x260_E2E_P01_CAN0_Rx_0x260_Sig_2_U3_IPDU_COM_CAN0_Rx_0x260_E2E_P01, ComSignalType=UINT8
          CAN0_Rx_0x260_Sig_3_U4_IPDU_COM_CAN0_Rx_0x260_E2E_P01: ComBitPosition=20, ComBitSize=4, ComHandleId=Rx_0x260_E2E_P01_IPDU_COM_CAN0_Rx_0x260_E2E_P01_CAN0_Rx_0x260_Sig_3_U4_IPDU_COM_CAN0_Rx_0x260_E2E_P01, ComSignalType=UINT8
          CAN0_Rx_0x260_Sig_1_U1_IPDU_COM_CAN0_Rx_0x260_E2E_P01: ComBitPosition=16, ComBitSize=1, ComHandleId=Rx_0x260_E2E_P01_IPDU_COM_CAN0_Rx_0x260_E2E_P01_CAN0_Rx_0x260_Sig_1_U1_IPDU_COM_CAN0_Rx_0x260_E2E_P01, ComSignalType=BOOLEAN
          CAN0_Rx_0x260_Counter_IPDU_COM_CAN0_Rx_0x260_E2E_P01: ComBitPosition=8, ComBitSize=4, ComHandleId=Rx_0x260_E2E_P01_IPDU_COM_CAN0_Rx_0x260_E2E_P01_CAN0_Rx_0x260_Counter_IPDU_COM_CAN0_Rx_0x260_E2E_P01, ComSignalType=UINT8
          CAN0_Rx_0x260_CRC_IPDU_COM_CAN0_Rx_0x260_E2E_P01: ComBitPosition=0, ComBitSize=8, ComHandleId=Rx_0x260_E2E_P01_IPDU_COM_CAN0_Rx_0x260_E2E_P01_CAN0_Rx_0x260_CRC_IPDU_COM_CAN0_Rx_0x260_E2E_P01, ComSignalType=UINT8
      IPDU_COM_CAN0_Tx_0x360_E2E_P01 (ComIPdu):
        ComIPduCancellationSupport = false
        ComIPduDirection = SEND
        ComIPduHandleId = COM_TXPDU_COM_CAN0_Tx_0x360_E2E_P01
        ComIPduSignalProcessing = DEFERRED
        ComIPduType = NORMAL
        ComIPduCallout = E2E_Tx_0x360_P01_0x1234_IpduCallOut
        ComPduIdRef = COM_CAN0_Tx_0x360_E2E_P01
        ComIPduSignalGroupRef = Tx_0x360_E2E_P01_IPDU_COM_CAN0_Tx_0x360_E2E_P01
        ComIPduGroupRef = Com_TxPduGroup_CanController_0
        ComTxIPdu: ComMinimumDelayTime=0.0, ComTxIPduClearUpdateBit=Confirmation, ComTxIPduUnusedAreasDefault=0
          ComTxModeTrue
            ComTxMode: ComTxModeMode=PERIODIC, ComTxModeNumberOfRepetitions=0, ComTxModeRepetitionPeriod=0.0, ComTxModeTimeOffset=0.03, ComTxModeTimePeriod=0.1
      Tx_0x360_E2E_P01_IPDU_COM_CAN0_Tx_0x360_E2E_P01 (ComSignalGroup):
        ComHandleId = Tx_0x360_E2E_P01_IPDU_COM_CAN0_Tx_0x360_E2E_P01
        ComInvalidNotification = NULL_PTR
        ComRxDataTimeoutAction = NONE
        ComInitialValueOnly = false
        ComTransferProperty = PENDING
        ComDataInvalidAction = NOTIFY
        10 x ComGroupSignal, all with ComSignalEndianness=BIG_ENDIAN, ComSignalInitValue=0x0, ComSignalLength=0:
          CAN0_Tx_0x360_Sig_8_U8_IPDU_COM_CAN0_Tx_0x360_E2E_P01: ComBitPosition=56, ComBitSize=8, ComHandleId=Tx_0x360_E2E_P01_IPDU_COM_CAN0_Tx_0x360_E2E_P01_CAN0_Tx_0x360_Sig_8_U8_IPDU_COM_CAN0_Tx_0x360_E2E_P01, ComSignalType=UINT8
          CAN0_Tx_0x360_Sig_7_U5_IPDU_COM_CAN0_Tx_0x360_E2E_P01: ComBitPosition=50, ComBitSize=5, ComHandleId=Tx_0x360_E2E_P01_IPDU_COM_CAN0_Tx_0x360_E2E_P01_CAN0_Tx_0x360_Sig_7_U5_IPDU_COM_CAN0_Tx_0x360_E2E_P01, ComSignalType=UINT8
          CAN0_Tx_0x360_Sig_6_U2_IPDU_COM_CAN0_Tx_0x360_E2E_P01: ComBitPosition=48, ComBitSize=2, ComHandleId=Tx_0x360_E2E_P01_IPDU_COM_CAN0_Tx_0x360_E2E_P01_CAN0_Tx_0x360_Sig_6_U2_IPDU_COM_CAN0_Tx_0x360_E2E_P01, ComSignalType=UINT8
          CAN0_Tx_0x360_Sig_5_U16_IPDU_COM_CAN0_Tx_0x360_E2E_P01: ComBitPosition=40, ComBitSize=16, ComHandleId=Tx_0x360_E2E_P01_IPDU_COM_CAN0_Tx_0x360_E2E_P01_CAN0_Tx_0x360_Sig_5_U16_IPDU_COM_CAN0_Tx_0x360_E2E_P01, ComSignalType=UINT16
          CAN0_Tx_0x360_Sig_4_U8_IPDU_COM_CAN0_Tx_0x360_E2E_P01: ComBitPosition=24, ComBitSize=8, ComHandleId=Tx_0x360_E2E_P01_IPDU_COM_CAN0_Tx_0x360_E2E_P01_CAN0_Tx_0x360_Sig_4_U8_IPDU_COM_CAN0_Tx_0x360_E2E_P01, ComSignalType=UINT8
          CAN0_Tx_0x360_Sig_2_U3_IPDU_COM_CAN0_Tx_0x360_E2E_P01: ComBitPosition=17, ComBitSize=3, ComHandleId=Tx_0x360_E2E_P01_IPDU_COM_CAN0_Tx_0x360_E2E_P01_CAN0_Tx_0x360_Sig_2_U3_IPDU_COM_CAN0_Tx_0x360_E2E_P01, ComSignalType=UINT8
          CAN0_Tx_0x360_Sig_3_U4_IPDU_COM_CAN0_Tx_0x360_E2E_P01: ComBitPosition=20, ComBitSize=4, ComHandleId=Tx_0x360_E2E_P01_IPDU_COM_CAN0_Tx_0x360_E2E_P01_CAN0_Tx_0x360_Sig_3_U4_IPDU_COM_CAN0_Tx_0x360_E2E_P01, ComSignalType=UINT8
          CAN0_Tx_0x360_Sig_1_U1_IPDU_COM_CAN0_Tx_0x360_E2E_P01: ComBitPosition=16, ComBitSize=1, ComHandleId=Tx_0x360_E2E_P01_IPDU_COM_CAN0_Tx_0x360_E2E_P01_CAN0_Tx_0x360_Sig_1_U1_IPDU_COM_CAN0_Tx_0x360_E2E_P01, ComSignalType=BOOLEAN
          CAN0_Tx_0x360_Counter_IPDU_COM_CAN0_Tx_0x360_E2E_P01: ComBitPosition=8, ComBitSize=4, ComHandleId=Tx_0x360_E2E_P01_IPDU_COM_CAN0_Tx_0x360_E2E_P01_CAN0_Tx_0x360_Counter_IPDU_COM_CAN0_Tx_0x360_E2E_P01, ComSignalType=UINT8
          CAN0_Tx_0x360_CRC_IPDU_COM_CAN0_Tx_0x360_E2E_P01: ComBitPosition=0, ComBitSize=8, ComHandleId=Tx_0x360_E2E_P01_IPDU_COM_CAN0_Tx_0x360_E2E_P01_CAN0_Tx_0x360_CRC_IPDU_COM_CAN0_Tx_0x360_E2E_P01, ComSignalType=UINT8
      ComMainFunctionRx_0 (ComMainFunctionRx): ComMainRxTimeBase=0.005
      ComMainFunctionTx_0 (ComMainFunctionTx): ComMainTxTimeBase=0.005
      4 x ComSignal, all with ComSignalEndianness=BIG_ENDIAN, ComSignalInitValue=0x0, ComSignalLength=0, ComInvalidNotification=NULL_PTR, ComRxDataTimeoutAction=NONE, ComInitialValueOnly=false, ComTransferProperty=PENDING:
        CAN0_Tx_0x304_Sig_4_U32_IPDU_COM_CAN0_Tx_0x304_Cyclic_Counter: ComBitPosition=56, ComBitSize=32, ComHandleId=CAN0_Tx_0x304_Sig_4_U32_IPDU_COM_CAN0_Tx_0x304_Cyclic_Counter, ComSignalType=UINT32
        CAN0_Tx_0x304_Sig_3_U16_IPDU_COM_CAN0_Tx_0x304_Cyclic_Counter: ComBitPosition=24, ComBitSize=16, ComHandleId=CAN0_Tx_0x304_Sig_3_U16_IPDU_COM_CAN0_Tx_0x304_Cyclic_Counter, ComSignalType=UINT16
        CAN0_Tx_0x304_Sig_2_U8_IPDU_COM_CAN0_Tx_0x304_Cyclic_Counter: ComBitPosition=12, ComBitSize=8, ComHandleId=CAN0_Tx_0x304_Sig_2_U8_IPDU_COM_CAN0_Tx_0x304_Cyclic_Counter, ComSignalType=UINT8
        CAN0_Tx_0x304_Sig_1_U4_IPDU_COM_CAN0_Tx_0x304_Cyclic_Counter: ComBitPosition=4, ComBitSize=4, ComHandleId=CAN0_Tx_0x304_Sig_1_U4_IPDU_COM_CAN0_Tx_0x304_Cyclic_Counter, ComSignalType=UINT8
      IPDU_COM_CAN0_Tx_0x304_Cyclic_Counter (ComIPdu):
        ComIPduCancellationSupport = false
        ComIPduDirection = SEND
        ComIPduHandleId = COM_TXPDU_COM_CAN0_Tx_0x304_Cyclic_Counter
        ComIPduSignalProcessing = DEFERRED
        ComIPduType = NORMAL
        ComIPduCallout = IPDU_COM_CAN0_Tx_0x304_Cylic_Callout
        ComPduIdRef = COM_CAN0_Tx_0x304_Cyclic_Counter
        ComIPduSignalRef = CAN0_Tx_0x304_Sig_4_U32_IPDU_COM_CAN0_Tx_0x304_Cyclic_Counter
        ComIPduSignalRef = CAN0_Tx_0x304_Sig_3_U16_IPDU_COM_CAN0_Tx_0x304_Cyclic_Counter
        ComIPduSignalRef = CAN0_Tx_0x304_Sig_2_U8_IPDU_COM_CAN0_Tx_0x304_Cyclic_Counter
        ComIPduSignalRef = CAN0_Tx_0x304_Sig_1_U4_IPDU_COM_CAN0_Tx_0x304_Cyclic_Counter
        ComIPduGroupRef = Com_TxPduGroup_CanController_0
        ComTxIPdu: ComMinimumDelayTime=0.0, ComTxIPduClearUpdateBit=Confirmation, ComTxIPduUnusedAreasDefault=0
          ComTxModeTrue
            ComTxMode: ComTxModeMode=PERIODIC, ComTxModeNumberOfRepetitions=0, ComTxModeRepetitionPeriod=0.0, ComTxModeTimeOffset=0.025, ComTxModeTimePeriod=0.05
        ComIPduCounter: ComIPduCounterSize=4, ComIPduCounterStartPosition=8, ComIPduCounterThreshold=15
      5 x ComSignal, all with ComSignalEndianness=LITTLE_ENDIAN, ComSignalInitValue=0x0, ComSignalLength=0, ComInvalidNotification=NULL_PTR, ComRxDataTimeoutAction=NONE, ComInitialValueOnly=false, ComTransferProperty=PENDING:
        CAN0_Tx_0x18C4D2D0_Sig_1_U4_IPDU_COM_CAN0_Tx_0x18C4D2D0_Cyclic_Counter: ComBitPosition=0, ComBitSize=4, ComHandleId=CAN0_Tx_0x18C4D2D0_Sig_1_U4_IPDU_COM_CAN0_Tx_0x18C4D2D0_Cyclic_Counter, ComSignalType=UINT8
        CAN0_Tx_0x18C4D2D0_Sig_2_U16_IPDU_COM_CAN0_Tx_0x18C4D2D0_Cyclic_Counter: ComBitPosition=4, ComBitSize=16, ComHandleId=CAN0_Tx_0x18C4D2D0_Sig_2_U16_IPDU_COM_CAN0_Tx_0x18C4D2D0_Cyclic_Counter, ComSignalType=UINT16
        CAN0_Tx_0x18C4D2D0_Sig_3_U16_IPDU_COM_CAN0_Tx_0x18C4D2D0_Cyclic_Counter: ComBitPosition=20, ComBitSize=16, ComHandleId=CAN0_Tx_0x18C4D2D0_Sig_3_U16_IPDU_COM_CAN0_Tx_0x18C4D2D0_Cyclic_Counter, ComSignalType=SINT16
        CAN0_Tx_0x18C4D2D0_Sig_4_U8_IPDU_COM_CAN0_Tx_0x18C4D2D0_Cyclic_Counter: ComBitPosition=36, ComBitSize=8, ComHandleId=CAN0_Tx_0x18C4D2D0_Sig_4_U8_IPDU_COM_CAN0_Tx_0x18C4D2D0_Cyclic_Counter, ComSignalType=UINT8
        CAN0_Tx_0x18C4D2D0_Sig_5_U8_IPDU_COM_CAN0_Tx_0x18C4D2D0_Cyclic_Counter: ComBitPosition=56, ComBitSize=8, ComHandleId=CAN0_Tx_0x18C4D2D0_Sig_5_U8_IPDU_COM_CAN0_Tx_0x18C4D2D0_Cyclic_Counter, ComSignalType=UINT8
      IPDU_COM_CAN0_Tx_0x18C4D2D0_Cyclic_Counter (ComIPdu):
        ComIPduCancellationSupport = false
        ComIPduDirection = SEND
        ComIPduHandleId = COM_TXPDU_COM_CAN0_Tx_0x18C4D2D0_Cyclic_Counter
        ComIPduSignalProcessing = DEFERRED
        ComIPduType = NORMAL
        ComIPduCallout = IPDU_COM_CAN0_Tx_0x18C4D2D0_Cylic_Callout
        ComPduIdRef = COM_CAN0_Tx_0x18C4D2D0_Cyclic_Counter
        ComIPduSignalRef = CAN0_Tx_0x18C4D2D0_Sig_5_U8_IPDU_COM_CAN0_Tx_0x18C4D2D0_Cyclic_Counter
        ComIPduSignalRef = CAN0_Tx_0x18C4D2D0_Sig_4_U8_IPDU_COM_CAN0_Tx_0x18C4D2D0_Cyclic_Counter
        ComIPduSignalRef = CAN0_Tx_0x18C4D2D0_Sig_3_U16_IPDU_COM_CAN0_Tx_0x18C4D2D0_Cyclic_Counter
        ComIPduSignalRef = CAN0_Tx_0x18C4D2D0_Sig_2_U16_IPDU_COM_CAN0_Tx_0x18C4D2D0_Cyclic_Counter
        ComIPduGroupRef = Com_TxPduGroup_CanController_0
        ComIPduSignalRef = CAN0_Tx_0x18C4D2D0_Sig_1_U4_IPDU_COM_CAN0_Tx_0x18C4D2D0_Cyclic_Counter
        ComTxIPdu: ComMinimumDelayTime=0.0, ComTxIPduClearUpdateBit=Confirmation, ComTxIPduUnusedAreasDefault=0
          ComTxModeTrue
            ComTxMode: ComTxModeMode=PERIODIC, ComTxModeNumberOfRepetitions=0, ComTxModeRepetitionPeriod=0.0, ComTxModeTimeOffset=0.025, ComTxModeTimePeriod=0.05
        ComIPduCounter: ComIPduCounterSize=4, ComIPduCounterStartPosition=52, ComIPduCounterThreshold=15
