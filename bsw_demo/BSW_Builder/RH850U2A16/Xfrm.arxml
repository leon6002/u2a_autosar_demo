AUTOSAR XML (schema 00048)
package /RH850U2A16
  module config Xfrm
    E2EXfrmGeneral
      E2EXfrmGeneral: E2EXfVersionInfoApi=false, E2EXfDevErrorDetect=true
      E2ETransformer_0x1234_Tx (E2ETransformer): E2EISignalProp=EndToEndTransformationISignalProps_0x1234_Tx
      EndToEndTransformationISignalProps_0x1234_Tx (EndToEndTransformationISignalProps):
        dataId = 0x1234
        dataLength = 64
        maxDataLength = 0
        minDataLength = 0
        Transformer = TransformationTechnology_P01
        systemSignalGroupRef = Tx_0x360_E2E_P01_IPDU_COM_CAN0_Tx_0x360_E2E_P01
        ISignals = CAN0_Tx_0x360_Sig_8_U8_IPDU_COM_CAN0_Tx_0x360_E2E_P01
        ISignals = CAN0_Tx_0x360_Sig_7_U5_IPDU_COM_CAN0_Tx_0x360_E2E_P01
        ISignals = CAN0_Tx_0x360_Sig_6_U2_IPDU_COM_CAN0_Tx_0x360_E2E_P01
        ISignals = CAN0_Tx_0x360_Sig_5_U16_IPDU_COM_CAN0_Tx_0x360_E2E_P01
        ISignals = CAN0_Tx_0x360_Sig_4_U8_IPDU_COM_CAN0_Tx_0x360_E2E_P01
        ISignals = CAN0_Tx_0x360_Sig_3_U4_IPDU_COM_CAN0_Tx_0x360_E2E_P01
        ISignals = CAN0_Tx_0x360_Sig_2_U3_IPDU_COM_CAN0_Tx_0x360_E2E_P01
        ISignals = CAN0_Tx_0x360_Sig_1_U1_IPDU_COM_CAN0_Tx_0x360_E2E_P01
      EndToEndTransformationISignalProps_0x1234_Rx (EndToEndTransformationISignalProps):
        dataId = 0x1234
        dataLength = 64
        maxDataLength = 0
        minDataLength = 0
        Transformer = TransformationTechnology_P01
        systemSignalGroupRef = Rx_0x260_E2E_P01_IPDU_COM_CAN0_Rx_0x260_E2E_P01
        ISignals = CAN0_Rx_0x260_Sig_8_U8_IPDU_COM_CAN0_Rx_0x260_E2E_P01
        ISignals = CAN0_Rx_0x260_Sig_7_U5_IPDU_COM_CAN0_Rx_0x260_E2E_P01
        ISignals = CAN0_Rx_0x260_Sig_6_U2_IPDU_COM_CAN0_Rx_0x260_E2E_P01
        ISignals = CAN0_Rx_0x260_Sig_5_U16_IPDU_COM_CAN0_Rx_0x260_E2E_P01
        ISignals = CAN0_Rx_0x260_Sig_4_U8_IPDU_COM_CAN0_Rx_0x260_E2E_P01
        ISignals = CAN0_Rx_0x260_Sig_3_U4_IPDU_COM_CAN0_Rx_0x260_E2E_P01
        ISignals = CAN0_Rx_0x260_Sig_2_U3_IPDU_COM_CAN0_Rx_0x260_E2E_P01
        ISignals = CAN0_Rx_0x260_Sig_1_U1_IPDU_COM_CAN0_Rx_0x260_E2E_P01
      E2ETransformer_0x1234_Rx (E2ETransformer): E2EISignalProp=EndToEndTransformationISignalProps_0x1234_Rx
    TransformationSet_0 (TransformationSet)
      Transformation_Tx_0x360_P01_0x1234 (Transformation): TransformerId=Tx_0x360_P01_0x1234, TransformChains=E2ETransformer_0x1234_Tx
      Transformation_Rx_0x260_P01_0x1234 (Transformation): TransformerId=Rx_0x260_P01_0x1234, TransformChains=E2ETransformer_0x1234_Rx
      TransformationTechnology_P01 (TransformationTechnology): NeedsOriginalData=false, Protocol=E2E, TransformerClass=SAFETY, Version=1.0.0
        BufferProperty: HeaderLength=16, InPlace=false
        EndToEndTransformationDescription:
          counterOffset = 8
          crcOffset = 0
          dataIdNibbleOffset = 12
          maxDeltaCounter = 3
          maxErrorStateInit = 0
          maxErrorStateInvalid = 0
          maxErrorStateValid = 0
          maxNoNewOrRepeatedData = 14
          minOkStateInit = 1
          minOkStateInvalid = 1
          minOkStateValid = 1
          offset = 0
          profileBehavior = R4_2
          profileName = PROFILE_01
          syncCounterInit = 1
          upperHeaderBitsToShift = 0
          windowSizeInit = 1
          windowSizeValid = 1
          windowSizeInvalid = 1
          clearFromValidToInvalid = true
          dataIdMode = ALL16BIT
