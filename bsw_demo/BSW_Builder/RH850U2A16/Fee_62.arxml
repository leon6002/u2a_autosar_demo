AUTOSAR XML (schema 00048)
package /RH850U2A16
  module config Fee_62
    FeeGeneral:
      FeeDevErrorDetect = true
      FeeMainFunctionPeriod = 0.005
      FeePollingMode = true
      FeeSetModeSupported = false
      FeeVersionInfoApi = false
      FeeVirtualPageSize = 8
      FeeCancelApi = false
      FeePageDirectWriteSupport = false
      FeeBank_0 (FeeBank): FeeBankIndex=0, FeeBankStartaddress=0, FeeBankSize=24576
      FeeBank_1 (FeeBank): FeeBankIndex=1, FeeBankStartaddress=24576, FeeBankSize=24576
    FeeBlockConfiguration_0 (FeeBlockConfiguration): FeeBlockNumber=256, FeeBlockSize=8, FeeImmediateData=false, FeeNumberOfWriteCycles=0, FeeDeviceIndex=NULL
    FeePublishedInformation: FeeBlockOverhead=32, FeeBankOverhead=24
    8 x FeeBlockConfiguration, all with FeeImmediateData=false, FeeNumberOfWriteCycles=0, FeeDeviceIndex=NULL:
      FeeBlockConfiguration_1: FeeBlockNumber=257, FeeBlockSize=8
      FeeBlockConfiguration_DCM: FeeBlockNumber=512, FeeBlockSize=264
      FeeBlockConfiguration_DEM_1_UDS_InternalData: FeeBlockNumber=768, FeeBlockSize=1032
      FeeBlockConfiguration_DEM_2_All_EventEntry: FeeBlockNumber=1024, FeeBlockSize=4096
      Fee_DIDF183: FeeBlockNumber=1280, FeeBlockSize=64
      Fee_DIDF190: FeeBlockNumber=1536, FeeBlockSize=64
      FeeBlock_SecurityLevel01: FeeBlockNumber=1792, FeeBlockSize=64
      FeeBlock_SecurityLevel02: FeeBlockNumber=2048, FeeBlockSize=64
