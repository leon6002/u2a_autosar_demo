AUTOSAR XML (schema 00048)
package /RH850U2A16
  module config Mcu: implementation-config-variant=VARIANT-POST-BUILD, module-description=Mcu_Impl
    McuGeneralConfiguration:
      McuClearAndSetWakeupFactorApi = true
      McuCriticalSectionProtection = true
      McuDevErrorDetect = true
      McuDeviceName = R7F702300AFABA
      McuEcmInterruptConsistencyCheck = false
      McuEcmResetTriggerSelect = false
      McuGetRamStateApi = false
      McuGetWakeupFactorApi = true
      McuInitClock = true
      McuIsrCategory = CAT2
      McuNoPll = false
      McuPerformResetApi = true
      McuProvideRAMStateISR = false
      McuRamEccEcmSettingSelect = Init
      McuReleaseIoBufferHoldApi = true
      McuSoftwareResetTriggerSelect = false
      McuSwResetCall = false
      McuVersionCheckExternalModules = false
      McuVersionInfoApi = true
      McuPowerGoodCount = 4095
    McuModuleConfiguration: McuClockSrcFailureNotification=DISABLED, McuNumberOfMcuModes=1, McuRamSectors=1, McuResetSetting=1
      McuClockSettingConfig:
        McuClkModeSelect = MCU_CLK_PLLO
        McuClockResponseWaitCount = 64
        McuClockSettingId = 0
        McuCpuMainSysClk = 400000000
        McuHsoscStopMask = MCU_HSOSC_STOP_MASK_DIS
        McuMainOscSelect = MCU_MOSC_20MHZ
        McuMoscStopMask = MCU_MOSC_STOP_MASK_DIS
        McuPllStopMask = MCU_PLL_STOP_MASK_DIS
        McuUnitName = CLK_CPU
        McuADCClk: McuPeripheralClock=40000000, McuSrcClockSel=MCU_CLK_LSB, McuUnitName=CLK_ADC
        McuADCClkA: McuDivClockSel=MCU_CLKA_ADC_DIVBY2, McuPeripheralClock=5000000, McuSrcClockSel=MCU_CLK_HSOSC_D20, McuUnitName=CLKA_ADC
        McuClockMonitorSettingConf:
          McuClm0MonitoringClockAccuracy = 14
          McuClm0Operation = false
          McuClm0SamplingClockAccuracy = 14
          McuClm1MonitoringClockAccuracy = 14
          McuClm1Operation = false
          McuClm1SamplingClockAccuracy = 14
          McuClm2MonitoringClockAccuracy = 14
          McuClm2Operation = false
          McuClm2SamplingClockAccuracy = 14
          McuClm3MonitoringClockAccuracy = 14
          McuClm3Operation = false
          McuClm3SamplingClockAccuracy = 14
          McuClm4MonitoringClockAccuracy = 14
          McuClm4Operation = false
          McuClm4SamplingClockAccuracy = 14
          McuClm5MonitoringClockAccuracy = 14
          McuClm5Operation = false
          McuClm5SamplingClockAccuracy = 14
          McuClm6MonitoringClockAccuracy = 14
          McuClm6Operation = false
          McuClm6SamplingClockAccuracy = 14
          McuClm7MonitoringClockAccuracy = 14
          McuClm7Operation = false
          McuClm7SamplingClockAccuracy = 14
          McuClm8Operation = false
          McuClm9Operation = false
          McuClm8MonitoringClockAccuracy = 14
          McuClm8SamplingClockAccuracy = 14
          McuClm9MonitoringClockAccuracy = 14
          McuClm9SamplingClockAccuracy = 14
        McuClockReferencePoint: McuClockReferencePointFrequency=400000000
        McuEXTCLK0OClk: McuDivClockN=0, McuPeripheralClock=20000000, McuSrcClockSel=MCU_CLK_HSB, McuUnitName=EXTCLK0O
        McuEXTCLK1OClk: McuDivClockN=0, McuPeripheralClock=20000000, McuSrcClockSel=MCU_CLK_HSB, McuUnitName=EXTCLK1O
        McuHBusClk: McuPeripheralClock=100000000, McuUnitName=CLK_HBUS
        McuHighSpeedPeriClk: McuPeripheralClock=80000000, McuUnitName=CLK_HSB
        McuLowSpeedPeriClk: McuPeripheralClock=40000000, McuUnitName=CLK_LSB
        McuMSPIClk: McuPeripheralClock=80000000, McuSrcClockSel=MCU_CLK_HSB, McuUnitName=CLK_MSPI
        McuRLINClk: McuPeripheralClock=80000000, McuSrcClockSel=MCU_CLK_HSB, McuUnitName=CLK_RLIN
        McuRTCClk: McuPeripheralClock=240000, McuSrcClockSel=MCU_CLK_LSOSC, McuUnitName=CLKA_RTCA
        McuSystemBusClk: McuPeripheralClock=200000000, McuUnitName=CLK_SBUS
        McuTAUJClk: McuPeripheralClock=240000, McuSrcClockSel=MCU_CLK_LSOSC, McuUnitName=CLK_TAUJ
        McuUltraHighSpeedPeriClk: McuPeripheralClock=160000000, McuUnitName=CLK_UHSB
        McuWDTClk: McuPeripheralClock=312500, McuSrcClockSel=MCU_CLK_HSOSC_D640, McuUnitName=CLK_WDT
        McuWDTClkA: McuPeripheralClock=240000, McuSrcClockSel=MCU_CLK_LSOSC, McuUnitName=CLKA_WDT
        McuRCANClk: McuPeripheralClock=20000000, McuSrcClockSel=MCU_CLK_MOSC, McuUnitName=CLK_RCAN
      McuMode_RUN (McuModeSettingConf): McuMode=0, McuModeType=MCU_RUN_MODE, McuWakeUpFactor=false
      McuVmonSettingConf: McuDmonDiagOperation=false, McuVmonDiagOperation=false
        McuDmonDetailSettingConf:
          McuDmonFilterSelect = MCU_VMON_DMONFLTW_NONE
          McuDmoncirren = MCU_VMON_DMONCIRREN_DIS
          McuDmonflten = MCU_VMON_DMONFLTEN_DIS
          McuDmonlde = MCU_VMON_DMONLDE_DIS
        McuVmonDetailSettingConf:
          McuVmonAwovddfbistme = MCU_VMON_AWOVDDFBISTME_EN
          McuVmonE0Vcccirren = MCU_VMON_E0VCCCIRREN_DIS
          McuVmonIsovddcirren = MCU_VMON_ISOVDDCIRREN_DIS
          McuVmonIsovddfbistme = MCU_VMON_ISOVDDFBISTME_EN
          McuVmonVcccirren = MCU_VMON_VCCCIRREN_DIS
    McuPublishedInformation
      McuResetReasonConf: McuResetReason=0
      McuRstRsnConfAdParityErrRst: McuResetReason=46
      McuRstRsnConfAdrbusEdcEccErrRst: McuResetReason=83
      McuRstRsnConfBusBridgecompErrorRst: McuResetReason=23
      McuRstRsnConfCanramEcc1bitErrRst: McuResetReason=71
      McuRstRsnConfCanramEcc2bitErrRst: McuResetReason=70
      McuRstRsnConfCflhEcc1bitErrRst: McuResetReason=50
      McuRstRsnConfCflhEcc2bitErrRst: McuResetReason=49
      McuRstRsnConfCflhErrAdrOflowRst: McuResetReason=51
      McuRstRsnConfCflhErrAdrPrtyErrRst: McuResetReason=48
      McuRstRsnConfClmaErrPe0Rst: McuResetReason=103
      McuRstRsnConfClmaErrPe1Rst: McuResetReason=114
      McuRstRsnConfClmaErrPe2Rst: McuResetReason=125
      McuRstRsnConfClmaErrPe3Rst: McuResetReason=136
      McuRstRsnConfClmaHbusErrRst: McuResetReason=36
      McuRstRsnConfClmaHoscErrRst: McuResetReason=32
      McuRstRsnConfClmaLoscErrRst: McuResetReason=33
      McuRstRsnConfClmaLsbErrRst: McuResetReason=34
      McuRstRsnConfClmaMoscErrRst: McuResetReason=31
      McuRstRsnConfClmaUhsbErrRst: McuResetReason=35
      McuRstRsnConfCramAdrOrEcc2ErrRst: McuResetReason=58
      McuRstRsnConfCramBusRst: McuResetReason=27
      McuRstRsnConfCramEcc1bitErrRst: McuResetReason=59
      McuRstRsnConfCramErrAdrOflowRst: McuResetReason=60
      McuRstRsnConfCramGuardErrRst: McuResetReason=86
      McuRstRsnConfDataAccessErrPe0Rst: McuResetReason=110
      McuRstRsnConfDataAccessErrPe1Rst: McuResetReason=121
      McuRstRsnConfDataAccessErrPe2Rst: McuResetReason=132
      McuRstRsnConfDataAccessErrPe3Rst: McuResetReason=143
      McuRstRsnConfDataTransDmaOrDtsErrRst: McuResetReason=90
      McuRstRsnConfDataTransHbusErrRst: McuResetReason=91
      McuRstRsnConfDatabusEcc1bitErrRst: McuResetReason=85
      McuRstRsnConfDatabusEcc2bitErrRst: McuResetReason=84
      McuRstRsnConfDclsCompErrPe0Rst: McuResetReason=100
      McuRstRsnConfDclsCompErrPe1Rst: McuResetReason=111
      McuRstRsnConfDclsCompErrPe2Rst: McuResetReason=122
      McuRstRsnConfDclsCompErrPe3Rst: McuResetReason=133
      McuRstRsnConfDeepstopRst: McuResetReason=8
      McuRstRsnConfDflhEcc1bitErrRst: McuResetReason=53
      McuRstRsnConfDflhEcc2bitErrRst: McuResetReason=52
      McuRstRsnConfDflhErrAdrOflowRst: McuResetReason=54
      McuRstRsnConfDmaCompErrRst: McuResetReason=22
      McuRstRsnConfDtsCompErrRst: McuResetReason=21
      McuRstRsnConfDtsramEcc1bitErrRst: McuResetReason=62
      McuRstRsnConfDtsramEcc2bitErrRst: McuResetReason=61
      McuRstRsnConfDtsramErrAdrOflowRst: McuResetReason=63
      McuRstRsnConfEcmAppRst: McuResetReason=7
      McuRstRsnConfEcmCompErrRst: McuResetReason=12
      McuRstRsnConfEcmDlyTimerOflowRst: McuResetReason=11
      McuRstRsnConfEcmSysRst: McuResetReason=4
      McuRstRsnConfExtErrin0Rst: McuResetReason=92
      McuRstRsnConfExtErrin1Rst: McuResetReason=93
      McuRstRsnConfExtErrin2Rst: McuResetReason=94
      McuRstRsnConfExtErrin3Rst: McuResetReason=95
      McuRstRsnConfExtRst: McuResetReason=1
      McuRstRsnConfFlashAccessErrRst: McuResetReason=20
      McuRstRsnConfFrramEcc1bitErrRst: McuResetReason=69
      McuRstRsnConfFrramEcc2bitErrRst: McuResetReason=68
      McuRstRsnConfGethramEcc1bitErrRst: McuResetReason=79
      McuRstRsnConfGethramEcc2bitErrRst: McuResetReason=78
      McuRstRsnConfGlobalFlashBusRst: McuResetReason=29
      McuRstRsnConfGtmramEcc1bitErrRst: McuResetReason=75
      McuRstRsnConfGtmramEcc2bitErrRst: McuResetReason=74
      McuRstRsnConfHbusGuardErrRst: McuResetReason=89
      McuRstRsnConfIbusGuardErrRst: McuResetReason=87
      McuRstRsnConfIcacheAdrOrEdcErrPe0Rst: McuResetReason=107
      McuRstRsnConfIcacheAdrOrEdcErrPe1Rst: McuResetReason=118
      McuRstRsnConfIcacheAdrOrEdcErrPe2Rst: McuResetReason=129
      McuRstRsnConfIcacheAdrOrEdcErrPe3Rst: McuResetReason=140
      McuRstRsnConfIcumSwAppRst: McuResetReason=10
      McuRstRsnConfIcumSwSysRst: McuResetReason=9
      McuRstRsnConfInterClusterBusRst: McuResetReason=25
      McuRstRsnConfInterProcElementBusRst: McuResetReason=24
      McuRstRsnConfLocalFlashBusRst: McuResetReason=30
      McuRstRsnConfLramAdrOrEcc2ErrPe0Rst: McuResetReason=104
      McuRstRsnConfLramAdrOrEcc2ErrPe1Rst: McuResetReason=115
      McuRstRsnConfLramAdrOrEcc2ErrPe2Rst: McuResetReason=126
      McuRstRsnConfLramAdrOrEcc2ErrPe3Rst: McuResetReason=137
      McuRstRsnConfLramEcc1ErrPe0Rst: McuResetReason=105
      McuRstRsnConfLramEcc1ErrPe1Rst: McuResetReason=116
      McuRstRsnConfLramEcc1ErrPe2Rst: McuResetReason=127
      McuRstRsnConfLramEcc1ErrPe3Rst: McuResetReason=138
      McuRstRsnConfLramEcc1bitErrRst: McuResetReason=56
      McuRstRsnConfLramEcc2bitErrRst: McuResetReason=55
      McuRstRsnConfLramErrAdrOflowRst: McuResetReason=57
      McuRstRsnConfLramErradrOflowPe0Rst: McuResetReason=106
      McuRstRsnConfLramErradrOflowPe1Rst: McuResetReason=117
      McuRstRsnConfLramErradrOflowPe2Rst: McuResetReason=128
      McuRstRsnConfLramErradrOflowPe3Rst: McuResetReason=139
      McuRstRsnConfMethramEcc1bitErrRst: McuResetReason=77
      McuRstRsnConfMethramEcc2bitErrRst: McuResetReason=76
      McuRstRsnConfMmcaRamEcc1bitErrRst: McuResetReason=81
      McuRstRsnConfMmcaRamEcc2bitErrRst: McuResetReason=80
      McuRstRsnConfModeErr0Rst: McuResetReason=13
      McuRstRsnConfModeErr1Rst: McuResetReason=14
      McuRstRsnConfModeErr2Rst: McuResetReason=15
      McuRstRsnConfModeErr3Rst: McuResetReason=16
      McuRstRsnConfModeErr4Rst: McuResetReason=17
      McuRstRsnConfModeErr5Rst: McuResetReason=18
      McuRstRsnConfModeErr6Rst: McuResetReason=19
      McuRstRsnConfModeUnintDebugEnablePe0Rst: McuResetReason=101
      McuRstRsnConfModeUnintDebugEnablePe1Rst: McuResetReason=112
      McuRstRsnConfModeUnintDebugEnablePe2Rst: McuResetReason=123
      McuRstRsnConfModeUnintDebugEnablePe3Rst: McuResetReason=134
      McuRstRsnConfMspiramEcc1bitErrRst: McuResetReason=73
      McuRstRsnConfMspiramEcc2bitErrRst: McuResetReason=72
      McuRstRsnConfMultiRst: McuResetReason=144
      McuRstRsnConfNonRst: McuResetReason=146
      McuRstRsnConfOstm1IntRst: McuResetReason=37
      McuRstRsnConfOstm2IntRst: McuResetReason=38
      McuRstRsnConfOstm3IntRst: McuResetReason=39
      McuRstRsnConfOstm4IntRst: McuResetReason=40
      McuRstRsnConfOstm5IntRst: McuResetReason=41
      McuRstRsnConfOstm6IntRst: McuResetReason=42
      McuRstRsnConfOstm7IntRst: McuResetReason=43
      McuRstRsnConfOstm8IntRst: McuResetReason=44
      McuRstRsnConfOstm9IntRst: McuResetReason=45
      McuRstRsnConfPbusGuardErrRst: McuResetReason=88
      McuRstRsnConfPegOtherLramreqPe0Rst: McuResetReason=109
      McuRstRsnConfPegOtherLramreqPe1Rst: McuResetReason=120
      McuRstRsnConfPegOtherLramreqPe2Rst: McuResetReason=131
      McuRstRsnConfPegOtherLramreqPe3Rst: McuResetReason=142
      McuRstRsnConfPeguardErrPe0Rst: McuResetReason=108
      McuRstRsnConfPeguardErrPe1Rst: McuResetReason=119
      McuRstRsnConfPeguardErrPe2Rst: McuResetReason=130
      McuRstRsnConfPeguardErrPe3Rst: McuResetReason=141
      McuRstRsnConfPeriRamEccOflowErrRst: McuResetReason=82
      McuRstRsnConfPheripheralBusRst: McuResetReason=26
      McuRstRsnConfPowerOnReset: McuResetReason=0
      McuRstRsnConfResetUndefined: McuResetReason=145
      McuRstRsnConfSdmac0RamEcc1bitErrRst: McuResetReason=65
      McuRstRsnConfSdmac0RamEcc2bitErrRst: McuResetReason=64
      McuRstRsnConfSdmac1RamEcc1bitErrRst: McuResetReason=67
      McuRstRsnConfSdmac1RamEcc2bitErrRst: McuResetReason=66
      McuRstRsnConfSwAlarm0Rst: McuResetReason=96
      McuRstRsnConfSwAlarm1Rst: McuResetReason=97
      McuRstRsnConfSwAlarm2Rst: McuResetReason=98
      McuRstRsnConfSwAlarm3Rst: McuResetReason=99
      McuRstRsnConfSwAppRst: McuResetReason=6
      McuRstRsnConfSwSysRst: McuResetReason=3
      McuRstRsnConfSystemBusRst: McuResetReason=28
      McuRstRsnConfTempSensorerrRst: McuResetReason=47
      McuRstRsnConfVmonRst: McuResetReason=2
      McuRstRsnConfWdtErrPe0Rst: McuResetReason=102
      McuRstRsnConfWdtErrPe1Rst: McuResetReason=113
      McuRstRsnConfWdtErrPe2Rst: McuResetReason=124
      McuRstRsnConfWdtErrPe3Rst: McuResetReason=135
      McuRstRsnConfWdtbaSysRst: McuResetReason=5
