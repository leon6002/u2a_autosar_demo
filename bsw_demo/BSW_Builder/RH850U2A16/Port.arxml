AUTOSAR XML (schema 00048)
package /RH850U2A16
  module config Port: implementation-config-variant=VARIANT-POST-BUILD, module-description=Port_Impl
    PortGeneral:
      PortCriticalSectionProtection = true
      PortDevErrorDetect = false
      PortDeviceName = R7F702300BFABA
      PortEcmErrorInApi = true
      PortJTAGForDebugging = true
      PortMaxMode = 8
      PortSetPinDefaultDirectionApi = true
      PortSetPinDirectionApi = true
      PortSetPinModeApi = true
      PortSetToDioAltModeApi = true
      PortUnlockSequenceCount = 50
      PortVersionCheckExternalModules = false
      PortVersionInfoApi = false
    PortConfigSet
      PortContainer: PortNumberOfPortPins=1
        PortPin:
          PortPinDirection = PORT_PIN_OUT
          PortPinDirectionChangeable = false
          PortPinId = 1
          PortPinInitialMode = PORT_PIN_MODE_DIO
          PortPinLevelValue = PORT_PIN_LEVEL_LOW
          PortPinMode = PORT_PIN_MODE_DIO
          PortPinModeChangeable = false
      PortGroup3
        PortPin2_CAN2TX_CAN_1_TX (PortPin2):
          PortBiDirectionControl = false
          PortDriveStrengthControl = DRIVE_STRENGTH_TYPE_1_SUPP_PDSC_PUCC
          PortInputBufferControl = false
          PortInputSelection = INPUT_BUFFER_TYPE_SCH1
          PortIpControl = false
          PortOpenDrainControl = OUTPUT_BUFFER_TYPE_PUSHPULL_SUPP_PODC_PODCE
          PortOutputLevelInversion = false
          PortPinDioAltModeChangeable = false
          PortPinDirection = PORT_PIN_OUT
          PortPinDirectionChangeable = false
          PortPinInitialMode = CAN2TX_ALT2_OUT_SUPP_PFC_PFCE_PFCAE_PMCSR
          PortPinLevelValue = PORT_PIN_LEVEL_LOW
          PortPinModeChangeable = false
          PortPinSafeStateControl = false
          PortPinSafeStateTrigger = ERROROUTZ0
          PortPullDownOption = false
          PortPullUpOption = false
        PortPin3_CAN2RX_CAN_1_RX (PortPin3):
          PortBiDirectionControl = false
          PortDriveStrengthControl = DRIVE_STRENGTH_TYPE_1_SUPP_PDSC_PUCC
          PortInputBufferControl = false
          PortInputSelection = INPUT_BUFFER_TYPE_SCH1
          PortIpControl = false
          PortOpenDrainControl = OUTPUT_BUFFER_TYPE_PUSHPULL_SUPP_PODC_PODCE
          PortOutputLevelInversion = false
          PortPinDioAltModeChangeable = false
          PortPinDirection = PORT_PIN_IN
          PortPinDirectionChangeable = false
          PortPinInitialMode = CAN2RX_INTP2_ALT2_IN_SUPP_PFC_PFCE_PFCAE_PMCSR
          PortPinLevelValue = PORT_PIN_LEVEL_LOW
          PortPinModeChangeable = false
          PortPinSafeStateControl = false
          PortPinSafeStateTrigger = ERROROUTZ0
          PortPullDownOption = false
          PortPullUpOption = false
        PortPin4:
          PortBiDirectionControl = false
          PortDriveStrengthControl = DRIVE_STRENGTH_TYPE_1_SUPP_PDSC_PUCC
          PortInputBufferControl = false
          PortInputSelection = INPUT_BUFFER_TYPE_SCH1
          PortIpControl = false
          PortOpenDrainControl = OUTPUT_BUFFER_TYPE_PUSHPULL_SUPP_PODC_PODCE
          PortOutputLevelInversion = false
          PortPinDioAltModeChangeable = false
          PortPinDirection = PORT_PIN_IN
          PortPinDirectionChangeable = false
          PortPinInitialMode = DIO_SUPP_PFC_PFCE_PFCAE_PFCEAE_PMCSR
          PortPinLevelValue = PORT_PIN_LEVEL_LOW
          PortPinModeChangeable = false
          PortPinSafeStateControl = false
          PortPinSafeStateTrigger = ERROROUTZ0
          PortPullDownOption = false
          PortPullUpOption = false
        PortPin5:
          PortBiDirectionControl = false
          PortDriveStrengthControl = DRIVE_STRENGTH_TYPE_1_SUPP_PDSC_PUCC
          PortInputBufferControl = false
          PortInputSelection = INPUT_BUFFER_TYPE_SCH1
          PortIpControl = false
          PortOpenDrainControl = OUTPUT_BUFFER_TYPE_PUSHPULL_SUPP_PODC_PODCE
          PortOutputLevelInversion = false
          PortPinDioAltModeChangeable = false
          PortPinDirection = PORT_PIN_IN
          PortPinDirectionChangeable = false
          PortPinInitialMode = DIO_SUPP_PFC_PFCE_PFCAE_PFCEAE_PMCSR
          PortPinLevelValue = PORT_PIN_LEVEL_LOW
          PortPinModeChangeable = false
          PortPinSafeStateControl = false
          PortPinSafeStateTrigger = ERROROUTZ0
          PortPullDownOption = false
          PortPullUpOption = false
        PortPin6:
          PortBiDirectionControl = false
          PortDriveStrengthControl = DRIVE_STRENGTH_TYPE_1_SUPP_PDSC_PUCC
          PortInputBufferControl = false
          PortInputSelection = INPUT_BUFFER_TYPE_SCH1
          PortIpControl = false
          PortOpenDrainControl = OUTPUT_BUFFER_TYPE_PUSHPULL_SUPP_PODC_PODCE
          PortOutputLevelInversion = false
          PortPinDioAltModeChangeable = false
          PortPinDirection = PORT_PIN_IN
          PortPinDirectionChangeable = false
          PortPinInitialMode = DIO_SUPP_PFC_PFCE_PFCAE_PFCEAE_PMCSR
          PortPinLevelValue = PORT_PIN_LEVEL_LOW
          PortPinModeChangeable = false
          PortPinSafeStateControl = false
          PortPinSafeStateTrigger = ERROROUTZ0
          PortPullDownOption = false
          PortPullUpOption = false
        PortPin7:
          PortBiDirectionControl = false
          PortDriveStrengthControl = DRIVE_STRENGTH_TYPE_1_SUPP_PDSC_PUCC
          PortInputBufferControl = false
          PortInputSelection = INPUT_BUFFER_TYPE_SCH1
          PortIpControl = false
          PortOpenDrainControl = OUTPUT_BUFFER_TYPE_PUSHPULL_SUPP_PODC_PODCE
          PortOutputLevelInversion = false
          PortPinDioAltModeChangeable = false
          PortPinDirection = PORT_PIN_IN
          PortPinDirectionChangeable = false
          PortPinInitialMode = DIO_SUPP_PFC_PFCE_PFCAE_PFCEAE_PMCSR
          PortPinLevelValue = PORT_PIN_LEVEL_LOW
          PortPinModeChangeable = false
          PortPinSafeStateControl = false
          PortPinSafeStateTrigger = ERROROUTZ0
          PortPullDownOption = false
          PortPullUpOption = false
        PortPin8:
          PortBiDirectionControl = false
          PortDriveStrengthControl = DRIVE_STRENGTH_TYPE_1_SUPP_PDSC_PUCC
          PortInputBufferControl = false
          PortInputSelection = INPUT_BUFFER_TYPE_SCH1
          PortIpControl = false
          PortOpenDrainControl = OUTPUT_BUFFER_TYPE_PUSHPULL_SUPP_PODC_PODCE
          PortOutputLevelInversion = false
          PortPinDioAltModeChangeable = false
          PortPinDirection = PORT_PIN_IN
          PortPinDirectionChangeable = false
          PortPinInitialMode = DIO_SUPP_PFC_PFCE_PFCAE_PFCEAE_PMCSR
          PortPinLevelValue = PORT_PIN_LEVEL_LOW
          PortPinModeChangeable = false
          PortPinSafeStateControl = false
          PortPinSafeStateTrigger = ERROROUTZ0
          PortPullDownOption = false
          PortPullUpOption = false
      PortGroupJtag0
        PortPin0:
          PortBiDirectionControl = false
          PortDriveStrengthControl = DRIVE_STRENGTH_TYPE_1_SUPP_PDSC_PUCC
          PortInputBufferControl = true
          PortInputSelection = INPUT_BUFFER_TYPE_SCH1
          PortOpenDrainControl = OUTPUT_BUFFER_TYPE_PUSHPULL_SUPP_PODC_PODCE
          PortOutputLevelInversion = false
          PortPinDioAltModeChangeable = false
          PortPinDirection = PORT_PIN_IN
          PortPinDirectionChangeable = false
          PortPinInitialMode = DIO_SUPP_PFC_PFCE_PFCAE_PFCEAE_PMCSR
          PortPinLevelValue = PORT_PIN_LEVEL_LOW
          PortPinModeChangeable = false
          PortPullDownOption = false
          PortPullUpOption = true
        PortPin1:
          PortBiDirectionControl = false
          PortDriveStrengthControl = DRIVE_STRENGTH_TYPE_1_SUPP_PDSC_PUCC
          PortInputBufferControl = false
          PortInputSelection = INPUT_BUFFER_TYPE_SCH1
          PortOpenDrainControl = OUTPUT_BUFFER_TYPE_PUSHPULL_SUPP_PODC_PODCE
          PortOutputLevelInversion = false
          PortPinDioAltModeChangeable = false
          PortPinDirection = PORT_PIN_IN
          PortPinDirectionChangeable = false
          PortPinInitialMode = DIO_SUPP_PFC_PFCE_PFCAE_PFCEAE_PMCSR
          PortPinLevelValue = PORT_PIN_LEVEL_LOW
          PortPinModeChangeable = false
          PortPullDownOption = false
          PortPullUpOption = false
        PortPin2:
          PortBiDirectionControl = false
          PortDriveStrengthControl = DRIVE_STRENGTH_TYPE_1_SUPP_PDSC_PUCC
          PortInputBufferControl = true
          PortInputSelection = INPUT_BUFFER_TYPE_SCH1
          PortOpenDrainControl = OUTPUT_BUFFER_TYPE_PUSHPULL_SUPP_PODC_PODCE
          PortOutputLevelInversion = false
          PortPinDioAltModeChangeable = false
          PortPinDirection = PORT_PIN_IN
          PortPinDirectionChangeable = false
          PortPinInitialMode = DIO_SUPP_PFC_PFCE_PFCAE_PFCEAE_PMCSR
          PortPinLevelValue = PORT_PIN_LEVEL_LOW
          PortPinModeChangeable = false
          PortPullDownOption = false
          PortPullUpOption = true
        PortPin3:
          PortBiDirectionControl = false
          PortDriveStrengthControl = DRIVE_STRENGTH_TYPE_1_SUPP_PDSC_PUCC
          PortInputBufferControl = false
          PortInputSelection = INPUT_BUFFER_TYPE_SCH1
          PortOpenDrainControl = OUTPUT_BUFFER_TYPE_PUSHPULL_SUPP_PODC_PODCE
          PortOutputLevelInversion = false
          PortPinDioAltModeChangeable = false
          PortPinDirection = PORT_PIN_IN
          PortPinDirectionChangeable = false
          PortPinInitialMode = DIO_SUPP_PFC_PFCE_PFCAE_PFCEAE_PMCSR
          PortPinLevelValue = PORT_PIN_LEVEL_LOW
          PortPinModeChangeable = false
          PortPullDownOption = false
          PortPullUpOption = false
        PortPin5:
          PortBiDirectionControl = false
          PortDriveStrengthControl = DRIVE_STRENGTH_TYPE_1_SUPP_PDSC_PUCC
          PortInputBufferControl = false
          PortInputSelection = INPUT_BUFFER_TYPE_SCH1
          PortOpenDrainControl = OUTPUT_BUFFER_TYPE_PUSHPULL_SUPP_PODC_PODCE
          PortOutputLevelInversion = false
          PortPinDioAltModeChangeable = false
          PortPinDirection = PORT_PIN_IN
          PortPinDirectionChangeable = false
          PortPinInitialMode = DIO_SUPP_PFC_PFCE_PFCAE_PFCEAE_PMCSR
          PortPinLevelValue = PORT_PIN_LEVEL_LOW
          PortPinModeChangeable = false
          PortPullDownOption = false
          PortPullUpOption = false
      PortFilterGroupConfig
      PortGroup2
        PortPin0:
          PortBiDirectionControl = false
          PortDriveStrengthControl = DRIVE_STRENGTH_TYPE_1_SUPP_PDSC_PUCC
          PortInputBufferControl = false
          PortInputSelection = INPUT_BUFFER_TYPE_SCH1
          PortIpControl = false
          PortOpenDrainControl = OUTPUT_BUFFER_TYPE_PUSHPULL_SUPP_PODC_PODCE
          PortOutputLevelInversion = false
          PortPinDioAltModeChangeable = false
          PortPinDirection = PORT_PIN_IN
          PortPinDirectionChangeable = false
          PortPinInitialMode = DIO_SUPP_PFC_PFCE_PFCAE_PFCEAE_PMCSR
          PortPinLevelValue = PORT_PIN_LEVEL_LOW
          PortPinModeChangeable = false
          PortPinSafeStateControl = false
          PortPinSafeStateTrigger = ERROROUTZ0
          PortPullDownOption = false
          PortPullUpOption = false
        PortPin1:
          PortBiDirectionControl = false
          PortDriveStrengthControl = DRIVE_STRENGTH_TYPE_1_SUPP_PDSC_PUCC
          PortInputBufferControl = false
          PortInputSelection = INPUT_BUFFER_TYPE_SCH1
          PortIpControl = false
          PortOpenDrainControl = OUTPUT_BUFFER_TYPE_PUSHPULL_SUPP_PODC_PODCE
          PortOutputLevelInversion = false
          PortPinDioAltModeChangeable = false
          PortPinDirection = PORT_PIN_IN
          PortPinDirectionChangeable = false
          PortPinInitialMode = DIO_SUPP_PFC_PFCE_PFCAE_PFCEAE_PMCSR
          PortPinLevelValue = PORT_PIN_LEVEL_LOW
          PortPinModeChangeable = false
          PortPinSafeStateControl = false
          PortPinSafeStateTrigger = ERROROUTZ0
          PortPullDownOption = false
          PortPullUpOption = false
        PortPin10:
          PortBiDirectionControl = false
          PortDriveStrengthControl = DRIVE_STRENGTH_TYPE_1_SUPP_PDSC_PUCC
          PortInputBufferControl = false
          PortInputSelection = INPUT_BUFFER_TYPE_SCH1
          PortIpControl = false
          PortOpenDrainControl = OUTPUT_BUFFER_TYPE_PUSHPULL_SUPP_PODC_PODCE
          PortOutputLevelInversion = false
          PortPinDioAltModeChangeable = false
          PortPinDirection = PORT_PIN_IN
          PortPinDirectionChangeable = false
          PortPinInitialMode = DIO_SUPP_PFC_PFCE_PFCAE_PFCEAE_PMCSR
          PortPinLevelValue = PORT_PIN_LEVEL_LOW
          PortPinModeChangeable = false
          PortPinSafeStateControl = false
          PortPinSafeStateTrigger = ERROROUTZ0
          PortPullDownOption = false
          PortPullUpOption = false
        PortPin11:
          PortBiDirectionControl = false
          PortDriveStrengthControl = DRIVE_STRENGTH_TYPE_1_SUPP_PDSC_PUCC
          PortInputBufferControl = false
          PortInputSelection = INPUT_BUFFER_TYPE_SCH1
          PortIpControl = false
          PortOpenDrainControl = OUTPUT_BUFFER_TYPE_PUSHPULL_SUPP_PODC_PODCE
          PortOutputLevelInversion = false
          PortPinDioAltModeChangeable = false
          PortPinDirection = PORT_PIN_IN
          PortPinDirectionChangeable = false
          PortPinInitialMode = DIO_SUPP_PFC_PFCE_PFCAE_PFCEAE_PMCSR
          PortPinLevelValue = PORT_PIN_LEVEL_LOW
          PortPinModeChangeable = false
          PortPinSafeStateControl = false
          PortPinSafeStateTrigger = ERROROUTZ0
          PortPullDownOption = false
          PortPullUpOption = false
        PortPin12:
          PortBiDirectionControl = false
          PortDriveStrengthControl = DRIVE_STRENGTH_TYPE_1_SUPP_PDSC_PUCC
          PortInputBufferControl = false
          PortInputSelection = INPUT_BUFFER_TYPE_SCH1
          PortIpControl = false
          PortOpenDrainControl = OUTPUT_BUFFER_TYPE_PUSHPULL_SUPP_PODC_PODCE
          PortOutputLevelInversion = false
          PortPinDioAltModeChangeable = false
          PortPinDirection = PORT_PIN_IN
          PortPinDirectionChangeable = false
          PortPinInitialMode = DIO_SUPP_PFC_PFCE_PFCAE_PFCEAE_PMCSR
          PortPinLevelValue = PORT_PIN_LEVEL_LOW
          PortPinModeChangeable = false
          PortPinSafeStateControl = false
          PortPinSafeStateTrigger = ERROROUTZ0
          PortPullDownOption = false
          PortPullUpOption = false
        PortPin13:
          PortBiDirectionControl = false
          PortDriveStrengthControl = DRIVE_STRENGTH_TYPE_1_SUPP_PDSC_PUCC
          PortInputBufferControl = false
          PortInputSelection = INPUT_BUFFER_TYPE_SCH1
          PortIpControl = false
          PortOpenDrainControl = OUTPUT_BUFFER_TYPE_PUSHPULL_SUPP_PODC_PODCE
          PortOutputLevelInversion = false
          PortPinDioAltModeChangeable = false
          PortPinDirection = PORT_PIN_IN
          PortPinDirectionChangeable = false
          PortPinInitialMode = DIO_SUPP_PFC_PFCE_PFCAE_PFCEAE_PMCSR
          PortPinLevelValue = PORT_PIN_LEVEL_LOW
          PortPinModeChangeable = false
          PortPinSafeStateControl = false
          PortPinSafeStateTrigger = ERROROUTZ0
          PortPullDownOption = false
          PortPullUpOption = false
        PortPin14:
          PortBiDirectionControl = false
          PortDriveStrengthControl = DRIVE_STRENGTH_TYPE_1_SUPP_PDSC_PUCC
          PortInputBufferControl = false
          PortInputSelection = INPUT_BUFFER_TYPE_SCH1
          PortIpControl = false
          PortOpenDrainControl = OUTPUT_BUFFER_TYPE_PUSHPULL_SUPP_PODC_PODCE
          PortOutputLevelInversion = false
          PortPinDioAltModeChangeable = false
          PortPinDirection = PORT_PIN_IN
          PortPinDirectionChangeable = false
          PortPinInitialMode = DIO_SUPP_PFC_PFCE_PFCAE_PFCEAE_PMCSR
          PortPinLevelValue = PORT_PIN_LEVEL_LOW
          PortPinModeChangeable = false
          PortPinSafeStateControl = false
          PortPinSafeStateTrigger = ERROROUTZ0
          PortPullDownOption = false
          PortPullUpOption = false
        PortPin15:
          PortBiDirectionControl = false
          PortDriveStrengthControl = DRIVE_STRENGTH_TYPE_1_SUPP_PDSC_PUCC
          PortInputBufferControl = false
          PortInputSelection = INPUT_BUFFER_TYPE_SCH1
          PortIpControl = false
          PortOpenDrainControl = OUTPUT_BUFFER_TYPE_PUSHPULL_SUPP_PODC_PODCE
          PortOutputLevelInversion = false
          PortPinDioAltModeChangeable = false
          PortPinDirection = PORT_PIN_IN
          PortPinDirectionChangeable = false
          PortPinInitialMode = DIO_SUPP_PFC_PFCE_PFCAE_PFCEAE_PMCSR
          PortPinLevelValue = PORT_PIN_LEVEL_LOW
          PortPinModeChangeable = false
          PortPinSafeStateControl = false
          PortPinSafeStateTrigger = ERROROUTZ0
          PortPullDownOption = false
          PortPullUpOption = false
        PortPin2:
          PortBiDirectionControl = false
          PortDriveStrengthControl = DRIVE_STRENGTH_TYPE_1_SUPP_PDSC_PUCC
          PortInputBufferControl = false
          PortInputSelection = INPUT_BUFFER_TYPE_SCH1
          PortIpControl = false
          PortOpenDrainControl = OUTPUT_BUFFER_TYPE_PUSHPULL_SUPP_PODC_PODCE
          PortOutputLevelInversion = false
          PortPinDioAltModeChangeable = false
          PortPinDirection = PORT_PIN_IN
          PortPinDirectionChangeable = false
          PortPinInitialMode = DIO_SUPP_PFC_PFCE_PFCAE_PFCEAE_PMCSR
          PortPinLevelValue = PORT_PIN_LEVEL_LOW
          PortPinModeChangeable = false
          PortPinSafeStateControl = false
          PortPinSafeStateTrigger = ERROROUTZ0
          PortPullDownOption = false
          PortPullUpOption = false
        PortPin3:
          PortBiDirectionControl = false
          PortDriveStrengthControl = DRIVE_STRENGTH_TYPE_1_SUPP_PDSC_PUCC
          PortInputBufferControl = false
          PortInputSelection = INPUT_BUFFER_TYPE_SCH1
          PortIpControl = false
          PortOpenDrainControl = OUTPUT_BUFFER_TYPE_PUSHPULL_SUPP_PODC_PODCE
          PortOutputLevelInversion = false
          PortPinDioAltModeChangeable = false
          PortPinDirection = PORT_PIN_IN
          PortPinDirectionChangeable = false
          PortPinInitialMode = DIO_SUPP_PFC_PFCE_PFCAE_PFCEAE_PMCSR
          PortPinLevelValue = PORT_PIN_LEVEL_LOW
          PortPinModeChangeable = false
          PortPinSafeStateControl = false
          PortPinSafeStateTrigger = ERROROUTZ0
          PortPullDownOption = false
          PortPullUpOption = false
        PortPin4:
          PortBiDirectionControl = false
          PortDriveStrengthControl = DRIVE_STRENGTH_TYPE_1_SUPP_PDSC_PUCC
          PortInputBufferControl = false
          PortInputSelection = INPUT_BUFFER_TYPE_SCH1
          PortIpControl = false
          PortOpenDrainControl = OUTPUT_BUFFER_TYPE_PUSHPULL_SUPP_PODC_PODCE
          PortOutputLevelInversion = false
          PortPinDioAltModeChangeable = false
          PortPinDirection = PORT_PIN_IN
          PortPinDirectionChangeable = false
          PortPinInitialMode = DIO_SUPP_PFC_PFCE_PFCAE_PFCEAE_PMCSR
          PortPinLevelValue = PORT_PIN_LEVEL_LOW
          PortPinModeChangeable = false
          PortPinSafeStateControl = false
          PortPinSafeStateTrigger = ERROROUTZ0
          PortPullDownOption = false
          PortPullUpOption = false
        PortPin5:
          PortBiDirectionControl = false
          PortDriveStrengthControl = DRIVE_STRENGTH_TYPE_1_SUPP_PDSC_PUCC
          PortInputBufferControl = false
          PortInputSelection = INPUT_BUFFER_TYPE_SCH1
          PortIpControl = false
          PortOpenDrainControl = OUTPUT_BUFFER_TYPE_PUSHPULL_SUPP_PODC_PODCE
          PortOutputLevelInversion = false
          PortPinDioAltModeChangeable = false
          PortPinDirection = PORT_PIN_IN
          PortPinDirectionChangeable = false
          PortPinInitialMode = DIO_SUPP_PFC_PFCE_PFCAE_PFCEAE_PMCSR
          PortPinLevelValue = PORT_PIN_LEVEL_LOW
          PortPinModeChangeable = false
          PortPinSafeStateControl = false
          PortPinSafeStateTrigger = ERROROUTZ0
          PortPullDownOption = false
          PortPullUpOption = false
        PortPin6:
          PortBiDirectionControl = false
          PortDriveStrengthControl = DRIVE_STRENGTH_TYPE_1_SUPP_PDSC_PUCC
          PortInputBufferControl = false
          PortInputSelection = INPUT_BUFFER_TYPE_SCH1
          PortIpControl = false
          PortOpenDrainControl = OUTPUT_BUFFER_TYPE_PUSHPULL_SUPP_PODC_PODCE
          PortOutputLevelInversion = false
          PortPinDioAltModeChangeable = false
          PortPinDirection = PORT_PIN_IN
          PortPinDirectionChangeable = false
          PortPinInitialMode = DIO_SUPP_PFC_PFCE_PFCAE_PFCEAE_PMCSR
          PortPinLevelValue = PORT_PIN_LEVEL_LOW
          PortPinModeChangeable = false
          PortPinSafeStateControl = false
          PortPinSafeStateTrigger = ERROROUTZ0
          PortPullDownOption = false
          PortPullUpOption = false
        PortPin7:
          PortBiDirectionControl = false
          PortDriveStrengthControl = DRIVE_STRENGTH_TYPE_1_SUPP_PDSC_PUCC
          PortInputBufferControl = false
          PortInputSelection = INPUT_BUFFER_TYPE_SCH1
          PortIpControl = false
          PortOpenDrainControl = OUTPUT_BUFFER_TYPE_PUSHPULL_SUPP_PODC_PODCE
          PortOutputLevelInversion = false
          PortPinDioAltModeChangeable = false
          PortPinDirection = PORT_PIN_IN
          PortPinDirectionChangeable = false
          PortPinInitialMode = DIO_SUPP_PFC_PFCE_PFCAE_PFCEAE_PMCSR
          PortPinLevelValue = PORT_PIN_LEVEL_LOW
          PortPinModeChangeable = false
          PortPinSafeStateControl = false
          PortPinSafeStateTrigger = ERROROUTZ0
          PortPullDownOption = false
          PortPullUpOption = false
        PortPin8:
          PortBiDirectionControl = false
          PortDriveStrengthControl = DRIVE_STRENGTH_TYPE_1_SUPP_PDSC_PUCC
          PortInputBufferControl = false
          PortInputSelection = INPUT_BUFFER_TYPE_SCH1
          PortIpControl = false
          PortOpenDrainControl = OUTPUT_BUFFER_TYPE_PUSHPULL_SUPP_PODC_PODCE
          PortOutputLevelInversion = false
          PortPinDioAltModeChangeable = false
          PortPinDirection = PORT_PIN_IN
          PortPinDirectionChangeable = false
          PortPinInitialMode = DIO_SUPP_PFC_PFCE_PFCAE_PFCEAE_PMCSR
          PortPinLevelValue = PORT_PIN_LEVEL_LOW
          PortPinModeChangeable = false
          PortPinSafeStateControl = false
          PortPinSafeStateTrigger = ERROROUTZ0
          PortPullDownOption = false
          PortPullUpOption = false
        PortPin9:
          PortBiDirectionControl = false
          PortDriveStrengthControl = DRIVE_STRENGTH_TYPE_1_SUPP_PDSC_PUCC
          PortInputBufferControl = false
          PortInputSelection = INPUT_BUFFER_TYPE_SCH1
          PortIpControl = false
          PortOpenDrainControl = OUTPUT_BUFFER_TYPE_PUSHPULL_SUPP_PODC_PODCE
          PortOutputLevelInversion = false
          PortPinDioAltModeChangeable = false
          PortPinDirection = PORT_PIN_IN
          PortPinDirectionChangeable = false
          PortPinInitialMode = DIO_SUPP_PFC_PFCE_PFCAE_PFCEAE_PMCSR
          PortPinLevelValue = PORT_PIN_LEVEL_LOW
          PortPinModeChangeable = false
          PortPinSafeStateControl = false
          PortPinSafeStateTrigger = ERROROUTZ0
          PortPullDownOption = false
          PortPullUpOption = false
      PortGroup4
        PortPin0:
          PortBiDirectionControl = false
          PortDriveStrengthControl = DRIVE_STRENGTH_TYPE_1_SUPP_PDSC_PUCC
          PortInputBufferControl = false
          PortInputSelection = INPUT_BUFFER_TYPE_SCH1
          PortIpControl = false
          PortOpenDrainControl = OUTPUT_BUFFER_TYPE_PUSHPULL_SUPP_PODC_PODCE
          PortOutputLevelInversion = false
          PortPinDioAltModeChangeable = false
          PortPinDirection = PORT_PIN_IN
          PortPinDirectionChangeable = false
          PortPinInitialMode = DIO_SUPP_PFC_PFCE_PFCAE_PFCEAE_PMCSR
          PortPinLevelValue = PORT_PIN_LEVEL_LOW
          PortPinModeChangeable = false
          PortPinSafeStateControl = false
          PortPinSafeStateTrigger = ERROROUTZ0
          PortPullDownOption = false
          PortPullUpOption = false
        PortPin1:
          PortBiDirectionControl = false
          PortDriveStrengthControl = DRIVE_STRENGTH_TYPE_1_SUPP_PDSC_PUCC
          PortInputBufferControl = false
          PortInputSelection = INPUT_BUFFER_TYPE_SCH1
          PortIpControl = false
          PortOpenDrainControl = OUTPUT_BUFFER_TYPE_PUSHPULL_SUPP_PODC_PODCE
          PortOutputLevelInversion = false
          PortPinDioAltModeChangeable = false
          PortPinDirection = PORT_PIN_IN
          PortPinDirectionChangeable = false
          PortPinInitialMode = DIO_SUPP_PFC_PFCE_PFCAE_PFCEAE_PMCSR
          PortPinLevelValue = PORT_PIN_LEVEL_LOW
          PortPinModeChangeable = false
          PortPinSafeStateControl = false
          PortPinSafeStateTrigger = ERROROUTZ0
          PortPullDownOption = false
          PortPullUpOption = false
        PortPin10:
          PortBiDirectionControl = false
          PortDriveStrengthControl = DRIVE_STRENGTH_TYPE_1_SUPP_PDSC_PUCC
          PortInputBufferControl = false
          PortInputSelection = INPUT_BUFFER_TYPE_SCH1
          PortIpControl = false
          PortOpenDrainControl = OUTPUT_BUFFER_TYPE_PUSHPULL_SUPP_PODC_PODCE
          PortOutputLevelInversion = false
          PortPinDioAltModeChangeable = false
          PortPinDirection = PORT_PIN_IN
          PortPinDirectionChangeable = false
          PortPinInitialMode = DIO_SUPP_PFC_PFCE_PFCAE_PFCEAE_PMCSR
          PortPinLevelValue = PORT_PIN_LEVEL_LOW
          PortPinModeChangeable = false
          PortPinSafeStateControl = false
          PortPinSafeStateTrigger = ERROROUTZ0
          PortPullDownOption = false
          PortPullUpOption = false
        PortPin11:
          PortBiDirectionControl = false
          PortDriveStrengthControl = DRIVE_STRENGTH_TYPE_1_SUPP_PDSC_PUCC
          PortInputBufferControl = false
          PortInputSelection = INPUT_BUFFER_TYPE_SCH1
          PortIpControl = false
          PortOpenDrainControl = OUTPUT_BUFFER_TYPE_PUSHPULL_SUPP_PODC_PODCE
          PortOutputLevelInversion = false
          PortPinDioAltModeChangeable = false
          PortPinDirection = PORT_PIN_IN
          PortPinDirectionChangeable = false
          PortPinInitialMode = DIO_SUPP_PFC_PFCE_PFCAE_PFCEAE_PMCSR
          PortPinLevelValue = PORT_PIN_LEVEL_LOW
          PortPinModeChangeable = false
          PortPinSafeStateControl = false
          PortPinSafeStateTrigger = ERROROUTZ0
          PortPullDownOption = false
          PortPullUpOption = false
        PortPin12:
          PortBiDirectionControl = false
          PortDriveStrengthControl = DRIVE_STRENGTH_TYPE_1_SUPP_PDSC_PUCC
          PortInputBufferControl = false
          PortInputSelection = INPUT_BUFFER_TYPE_SCH1
          PortIpControl = false
          PortOpenDrainControl = OUTPUT_BUFFER_TYPE_PUSHPULL_SUPP_PODC_PODCE
          PortOutputLevelInversion = false
          PortPinDioAltModeChangeable = false
          PortPinDirection = PORT_PIN_IN
          PortPinDirectionChangeable = false
          PortPinInitialMode = DIO_SUPP_PFC_PFCE_PFCAE_PFCEAE_PMCSR
          PortPinLevelValue = PORT_PIN_LEVEL_LOW
          PortPinModeChangeable = false
          PortPinSafeStateControl = false
          PortPinSafeStateTrigger = ERROROUTZ0
          PortPullDownOption = false
          PortPullUpOption = false
        PortPin13:
          PortBiDirectionControl = false
          PortDriveStrengthControl = DRIVE_STRENGTH_TYPE_1_SUPP_PDSC_PUCC
          PortInputBufferControl = false
          PortInputSelection = INPUT_BUFFER_TYPE_SCH1
          PortIpControl = false
          PortOpenDrainControl = OUTPUT_BUFFER_TYPE_PUSHPULL_SUPP_PODC_PODCE
          PortOutputLevelInversion = false
          PortPinDioAltModeChangeable = false
          PortPinDirection = PORT_PIN_IN
          PortPinDirectionChangeable = false
          PortPinInitialMode = DIO_SUPP_PFC_PFCE_PFCAE_PFCEAE_PMCSR
          PortPinLevelValue = PORT_PIN_LEVEL_LOW
          PortPinModeChangeable = false
          PortPinSafeStateControl = false
          PortPinSafeStateTrigger = ERROROUTZ0
          PortPullDownOption = false
          PortPullUpOption = false
        PortPin14:
          PortBiDirectionControl = false
          PortDriveStrengthControl = DRIVE_STRENGTH_TYPE_1_SUPP_PDSC_PUCC
          PortInputBufferControl = false
          PortInputSelection = INPUT_BUFFER_TYPE_SCH1
          PortIpControl = false
          PortOpenDrainControl = OUTPUT_BUFFER_TYPE_PUSHPULL_SUPP_PODC_PODCE
          PortOutputLevelInversion = false
          PortPinDioAltModeChangeable = false
          PortPinDirection = PORT_PIN_IN
          PortPinDirectionChangeable = false
          PortPinInitialMode = DIO_SUPP_PFC_PFCE_PFCAE_PFCEAE_PMCSR
          PortPinLevelValue = PORT_PIN_LEVEL_LOW
          PortPinModeChangeable = false
          PortPinSafeStateControl = false
          PortPinSafeStateTrigger = ERROROUTZ0
          PortPullDownOption = false
          PortPullUpOption = false
        PortPin15:
          PortBiDirectionControl = false
          PortDriveStrengthControl = DRIVE_STRENGTH_TYPE_1_SUPP_PDSC_PUCC
          PortInputBufferControl = false
          PortInputSelection = INPUT_BUFFER_TYPE_SCH1
          PortIpControl = false
          PortOpenDrainControl = OUTPUT_BUFFER_TYPE_PUSHPULL_SUPP_PODC_PODCE
          PortOutputLevelInversion = false
          PortPinDioAltModeChangeable = false
          PortPinDirection = PORT_PIN_IN
          PortPinDirectionChangeable = false
          PortPinInitialMode = DIO_SUPP_PFC_PFCE_PFCAE_PFCEAE_PMCSR
          PortPinLevelValue = PORT_PIN_LEVEL_LOW
          PortPinModeChangeable = false
          PortPinSafeStateControl = false
          PortPinSafeStateTrigger = ERROROUTZ0
          PortPullDownOption = false
          PortPullUpOption = false
        PortPin4:
          PortBiDirectionControl = false
          PortDriveStrengthControl = DRIVE_STRENGTH_TYPE_1_SUPP_PDSC_PUCC
          PortInputBufferControl = false
          PortInputSelection = INPUT_BUFFER_TYPE_SCH1
          PortIpControl = false
          PortOpenDrainControl = OUTPUT_BUFFER_TYPE_PUSHPULL_SUPP_PODC_PODCE
          PortOutputLevelInversion = false
          PortPinDioAltModeChangeable = false
          PortPinDirection = PORT_PIN_IN
          PortPinDirectionChangeable = false
          PortPinInitialMode = DIO_SUPP_PFC_PFCE_PFCAE_PFCEAE_PMCSR
          PortPinLevelValue = PORT_PIN_LEVEL_LOW
          PortPinModeChangeable = false
          PortPinSafeStateControl = false
          PortPinSafeStateTrigger = ERROROUTZ0
          PortPullDownOption = false
          PortPullUpOption = false
        PortPin5:
          PortBiDirectionControl = false
          PortDriveStrengthControl = DRIVE_STRENGTH_TYPE_1_SUPP_PDSC_PUCC
          PortInputBufferControl = false
          PortInputSelection = INPUT_BUFFER_TYPE_SCH1
          PortIpControl = false
          PortOpenDrainControl = OUTPUT_BUFFER_TYPE_PUSHPULL_SUPP_PODC_PODCE
          PortOutputLevelInversion = false
          PortPinDioAltModeChangeable = false
          PortPinDirection = PORT_PIN_IN
          PortPinDirectionChangeable = false
          PortPinInitialMode = DIO_SUPP_PFC_PFCE_PFCAE_PFCEAE_PMCSR
          PortPinLevelValue = PORT_PIN_LEVEL_LOW
          PortPinModeChangeable = false
          PortPinSafeStateControl = false
          PortPinSafeStateTrigger = ERROROUTZ0
          PortPullDownOption = false
          PortPullUpOption = false
        PortPin6:
          PortBiDirectionControl = false
          PortDriveStrengthControl = DRIVE_STRENGTH_TYPE_1_SUPP_PDSC_PUCC
          PortInputBufferControl = false
          PortInputSelection = INPUT_BUFFER_TYPE_SCH1
          PortIpControl = false
          PortOpenDrainControl = OUTPUT_BUFFER_TYPE_PUSHPULL_SUPP_PODC_PODCE
          PortOutputLevelInversion = false
          PortPinDioAltModeChangeable = false
          PortPinDirection = PORT_PIN_IN
          PortPinDirectionChangeable = false
          PortPinInitialMode = DIO_SUPP_PFC_PFCE_PFCAE_PFCEAE_PMCSR
          PortPinLevelValue = PORT_PIN_LEVEL_LOW
          PortPinModeChangeable = false
          PortPinSafeStateControl = false
          PortPinSafeStateTrigger = ERROROUTZ0
          PortPullDownOption = false
          PortPullUpOption = false
        PortPin7:
          PortBiDirectionControl = false
          PortDriveStrengthControl = DRIVE_STRENGTH_TYPE_1_SUPP_PDSC_PUCC
          PortInputBufferControl = false
          PortInputSelection = INPUT_BUFFER_TYPE_SCH1
          PortIpControl = false
          PortOpenDrainControl = OUTPUT_BUFFER_TYPE_PUSHPULL_SUPP_PODC_PODCE
          PortOutputLevelInversion = false
          PortPinDioAltModeChangeable = false
          PortPinDirection = PORT_PIN_IN
          PortPinDirectionChangeable = false
          PortPinInitialMode = DIO_SUPP_PFC_PFCE_PFCAE_PFCEAE_PMCSR
          PortPinLevelValue = PORT_PIN_LEVEL_LOW
          PortPinModeChangeable = false
          PortPinSafeStateControl = false
          PortPinSafeStateTrigger = ERROROUTZ0
          PortPullDownOption = false
          PortPullUpOption = false
        PortPin8:
          PortBiDirectionControl = false
          PortDriveStrengthControl = DRIVE_STRENGTH_TYPE_1_SUPP_PDSC_PUCC
          PortInputBufferControl = false
          PortInputSelection = INPUT_BUFFER_TYPE_SCH1
          PortIpControl = false
          PortOpenDrainControl = OUTPUT_BUFFER_TYPE_PUSHPULL_SUPP_PODC_PODCE
          PortOutputLevelInversion = false
          PortPinDioAltModeChangeable = false
          PortPinDirection = PORT_PIN_IN
          PortPinDirectionChangeable = false
          PortPinInitialMode = DIO_SUPP_PFC_PFCE_PFCAE_PFCEAE_PMCSR
          PortPinLevelValue = PORT_PIN_LEVEL_LOW
          PortPinModeChangeable = false
          PortPinSafeStateControl = false
          PortPinSafeStateTrigger = ERROROUTZ0
          PortPullDownOption = false
          PortPullUpOption = false
        PortPin9:
          PortBiDirectionControl = false
          PortDriveStrengthControl = DRIVE_STRENGTH_TYPE_1_SUPP_PDSC_PUCC
          PortInputBufferControl = false
          PortInputSelection = INPUT_BUFFER_TYPE_SCH1
          PortIpControl = false
          PortOpenDrainControl = OUTPUT_BUFFER_TYPE_PUSHPULL_SUPP_PODC_PODCE
          PortOutputLevelInversion = false
          PortPinDioAltModeChangeable = false
          PortPinDirection = PORT_PIN_IN
          PortPinDirectionChangeable = false
          PortPinInitialMode = DIO_SUPP_PFC_PFCE_PFCAE_PFCEAE_PMCSR
          PortPinLevelValue = PORT_PIN_LEVEL_LOW
          PortPinModeChangeable = false
          PortPinSafeStateControl = false
          PortPinSafeStateTrigger = ERROROUTZ0
          PortPullDownOption = false
          PortPullUpOption = false
      PortGroup5
        PortPin2:
          PortBiDirectionControl = false
          PortDriveStrengthControl = DRIVE_STRENGTH_TYPE_1_SUPP_PDSC_PUCC
          PortInputBufferControl = false
          PortInputSelection = INPUT_BUFFER_TYPE_SCH1
          PortIpControl = false
          PortOpenDrainControl = OUTPUT_BUFFER_TYPE_PUSHPULL_SUPP_PODC_PODCE
          PortOutputLevelInversion = false
          PortPinDioAltModeChangeable = false
          PortPinDirection = PORT_PIN_IN
          PortPinDirectionChangeable = false
          PortPinInitialMode = DIO_SUPP_PFC_PFCE_PFCAE_PFCEAE_PMCSR
          PortPinLevelValue = PORT_PIN_LEVEL_LOW
          PortPinModeChangeable = false
          PortPinSafeStateControl = false
          PortPinSafeStateTrigger = ERROROUTZ0
          PortPullDownOption = false
          PortPullUpOption = false
        PortPin3:
          PortBiDirectionControl = false
          PortDriveStrengthControl = DRIVE_STRENGTH_TYPE_1_SUPP_PDSC_PUCC
          PortInputBufferControl = false
          PortInputSelection = INPUT_BUFFER_TYPE_SCH1
          PortIpControl = false
          PortOpenDrainControl = OUTPUT_BUFFER_TYPE_PUSHPULL_SUPP_PODC_PODCE
          PortOutputLevelInversion = false
          PortPinDioAltModeChangeable = false
          PortPinDirection = PORT_PIN_IN
          PortPinDirectionChangeable = false
          PortPinInitialMode = DIO_SUPP_PFC_PFCE_PFCAE_PFCEAE_PMCSR
          PortPinLevelValue = PORT_PIN_LEVEL_LOW
          PortPinModeChangeable = false
          PortPinSafeStateControl = false
          PortPinSafeStateTrigger = ERROROUTZ0
          PortPullDownOption = false
          PortPullUpOption = false
        PortPin4:
          PortBiDirectionControl = false
          PortDriveStrengthControl = DRIVE_STRENGTH_TYPE_1_SUPP_PDSC_PUCC
          PortInputBufferControl = false
          PortInputSelection = INPUT_BUFFER_TYPE_SCH1
          PortIpControl = false
          PortOpenDrainControl = OUTPUT_BUFFER_TYPE_PUSHPULL_SUPP_PODC_PODCE
          PortOutputLevelInversion = false
          PortPinDioAltModeChangeable = false
          PortPinDirection = PORT_PIN_IN
          PortPinDirectionChangeable = false
          PortPinInitialMode = DIO_SUPP_PFC_PFCE_PFCAE_PFCEAE_PMCSR
          PortPinLevelValue = PORT_PIN_LEVEL_LOW
          PortPinModeChangeable = false
          PortPinSafeStateControl = false
          PortPinSafeStateTrigger = ERROROUTZ0
          PortPullDownOption = false
          PortPullUpOption = false
        PortPin6:
          PortBiDirectionControl = false
          PortDriveStrengthControl = DRIVE_STRENGTH_TYPE_1_SUPP_PDSC_PUCC
          PortInputBufferControl = false
          PortInputSelection = INPUT_BUFFER_TYPE_SCH1
          PortIpControl = false
          PortOpenDrainControl = OUTPUT_BUFFER_TYPE_PUSHPULL_SUPP_PODC_PODCE
          PortOutputLevelInversion = false
          PortPinDioAltModeChangeable = false
          PortPinDirection = PORT_PIN_IN
          PortPinDirectionChangeable = false
          PortPinInitialMode = DIO_SUPP_PFC_PFCE_PFCAE_PFCEAE_PMCSR
          PortPinLevelValue = PORT_PIN_LEVEL_LOW
          PortPinModeChangeable = false
          PortPinSafeStateControl = false
          PortPinSafeStateTrigger = ERROROUTZ0
          PortPullDownOption = false
          PortPullUpOption = false
      PortGroup6
        PortPin0:
          PortBiDirectionControl = false
          PortDriveStrengthControl = DRIVE_STRENGTH_TYPE_1_SUPP_PDSC_PUCC
          PortInputBufferControl = false
          PortInputSelection = INPUT_BUFFER_TYPE_SCH1
          PortIpControl = false
          PortOpenDrainControl = OUTPUT_BUFFER_TYPE_PUSHPULL_SUPP_PODC_PODCE
          PortOutputLevelInversion = false
          PortPinDioAltModeChangeable = false
          PortPinDirection = PORT_PIN_IN
          PortPinDirectionChangeable = false
          PortPinInitialMode = DIO_SUPP_PFC_PFCE_PFCAE_PFCEAE_PMCSR
          PortPinLevelValue = PORT_PIN_LEVEL_LOW
          PortPinModeChangeable = false
          PortPinSafeStateControl = false
          PortPinSafeStateTrigger = ERROROUTZ0
          PortPullDownOption = false
          PortPullUpOption = false
        PortPin10:
          PortBiDirectionControl = false
          PortDriveStrengthControl = DRIVE_STRENGTH_TYPE_1_SUPP_PDSC_PUCC
          PortInputBufferControl = false
          PortInputSelection = INPUT_BUFFER_TYPE_SCH1
          PortOpenDrainControl = OUTPUT_BUFFER_TYPE_PUSHPULL_SUPP_PODC_PODCE
          PortOutputLevelInversion = false
          PortPinDirection = PORT_PIN_IN
          PortPinDirectionChangeable = false
          PortPinInitialMode = DIO_SUPP_PM_PMSR
          PortPinLevelValue = PORT_PIN_LEVEL_LOW
          PortPinSafeStateControl = false
          PortPinSafeStateTrigger = ERROROUTZ0
          PortPullDownOption = false
          PortPullUpOption = false
        PortPin11:
          PortBiDirectionControl = false
          PortDriveStrengthControl = DRIVE_STRENGTH_TYPE_1_SUPP_PDSC_PUCC
          PortInputBufferControl = false
          PortInputSelection = INPUT_BUFFER_TYPE_SCH1
          PortIpControl = false
          PortOpenDrainControl = OUTPUT_BUFFER_TYPE_PUSHPULL_SUPP_PODC_PODCE
          PortOutputLevelInversion = false
          PortPinDioAltModeChangeable = false
          PortPinDirection = PORT_PIN_IN
          PortPinDirectionChangeable = false
          PortPinInitialMode = DIO_SUPP_PFC_PFCE_PFCAE_PFCEAE_PMCSR
          PortPinLevelValue = PORT_PIN_LEVEL_LOW
          PortPinModeChangeable = false
          PortPinSafeStateControl = false
          PortPinSafeStateTrigger = ERROROUTZ0
          PortPullDownOption = false
          PortPullUpOption = false
        PortPin12:
          PortBiDirectionControl = false
          PortDriveStrengthControl = DRIVE_STRENGTH_TYPE_1_SUPP_PDSC_PUCC
          PortInputBufferControl = false
          PortInputSelection = INPUT_BUFFER_TYPE_SCH1
          PortIpControl = false
          PortOpenDrainControl = OUTPUT_BUFFER_TYPE_PUSHPULL_SUPP_PODC_PODCE
          PortOutputLevelInversion = false
          PortPinDioAltModeChangeable = false
          PortPinDirection = PORT_PIN_IN
          PortPinDirectionChangeable = false
          PortPinInitialMode = DIO_SUPP_PFC_PFCE_PFCAE_PFCEAE_PMCSR
          PortPinLevelValue = PORT_PIN_LEVEL_LOW
          PortPinModeChangeable = false
          PortPinSafeStateControl = false
          PortPinSafeStateTrigger = ERROROUTZ0
          PortPullDownOption = false
          PortPullUpOption = false
        PortPin13:
          PortBiDirectionControl = false
          PortDriveStrengthControl = DRIVE_STRENGTH_TYPE_1_SUPP_PDSC_PUCC
          PortInputBufferControl = false
          PortInputSelection = INPUT_BUFFER_TYPE_SCH1
          PortIpControl = false
          PortOpenDrainControl = OUTPUT_BUFFER_TYPE_PUSHPULL_SUPP_PODC_PODCE
          PortOutputLevelInversion = false
          PortPinDioAltModeChangeable = false
          PortPinDirection = PORT_PIN_IN
          PortPinDirectionChangeable = false
          PortPinInitialMode = DIO_SUPP_PFC_PFCE_PFCAE_PFCEAE_PMCSR
          PortPinLevelValue = PORT_PIN_LEVEL_LOW
          PortPinModeChangeable = false
          PortPinSafeStateControl = false
          PortPinSafeStateTrigger = ERROROUTZ0
          PortPullDownOption = false
          PortPullUpOption = false
        PortPin14:
          PortBiDirectionControl = false
          PortDriveStrengthControl = DRIVE_STRENGTH_TYPE_1_SUPP_PDSC_PUCC
          PortInputBufferControl = false
          PortInputSelection = INPUT_BUFFER_TYPE_SCH1
          PortIpControl = false
          PortOpenDrainControl = OUTPUT_BUFFER_TYPE_PUSHPULL_SUPP_PODC_PODCE
          PortOutputLevelInversion = false
          PortPinDioAltModeChangeable = false
          PortPinDirection = PORT_PIN_IN
          PortPinDirectionChangeable = false
          PortPinInitialMode = DIO_SUPP_PFC_PFCE_PFCAE_PFCEAE_PMCSR
          PortPinLevelValue = PORT_PIN_LEVEL_LOW
          PortPinModeChangeable = false
          PortPinSafeStateControl = false
          PortPinSafeStateTrigger = ERROROUTZ0
          PortPullDownOption = false
          PortPullUpOption = false
        PortPin15:
          PortBiDirectionControl = false
          PortDriveStrengthControl = DRIVE_STRENGTH_TYPE_1_SUPP_PDSC_PUCC
          PortInputBufferControl = false
          PortInputSelection = INPUT_BUFFER_TYPE_SCH1
          PortIpControl = false
          PortOpenDrainControl = OUTPUT_BUFFER_TYPE_PUSHPULL_SUPP_PODC_PODCE
          PortOutputLevelInversion = false
          PortPinDioAltModeChangeable = false
          PortPinDirection = PORT_PIN_IN
          PortPinDirectionChangeable = false
          PortPinInitialMode = DIO_SUPP_PFC_PFCE_PFCAE_PFCEAE_PMCSR
          PortPinLevelValue = PORT_PIN_LEVEL_LOW
          PortPinModeChangeable = false
          PortPinSafeStateControl = false
          PortPinSafeStateTrigger = ERROROUTZ0
          PortPullDownOption = false
          PortPullUpOption = false
        PortPin2:
          PortBiDirectionControl = false
          PortDriveStrengthControl = DRIVE_STRENGTH_TYPE_1_SUPP_PDSC_PUCC
          PortInputBufferControl = false
          PortInputSelection = INPUT_BUFFER_TYPE_SCH1
          PortIpControl = false
          PortOpenDrainControl = OUTPUT_BUFFER_TYPE_PUSHPULL_SUPP_PODC_PODCE
          PortOutputLevelInversion = false
          PortPinDioAltModeChangeable = false
          PortPinDirection = PORT_PIN_IN
          PortPinDirectionChangeable = false
          PortPinInitialMode = DIO_SUPP_PFC_PFCE_PFCAE_PFCEAE_PMCSR
          PortPinLevelValue = PORT_PIN_LEVEL_LOW
          PortPinModeChangeable = false
          PortPinSafeStateControl = false
          PortPinSafeStateTrigger = ERROROUTZ0
          PortPullDownOption = false
          PortPullUpOption = false
        PortPin3:
          PortBiDirectionControl = false
          PortDriveStrengthControl = DRIVE_STRENGTH_TYPE_1_SUPP_PDSC_PUCC
          PortInputBufferControl = false
          PortInputSelection = INPUT_BUFFER_TYPE_SCH1
          PortIpControl = false
          PortOpenDrainControl = OUTPUT_BUFFER_TYPE_PUSHPULL_SUPP_PODC_PODCE
          PortOutputLevelInversion = false
          PortPinDioAltModeChangeable = false
          PortPinDirection = PORT_PIN_IN
          PortPinDirectionChangeable = false
          PortPinInitialMode = DIO_SUPP_PFC_PFCE_PFCAE_PFCEAE_PMCSR
          PortPinLevelValue = PORT_PIN_LEVEL_LOW
          PortPinModeChangeable = false
          PortPinSafeStateControl = false
          PortPinSafeStateTrigger = ERROROUTZ0
          PortPullDownOption = false
          PortPullUpOption = false
        PortPin4:
          PortBiDirectionControl = false
          PortDriveStrengthControl = DRIVE_STRENGTH_TYPE_1_SUPP_PDSC_PUCC
          PortInputBufferControl = false
          PortInputSelection = INPUT_BUFFER_TYPE_SCH1
          PortIpControl = false
          PortOpenDrainControl = OUTPUT_BUFFER_TYPE_PUSHPULL_SUPP_PODC_PODCE
          PortOutputLevelInversion = false
          PortPinDioAltModeChangeable = false
          PortPinDirection = PORT_PIN_IN
          PortPinDirectionChangeable = false
          PortPinInitialMode = DIO_SUPP_PFC_PFCE_PFCAE_PFCEAE_PMCSR
          PortPinLevelValue = PORT_PIN_LEVEL_LOW
          PortPinModeChangeable = false
          PortPinSafeStateControl = false
          PortPinSafeStateTrigger = ERROROUTZ0
          PortPullDownOption = false
          PortPullUpOption = false
        PortPin5:
          PortBiDirectionControl = false
          PortDriveStrengthControl = DRIVE_STRENGTH_TYPE_1_SUPP_PDSC_PUCC
          PortInputBufferControl = false
          PortInputSelection = INPUT_BUFFER_TYPE_SCH1
          PortIpControl = false
          PortOpenDrainControl = OUTPUT_BUFFER_TYPE_PUSHPULL_SUPP_PODC_PODCE
          PortOutputLevelInversion = false
          PortPinDioAltModeChangeable = false
          PortPinDirection = PORT_PIN_IN
          PortPinDirectionChangeable = false
          PortPinInitialMode = DIO_SUPP_PFC_PFCE_PFCAE_PFCEAE_PMCSR
          PortPinLevelValue = PORT_PIN_LEVEL_LOW
          PortPinModeChangeable = false
          PortPinSafeStateControl = false
          PortPinSafeStateTrigger = ERROROUTZ0
          PortPullDownOption = false
          PortPullUpOption = false
        PortPin6:
          PortBiDirectionControl = false
          PortDriveStrengthControl = DRIVE_STRENGTH_TYPE_1_SUPP_PDSC_PUCC
          PortInputBufferControl = false
          PortInputSelection = INPUT_BUFFER_TYPE_SCH1
          PortIpControl = false
          PortOpenDrainControl = OUTPUT_BUFFER_TYPE_PUSHPULL_SUPP_PODC_PODCE
          PortOutputLevelInversion = false
          PortPinDioAltModeChangeable = false
          PortPinDirection = PORT_PIN_IN
          PortPinDirectionChangeable = false
          PortPinInitialMode = DIO_SUPP_PFC_PFCE_PFCAE_PFCEAE_PMCSR
          PortPinLevelValue = PORT_PIN_LEVEL_LOW
          PortPinModeChangeable = false
          PortPinSafeStateControl = false
          PortPinSafeStateTrigger = ERROROUTZ0
          PortPullDownOption = false
          PortPullUpOption = false
        PortPin7:
          PortBiDirectionControl = false
          PortDriveStrengthControl = DRIVE_STRENGTH_TYPE_1_SUPP_PDSC_PUCC
          PortInputBufferControl = false
          PortInputSelection = INPUT_BUFFER_TYPE_SCH1
          PortIpControl = false
          PortOpenDrainControl = OUTPUT_BUFFER_TYPE_PUSHPULL_SUPP_PODC_PODCE
          PortOutputLevelInversion = false
          PortPinDioAltModeChangeable = false
          PortPinDirection = PORT_PIN_IN
          PortPinDirectionChangeable = false
          PortPinInitialMode = DIO_SUPP_PFC_PFCE_PFCAE_PFCEAE_PMCSR
          PortPinLevelValue = PORT_PIN_LEVEL_LOW
          PortPinModeChangeable = false
          PortPinSafeStateControl = false
          PortPinSafeStateTrigger = ERROROUTZ0
          PortPullDownOption = false
          PortPullUpOption = false
        PortPin8:
          PortBiDirectionControl = false
          PortDriveStrengthControl = DRIVE_STRENGTH_TYPE_1_SUPP_PDSC_PUCC
          PortInputBufferControl = false
          PortInputSelection = INPUT_BUFFER_TYPE_SCH1
          PortIpControl = false
          PortOpenDrainControl = OUTPUT_BUFFER_TYPE_PUSHPULL_SUPP_PODC_PODCE
          PortOutputLevelInversion = false
          PortPinDioAltModeChangeable = false
          PortPinDirection = PORT_PIN_IN
          PortPinDirectionChangeable = false
          PortPinInitialMode = DIO_SUPP_PFC_PFCE_PFCAE_PFCEAE_PMCSR
          PortPinLevelValue = PORT_PIN_LEVEL_LOW
          PortPinModeChangeable = false
          PortPinSafeStateControl = false
          PortPinSafeStateTrigger = ERROROUTZ0
          PortPullDownOption = false
          PortPullUpOption = false
        PortPin9:
          PortBiDirectionControl = false
          PortDriveStrengthControl = DRIVE_STRENGTH_TYPE_1_SUPP_PDSC_PUCC
          PortInputBufferControl = false
          PortInputSelection = INPUT_BUFFER_TYPE_SCH1
          PortIpControl = false
          PortOpenDrainControl = OUTPUT_BUFFER_TYPE_PUSHPULL_SUPP_PODC_PODCE
          PortOutputLevelInversion = false
          PortPinDioAltModeChangeable = false
          PortPinDirection = PORT_PIN_IN
          PortPinDirectionChangeable = false
          PortPinInitialMode = DIO_SUPP_PFC_PFCE_PFCAE_PFCEAE_PMCSR
          PortPinLevelValue = PORT_PIN_LEVEL_LOW
          PortPinModeChangeable = false
          PortPinSafeStateControl = false
          PortPinSafeStateTrigger = ERROROUTZ0
          PortPullDownOption = false
          PortPullUpOption = false
      PortGroup10
        PortPin0:
          PortBiDirectionControl = false
          PortDriveStrengthControl = DRIVE_STRENGTH_TYPE_1_SUPP_PDSC_PUCC
          PortInputBufferControl = false
          PortInputSelection = INPUT_BUFFER_TYPE_SCH1
          PortIpControl = false
          PortOpenDrainControl = OUTPUT_BUFFER_TYPE_PUSHPULL_SUPP_PODC_PODCE
          PortOutputLevelInversion = false
          PortPinDioAltModeChangeable = false
          PortPinDirection = PORT_PIN_IN
          PortPinDirectionChangeable = false
          PortPinInitialMode = DIO_SUPP_PFC_PFCE_PFCAE_PFCEAE_PMCSR
          PortPinLevelValue = PORT_PIN_LEVEL_LOW
          PortPinModeChangeable = false
          PortPinSafeStateControl = false
          PortPinSafeStateTrigger = ERROROUTZ0
          PortPullDownOption = false
          PortPullUpOption = false
        PortPin1:
          PortBiDirectionControl = false
          PortDriveStrengthControl = DRIVE_STRENGTH_TYPE_1_SUPP_PDSC_PUCC
          PortInputBufferControl = false
          PortInputSelection = INPUT_BUFFER_TYPE_SCH1
          PortIpControl = false
          PortOpenDrainControl = OUTPUT_BUFFER_TYPE_PUSHPULL_SUPP_PODC_PODCE
          PortOutputLevelInversion = false
          PortPinDioAltModeChangeable = false
          PortPinDirection = PORT_PIN_IN
          PortPinDirectionChangeable = false
          PortPinInitialMode = DIO_SUPP_PFC_PFCE_PFCAE_PFCEAE_PMCSR
          PortPinLevelValue = PORT_PIN_LEVEL_LOW
          PortPinModeChangeable = false
          PortPinSafeStateControl = false
          PortPinSafeStateTrigger = ERROROUTZ0
          PortPullDownOption = false
          PortPullUpOption = false
        PortPin10:
          PortBiDirectionControl = false
          PortDriveStrengthControl = DRIVE_STRENGTH_TYPE_1_SUPP_PDSC_PUCC
          PortInputBufferControl = false
          PortInputSelection = INPUT_BUFFER_TYPE_SCH1
          PortIpControl = false
          PortOpenDrainControl = OUTPUT_BUFFER_TYPE_PUSHPULL_SUPP_PODC_PODCE
          PortOutputLevelInversion = false
          PortPinDioAltModeChangeable = false
          PortPinDirection = PORT_PIN_IN
          PortPinDirectionChangeable = false
          PortPinInitialMode = DIO_SUPP_PFC_PFCE_PFCAE_PFCEAE_PMCSR
          PortPinLevelValue = PORT_PIN_LEVEL_LOW
          PortPinModeChangeable = false
          PortPinSafeStateControl = false
          PortPinSafeStateTrigger = ERROROUTZ0
          PortPullDownOption = false
          PortPullUpOption = false
        PortPin11:
          PortBiDirectionControl = false
          PortDriveStrengthControl = DRIVE_STRENGTH_TYPE_1_SUPP_PDSC_PUCC
          PortInputBufferControl = false
          PortInputSelection = INPUT_BUFFER_TYPE_SCH1
          PortIpControl = false
          PortOpenDrainControl = OUTPUT_BUFFER_TYPE_PUSHPULL_SUPP_PODC_PODCE
          PortOutputLevelInversion = false
          PortPinDioAltModeChangeable = false
          PortPinDirection = PORT_PIN_IN
          PortPinDirectionChangeable = false
          PortPinInitialMode = DIO_SUPP_PFC_PFCE_PFCAE_PFCEAE_PMCSR
          PortPinLevelValue = PORT_PIN_LEVEL_LOW
          PortPinModeChangeable = false
          PortPinSafeStateControl = false
          PortPinSafeStateTrigger = ERROROUTZ0
          PortPullDownOption = false
          PortPullUpOption = false
        PortPin12:
          PortBiDirectionControl = false
          PortDriveStrengthControl = DRIVE_STRENGTH_TYPE_1_SUPP_PDSC_PUCC
          PortInputBufferControl = false
          PortInputSelection = INPUT_BUFFER_TYPE_SCH1
          PortIpControl = false
          PortOpenDrainControl = OUTPUT_BUFFER_TYPE_PUSHPULL_SUPP_PODC_PODCE
          PortOutputLevelInversion = false
          PortPinDioAltModeChangeable = false
          PortPinDirection = PORT_PIN_IN
          PortPinDirectionChangeable = false
          PortPinInitialMode = DIO_SUPP_PFC_PFCE_PFCAE_PFCEAE_PMCSR
          PortPinLevelValue = PORT_PIN_LEVEL_LOW
          PortPinModeChangeable = false
          PortPinSafeStateControl = false
          PortPinSafeStateTrigger = ERROROUTZ0
          PortPullDownOption = false
          PortPullUpOption = false
        PortPin13:
          PortBiDirectionControl = false
          PortDriveStrengthControl = DRIVE_STRENGTH_TYPE_1_SUPP_PDSC_PUCC
          PortInputBufferControl = false
          PortInputSelection = INPUT_BUFFER_TYPE_SCH1
          PortIpControl = false
          PortOpenDrainControl = OUTPUT_BUFFER_TYPE_PUSHPULL_SUPP_PODC_PODCE
          PortOutputLevelInversion = false
          PortPinDioAltModeChangeable = false
          PortPinDirection = PORT_PIN_IN
          PortPinDirectionChangeable = false
          PortPinInitialMode = DIO_SUPP_PFC_PFCE_PFCAE_PFCEAE_PMCSR
          PortPinLevelValue = PORT_PIN_LEVEL_LOW
          PortPinModeChangeable = false
          PortPinSafeStateControl = false
          PortPinSafeStateTrigger = ERROROUTZ0
          PortPullDownOption = false
          PortPullUpOption = false
        PortPin14:
          PortBiDirectionControl = false
          PortDriveStrengthControl = DRIVE_STRENGTH_TYPE_1_SUPP_PDSC_PUCC
          PortInputBufferControl = false
          PortInputSelection = INPUT_BUFFER_TYPE_SCH1
          PortIpControl = false
          PortOpenDrainControl = OUTPUT_BUFFER_TYPE_PUSHPULL_SUPP_PODC_PODCE
          PortOutputLevelInversion = false
          PortPinDioAltModeChangeable = false
          PortPinDirection = PORT_PIN_IN
          PortPinDirectionChangeable = false
          PortPinInitialMode = DIO_SUPP_PFC_PFCE_PFCAE_PFCEAE_PMCSR
          PortPinLevelValue = PORT_PIN_LEVEL_LOW
          PortPinModeChangeable = false
          PortPinSafeStateControl = false
          PortPinSafeStateTrigger = ERROROUTZ0
          PortPullDownOption = false
          PortPullUpOption = false
        PortPin2:
          PortBiDirectionControl = false
          PortDriveStrengthControl = DRIVE_STRENGTH_TYPE_1_SUPP_PDSC_PUCC
          PortInputBufferControl = false
          PortInputSelection = INPUT_BUFFER_TYPE_SCH1
          PortIpControl = false
          PortOpenDrainControl = OUTPUT_BUFFER_TYPE_PUSHPULL_SUPP_PODC_PODCE
          PortOutputLevelInversion = false
          PortPinDioAltModeChangeable = false
          PortPinDirection = PORT_PIN_IN
          PortPinDirectionChangeable = false
          PortPinInitialMode = DIO_SUPP_PFC_PFCE_PFCAE_PFCEAE_PMCSR
          PortPinLevelValue = PORT_PIN_LEVEL_LOW
          PortPinModeChangeable = false
          PortPinSafeStateControl = false
          PortPinSafeStateTrigger = ERROROUTZ0
          PortPullDownOption = false
          PortPullUpOption = false
        PortPin3:
          PortBiDirectionControl = false
          PortDriveStrengthControl = DRIVE_STRENGTH_TYPE_1_SUPP_PDSC_PUCC
          PortInputBufferControl = false
          PortInputSelection = INPUT_BUFFER_TYPE_SCH1
          PortIpControl = false
          PortOpenDrainControl = OUTPUT_BUFFER_TYPE_PUSHPULL_SUPP_PODC_PODCE
          PortOutputLevelInversion = false
          PortPinDioAltModeChangeable = false
          PortPinDirection = PORT_PIN_IN
          PortPinDirectionChangeable = false
          PortPinInitialMode = DIO_SUPP_PFC_PFCE_PFCAE_PFCEAE_PMCSR
          PortPinLevelValue = PORT_PIN_LEVEL_LOW
          PortPinModeChangeable = false
          PortPinSafeStateControl = false
          PortPinSafeStateTrigger = ERROROUTZ0
          PortPullDownOption = false
          PortPullUpOption = false
        PortPin4:
          PortBiDirectionControl = false
          PortDriveStrengthControl = DRIVE_STRENGTH_TYPE_1_SUPP_PDSC_PUCC
          PortInputBufferControl = false
          PortInputSelection = INPUT_BUFFER_TYPE_SCH1
          PortIpControl = false
          PortOpenDrainControl = OUTPUT_BUFFER_TYPE_PUSHPULL_SUPP_PODC_PODCE
          PortOutputLevelInversion = false
          PortPinDioAltModeChangeable = false
          PortPinDirection = PORT_PIN_IN
          PortPinDirectionChangeable = false
          PortPinInitialMode = DIO_SUPP_PFC_PFCE_PFCAE_PFCEAE_PMCSR
          PortPinLevelValue = PORT_PIN_LEVEL_LOW
          PortPinModeChangeable = false
          PortPinSafeStateControl = false
          PortPinSafeStateTrigger = ERROROUTZ0
          PortPullDownOption = false
          PortPullUpOption = false
        PortPin5:
          PortBiDirectionControl = false
          PortDriveStrengthControl = DRIVE_STRENGTH_TYPE_1_SUPP_PDSC_PUCC
          PortInputBufferControl = false
          PortInputSelection = INPUT_BUFFER_TYPE_SCH1
          PortIpControl = false
          PortOpenDrainControl = OUTPUT_BUFFER_TYPE_PUSHPULL_SUPP_PODC_PODCE
          PortOutputLevelInversion = false
          PortPinDioAltModeChangeable = false
          PortPinDirection = PORT_PIN_IN
          PortPinDirectionChangeable = false
          PortPinInitialMode = DIO_SUPP_PFC_PFCE_PFCAE_PFCEAE_PMCSR
          PortPinLevelValue = PORT_PIN_LEVEL_LOW
          PortPinModeChangeable = false
          PortPinSafeStateControl = false
          PortPinSafeStateTrigger = ERROROUTZ0
          PortPullDownOption = false
          PortPullUpOption = false
        PortPin6:
          PortBiDirectionControl = false
          PortDriveStrengthControl = DRIVE_STRENGTH_TYPE_1_SUPP_PDSC_PUCC
          PortInputBufferControl = false
          PortInputSelection = INPUT_BUFFER_TYPE_SCH1
          PortIpControl = false
          PortOpenDrainControl = OUTPUT_BUFFER_TYPE_PUSHPULL_SUPP_PODC_PODCE
          PortOutputLevelInversion = false
          PortPinDioAltModeChangeable = false
          PortPinDirection = PORT_PIN_IN
          PortPinDirectionChangeable = false
          PortPinInitialMode = DIO_SUPP_PFC_PFCE_PFCAE_PFCEAE_PMCSR
          PortPinLevelValue = PORT_PIN_LEVEL_LOW
          PortPinModeChangeable = false
          PortPinSafeStateControl = false
          PortPinSafeStateTrigger = ERROROUTZ0
          PortPullDownOption = false
          PortPullUpOption = false
        PortPin7:
          PortBiDirectionControl = false
          PortDriveStrengthControl = DRIVE_STRENGTH_TYPE_1_SUPP_PDSC_PUCC
          PortInputBufferControl = false
          PortInputSelection = INPUT_BUFFER_TYPE_SCH1
          PortIpControl = false
          PortOpenDrainControl = OUTPUT_BUFFER_TYPE_PUSHPULL_SUPP_PODC_PODCE
          PortOutputLevelInversion = false
          PortPinDioAltModeChangeable = false
          PortPinDirection = PORT_PIN_IN
          PortPinDirectionChangeable = false
          PortPinInitialMode = DIO_SUPP_PFC_PFCE_PFCAE_PFCEAE_PMCSR
          PortPinLevelValue = PORT_PIN_LEVEL_LOW
          PortPinModeChangeable = false
          PortPinSafeStateControl = false
          PortPinSafeStateTrigger = ERROROUTZ0
          PortPullDownOption = false
          PortPullUpOption = false
        PortPin8:
          PortBiDirectionControl = false
          PortDriveStrengthControl = DRIVE_STRENGTH_TYPE_1_SUPP_PDSC_PUCC
          PortInputBufferControl = false
          PortInputSelection = INPUT_BUFFER_TYPE_SCH1
          PortIpControl = false
          PortOpenDrainControl = OUTPUT_BUFFER_TYPE_PUSHPULL_SUPP_PODC_PODCE
          PortOutputLevelInversion = false
          PortPinDioAltModeChangeable = false
          PortPinDirection = PORT_PIN_IN
          PortPinDirectionChangeable = false
          PortPinInitialMode = DIO_SUPP_PFC_PFCE_PFCAE_PFCEAE_PMCSR
          PortPinLevelValue = PORT_PIN_LEVEL_LOW
          PortPinModeChangeable = false
          PortPinSafeStateControl = false
          PortPinSafeStateTrigger = ERROROUTZ0
          PortPullDownOption = false
          PortPullUpOption = false
        PortPin9:
          PortBiDirectionControl = false
          PortDriveStrengthControl = DRIVE_STRENGTH_TYPE_1_SUPP_PDSC_PUCC
          PortInputBufferControl = false
          PortInputSelection = INPUT_BUFFER_TYPE_SCH1
          PortIpControl = false
          PortOpenDrainControl = OUTPUT_BUFFER_TYPE_PUSHPULL_SUPP_PODC_PODCE
          PortOutputLevelInversion = false
          PortPinDioAltModeChangeable = false
          PortPinDirection = PORT_PIN_IN
          PortPinDirectionChangeable = false
          PortPinInitialMode = DIO_SUPP_PFC_PFCE_PFCAE_PFCEAE_PMCSR
          PortPinLevelValue = PORT_PIN_LEVEL_LOW
          PortPinModeChangeable = false
          PortPinSafeStateControl = false
          PortPinSafeStateTrigger = ERROROUTZ0
          PortPullDownOption = false
          PortPullUpOption = false
      PortGroup17
        PortPin0:
          PortBiDirectionControl = false
          PortDriveStrengthControl = DRIVE_STRENGTH_TYPE_1_SUPP_PDSC_PUCC
          PortInputBufferControl = false
          PortInputSelection = INPUT_BUFFER_TYPE_SCH1
          PortIpControl = false
          PortOpenDrainControl = OUTPUT_BUFFER_TYPE_PUSHPULL_SUPP_PODC_PODCE
          PortOutputLevelInversion = false
          PortPinDioAltModeChangeable = false
          PortPinDirection = PORT_PIN_IN
          PortPinDirectionChangeable = false
          PortPinInitialMode = DIO_SUPP_PFC_PFCE_PFCAE_PFCEAE_PMCSR
          PortPinLevelValue = PORT_PIN_LEVEL_LOW
          PortPinModeChangeable = false
          PortPinSafeStateControl = false
          PortPinSafeStateTrigger = ERROROUTZ0
          PortPullDownOption = false
          PortPullUpOption = false
        PortPin1:
          PortBiDirectionControl = false
          PortDriveStrengthControl = DRIVE_STRENGTH_TYPE_1_SUPP_PDSC_PUCC
          PortInputBufferControl = false
          PortInputSelection = INPUT_BUFFER_TYPE_SCH1
          PortIpControl = false
          PortOpenDrainControl = OUTPUT_BUFFER_TYPE_PUSHPULL_SUPP_PODC_PODCE
          PortOutputLevelInversion = false
          PortPinDioAltModeChangeable = false
          PortPinDirection = PORT_PIN_IN
          PortPinDirectionChangeable = false
          PortPinInitialMode = DIO_SUPP_PFC_PFCE_PFCAE_PFCEAE_PMCSR
          PortPinLevelValue = PORT_PIN_LEVEL_LOW
          PortPinModeChangeable = false
          PortPinSafeStateControl = false
          PortPinSafeStateTrigger = ERROROUTZ0
          PortPullDownOption = false
          PortPullUpOption = false
        PortPin2:
          PortBiDirectionControl = false
          PortDriveStrengthControl = DRIVE_STRENGTH_TYPE_1_SUPP_PDSC_PUCC
          PortInputBufferControl = false
          PortInputSelection = INPUT_BUFFER_TYPE_SCH1
          PortIpControl = false
          PortOpenDrainControl = OUTPUT_BUFFER_TYPE_PUSHPULL_SUPP_PODC_PODCE
          PortOutputLevelInversion = false
          PortPinDioAltModeChangeable = false
          PortPinDirection = PORT_PIN_IN
          PortPinDirectionChangeable = false
          PortPinInitialMode = DIO_SUPP_PFC_PFCE_PFCAE_PFCEAE_PMCSR
          PortPinLevelValue = PORT_PIN_LEVEL_LOW
          PortPinModeChangeable = false
          PortPinSafeStateControl = false
          PortPinSafeStateTrigger = ERROROUTZ0
          PortPullDownOption = false
          PortPullUpOption = false
        PortPin3:
          PortBiDirectionControl = false
          PortDriveStrengthControl = DRIVE_STRENGTH_TYPE_1_SUPP_PDSC_PUCC
          PortInputBufferControl = false
          PortInputSelection = INPUT_BUFFER_TYPE_SCH1
          PortIpControl = false
          PortOpenDrainControl = OUTPUT_BUFFER_TYPE_PUSHPULL_SUPP_PODC_PODCE
          PortOutputLevelInversion = false
          PortPinDioAltModeChangeable = false
          PortPinDirection = PORT_PIN_IN
          PortPinDirectionChangeable = false
          PortPinInitialMode = DIO_SUPP_PFC_PFCE_PFCAE_PFCEAE_PMCSR
          PortPinLevelValue = PORT_PIN_LEVEL_LOW
          PortPinModeChangeable = false
          PortPinSafeStateControl = false
          PortPinSafeStateTrigger = ERROROUTZ0
          PortPullDownOption = false
          PortPullUpOption = false
        PortPin4:
          PortBiDirectionControl = false
          PortDriveStrengthControl = DRIVE_STRENGTH_TYPE_1_SUPP_PDSC_PUCC
          PortInputBufferControl = false
          PortInputSelection = INPUT_BUFFER_TYPE_SCH1
          PortIpControl = false
          PortOpenDrainControl = OUTPUT_BUFFER_TYPE_PUSHPULL_SUPP_PODC_PODCE
          PortOutputLevelInversion = false
          PortPinDioAltModeChangeable = false
          PortPinDirection = PORT_PIN_IN
          PortPinDirectionChangeable = false
          PortPinInitialMode = DIO_SUPP_PFC_PFCE_PFCAE_PFCEAE_PMCSR
          PortPinLevelValue = PORT_PIN_LEVEL_LOW
          PortPinModeChangeable = false
          PortPinSafeStateControl = false
          PortPinSafeStateTrigger = ERROROUTZ0
          PortPullDownOption = false
          PortPullUpOption = false
        PortPin5:
          PortBiDirectionControl = false
          PortDriveStrengthControl = DRIVE_STRENGTH_TYPE_1_SUPP_PDSC_PUCC
          PortInputBufferControl = false
          PortInputSelection = INPUT_BUFFER_TYPE_SCH1
          PortOpenDrainControl = OUTPUT_BUFFER_TYPE_PUSHPULL_SUPP_PODC_PODCE
          PortOutputLevelInversion = false
          PortPinDioAltModeChangeable = false
          PortPinDirection = PORT_PIN_IN
          PortPinDirectionChangeable = false
          PortPinInitialMode = DIO_SUPP_PFC_PFCE_PFCAE_PFCEAE_PMCSR
          PortPinLevelValue = PORT_PIN_LEVEL_LOW
          PortPinModeChangeable = false
          PortPinSafeStateControl = false
          PortPinSafeStateTrigger = ERROROUTZ0
          PortPullDownOption = false
          PortPullUpOption = false
        PortPin6:
          PortBiDirectionControl = false
          PortDriveStrengthControl = DRIVE_STRENGTH_TYPE_1_SUPP_PDSC_PUCC
          PortInputBufferControl = false
          PortInputSelection = INPUT_BUFFER_TYPE_SCH1
          PortOpenDrainControl = OUTPUT_BUFFER_TYPE_PUSHPULL_SUPP_PODC_PODCE
          PortOutputLevelInversion = false
          PortPinDioAltModeChangeable = false
          PortPinDirection = PORT_PIN_IN
          PortPinDirectionChangeable = false
          PortPinInitialMode = DIO_SUPP_PFC_PFCE_PFCAE_PFCEAE_PMCSR
          PortPinLevelValue = PORT_PIN_LEVEL_LOW
          PortPinModeChangeable = false
          PortPinSafeStateControl = false
          PortPinSafeStateTrigger = ERROROUTZ0
          PortPullDownOption = false
          PortPullUpOption = false
      PortGroup20
        PortPin0:
          PortBiDirectionControl = false
          PortDriveStrengthControl = DRIVE_STRENGTH_TYPE_1_SUPP_PDSC_PUCC
          PortInputBufferControl = false
          PortInputSelection = INPUT_BUFFER_TYPE_SCH1
          PortIpControl = false
          PortOpenDrainControl = OUTPUT_BUFFER_TYPE_PUSHPULL_SUPP_PODC_PODCE
          PortOutputLevelInversion = false
          PortPinDioAltModeChangeable = false
          PortPinDirection = PORT_PIN_IN
          PortPinDirectionChangeable = false
          PortPinInitialMode = DIO_SUPP_PFC_PFCE_PFCAE_PFCEAE_PMCSR
          PortPinLevelValue = PORT_PIN_LEVEL_LOW
          PortPinModeChangeable = false
          PortPinSafeStateControl = false
          PortPinSafeStateTrigger = ERROROUTZ0
          PortPullDownOption = false
          PortPullUpOption = false
        PortPin1:
          PortBiDirectionControl = false
          PortDriveStrengthControl = DRIVE_STRENGTH_TYPE_1_SUPP_PDSC_PUCC
          PortInputBufferControl = false
          PortInputSelection = INPUT_BUFFER_TYPE_SCH1
          PortIpControl = false
          PortOpenDrainControl = OUTPUT_BUFFER_TYPE_PUSHPULL_SUPP_PODC_PODCE
          PortOutputLevelInversion = false
          PortPinDioAltModeChangeable = false
          PortPinDirection = PORT_PIN_IN
          PortPinDirectionChangeable = false
          PortPinInitialMode = DIO_SUPP_PFC_PFCE_PFCAE_PFCEAE_PMCSR
          PortPinLevelValue = PORT_PIN_LEVEL_LOW
          PortPinModeChangeable = false
          PortPinSafeStateControl = false
          PortPinSafeStateTrigger = ERROROUTZ0
          PortPullDownOption = false
          PortPullUpOption = false
        PortPin10:
          PortBiDirectionControl = false
          PortDriveStrengthControl = DRIVE_STRENGTH_TYPE_1_SUPP_PDSC_PUCC
          PortInputBufferControl = false
          PortInputSelection = INPUT_BUFFER_TYPE_SCH1
          PortIpControl = false
          PortOpenDrainControl = OUTPUT_BUFFER_TYPE_PUSHPULL_SUPP_PODC_PODCE
          PortOutputLevelInversion = false
          PortPinDioAltModeChangeable = false
          PortPinDirection = PORT_PIN_IN
          PortPinDirectionChangeable = false
          PortPinInitialMode = DIO_SUPP_PFC_PFCE_PFCAE_PFCEAE_PMCSR
          PortPinLevelValue = PORT_PIN_LEVEL_LOW
          PortPinModeChangeable = false
          PortPinSafeStateControl = false
          PortPinSafeStateTrigger = ERROROUTZ0
          PortPullDownOption = false
          PortPullUpOption = false
        PortPin12:
          PortBiDirectionControl = false
          PortDriveStrengthControl = DRIVE_STRENGTH_TYPE_1_SUPP_PDSC_PUCC
          PortInputBufferControl = false
          PortInputSelection = INPUT_BUFFER_TYPE_SCH1
          PortIpControl = false
          PortOpenDrainControl = OUTPUT_BUFFER_TYPE_PUSHPULL_SUPP_PODC_PODCE
          PortOutputLevelInversion = false
          PortPinDioAltModeChangeable = false
          PortPinDirection = PORT_PIN_IN
          PortPinDirectionChangeable = false
          PortPinInitialMode = DIO_SUPP_PFC_PFCE_PFCAE_PFCEAE_PMCSR
          PortPinLevelValue = PORT_PIN_LEVEL_LOW
          PortPinModeChangeable = false
          PortPinSafeStateControl = false
          PortPinSafeStateTrigger = ERROROUTZ0
          PortPullDownOption = false
          PortPullUpOption = false
        PortPin13:
          PortBiDirectionControl = false
          PortDriveStrengthControl = DRIVE_STRENGTH_TYPE_1_SUPP_PDSC_PUCC
          PortInputBufferControl = false
          PortInputSelection = INPUT_BUFFER_TYPE_SCH1
          PortIpControl = false
          PortOpenDrainControl = OUTPUT_BUFFER_TYPE_PUSHPULL_SUPP_PODC_PODCE
          PortOutputLevelInversion = false
          PortPinDioAltModeChangeable = false
          PortPinDirection = PORT_PIN_IN
          PortPinDirectionChangeable = false
          PortPinInitialMode = DIO_SUPP_PFC_PFCE_PFCAE_PFCEAE_PMCSR
          PortPinLevelValue = PORT_PIN_LEVEL_LOW
          PortPinModeChangeable = false
          PortPinSafeStateControl = false
          PortPinSafeStateTrigger = ERROROUTZ0
          PortPullDownOption = false
          PortPullUpOption = false
        PortPin14:
          PortBiDirectionControl = false
          PortDriveStrengthControl = DRIVE_STRENGTH_TYPE_1_SUPP_PDSC_PUCC
          PortInputBufferControl = false
          PortInputSelection = INPUT_BUFFER_TYPE_SCH1
          PortIpControl = false
          PortOpenDrainControl = OUTPUT_BUFFER_TYPE_PUSHPULL_SUPP_PODC_PODCE
          PortOutputLevelInversion = false
          PortPinDioAltModeChangeable = false
          PortPinDirection = PORT_PIN_IN
          PortPinDirectionChangeable = false
          PortPinInitialMode = DIO_SUPP_PFC_PFCE_PFCAE_PFCEAE_PMCSR
          PortPinLevelValue = PORT_PIN_LEVEL_LOW
          PortPinModeChangeable = false
          PortPinSafeStateControl = false
          PortPinSafeStateTrigger = ERROROUTZ0
          PortPullDownOption = false
          PortPullUpOption = false
        PortPin2:
          PortBiDirectionControl = false
          PortDriveStrengthControl = DRIVE_STRENGTH_TYPE_1_SUPP_PDSC_PUCC
          PortInputBufferControl = false
          PortInputSelection = INPUT_BUFFER_TYPE_SCH1
          PortIpControl = false
          PortOpenDrainControl = OUTPUT_BUFFER_TYPE_PUSHPULL_SUPP_PODC_PODCE
          PortOutputLevelInversion = false
          PortPinDioAltModeChangeable = false
          PortPinDirection = PORT_PIN_IN
          PortPinDirectionChangeable = false
          PortPinInitialMode = DIO_SUPP_PFC_PFCE_PFCAE_PFCEAE_PMCSR
          PortPinLevelValue = PORT_PIN_LEVEL_LOW
          PortPinModeChangeable = false
          PortPinSafeStateControl = false
          PortPinSafeStateTrigger = ERROROUTZ0
          PortPullDownOption = false
          PortPullUpOption = false
        PortPin3:
          PortBiDirectionControl = false
          PortDriveStrengthControl = DRIVE_STRENGTH_TYPE_1_SUPP_PDSC_PUCC
          PortInputBufferControl = false
          PortInputSelection = INPUT_BUFFER_TYPE_SCH1
          PortIpControl = false
          PortOpenDrainControl = OUTPUT_BUFFER_TYPE_PUSHPULL_SUPP_PODC_PODCE
          PortOutputLevelInversion = false
          PortPinDioAltModeChangeable = false
          PortPinDirection = PORT_PIN_IN
          PortPinDirectionChangeable = false
          PortPinInitialMode = DIO_SUPP_PFC_PFCE_PFCAE_PFCEAE_PMCSR
          PortPinLevelValue = PORT_PIN_LEVEL_LOW
          PortPinModeChangeable = false
          PortPinSafeStateControl = false
          PortPinSafeStateTrigger = ERROROUTZ0
          PortPullDownOption = false
          PortPullUpOption = false
        PortPin4:
          PortBiDirectionControl = false
          PortDriveStrengthControl = DRIVE_STRENGTH_TYPE_1_SUPP_PDSC_PUCC
          PortInputBufferControl = false
          PortInputSelection = INPUT_BUFFER_TYPE_SCH1
          PortIpControl = false
          PortOpenDrainControl = OUTPUT_BUFFER_TYPE_PUSHPULL_SUPP_PODC_PODCE
          PortOutputLevelInversion = false
          PortPinDioAltModeChangeable = false
          PortPinDirection = PORT_PIN_IN
          PortPinDirectionChangeable = false
          PortPinInitialMode = DIO_SUPP_PFC_PFCE_PFCAE_PFCEAE_PMCSR
          PortPinLevelValue = PORT_PIN_LEVEL_LOW
          PortPinModeChangeable = false
          PortPinSafeStateControl = false
          PortPinSafeStateTrigger = ERROROUTZ0
          PortPullDownOption = false
          PortPullUpOption = false
        PortPin5:
          PortBiDirectionControl = false
          PortDriveStrengthControl = DRIVE_STRENGTH_TYPE_1_SUPP_PDSC_PUCC
          PortInputBufferControl = false
          PortInputSelection = INPUT_BUFFER_TYPE_SCH1
          PortIpControl = false
          PortOpenDrainControl = OUTPUT_BUFFER_TYPE_PUSHPULL_SUPP_PODC_PODCE
          PortOutputLevelInversion = false
          PortPinDioAltModeChangeable = false
          PortPinDirection = PORT_PIN_IN
          PortPinDirectionChangeable = false
          PortPinInitialMode = DIO_SUPP_PFC_PFCE_PFCAE_PFCEAE_PMCSR
          PortPinLevelValue = PORT_PIN_LEVEL_LOW
          PortPinModeChangeable = false
          PortPinSafeStateControl = false
          PortPinSafeStateTrigger = ERROROUTZ0
          PortPullDownOption = false
          PortPullUpOption = false
        PortPin6:
          PortBiDirectionControl = false
          PortDriveStrengthControl = DRIVE_STRENGTH_TYPE_1_SUPP_PDSC_PUCC
          PortInputBufferControl = false
          PortInputSelection = INPUT_BUFFER_TYPE_SCH1
          PortIpControl = false
          PortOpenDrainControl = OUTPUT_BUFFER_TYPE_PUSHPULL_SUPP_PODC_PODCE
          PortOutputLevelInversion = false
          PortPinDioAltModeChangeable = false
          PortPinDirection = PORT_PIN_IN
          PortPinDirectionChangeable = false
          PortPinInitialMode = DIO_SUPP_PFC_PFCE_PFCAE_PFCEAE_PMCSR
          PortPinLevelValue = PORT_PIN_LEVEL_LOW
          PortPinModeChangeable = false
          PortPinSafeStateControl = false
          PortPinSafeStateTrigger = ERROROUTZ0
          PortPullDownOption = false
          PortPullUpOption = false
        PortPin7:
          PortBiDirectionControl = false
          PortDriveStrengthControl = DRIVE_STRENGTH_TYPE_1_SUPP_PDSC_PUCC
          PortInputBufferControl = false
          PortInputSelection = INPUT_BUFFER_TYPE_SCH1
          PortIpControl = false
          PortOpenDrainControl = OUTPUT_BUFFER_TYPE_PUSHPULL_SUPP_PODC_PODCE
          PortOutputLevelInversion = false
          PortPinDioAltModeChangeable = false
          PortPinDirection = PORT_PIN_IN
          PortPinDirectionChangeable = false
          PortPinInitialMode = DIO_SUPP_PFC_PFCE_PFCAE_PFCEAE_PMCSR
          PortPinLevelValue = PORT_PIN_LEVEL_LOW
          PortPinModeChangeable = false
          PortPinSafeStateControl = false
          PortPinSafeStateTrigger = ERROROUTZ0
          PortPullDownOption = false
          PortPullUpOption = false
        PortPin8:
          PortBiDirectionControl = false
          PortDriveStrengthControl = DRIVE_STRENGTH_TYPE_1_SUPP_PDSC_PUCC
          PortInputBufferControl = false
          PortInputSelection = INPUT_BUFFER_TYPE_SCH1
          PortIpControl = false
          PortOpenDrainControl = OUTPUT_BUFFER_TYPE_PUSHPULL_SUPP_PODC_PODCE
          PortOutputLevelInversion = false
          PortPinDioAltModeChangeable = false
          PortPinDirection = PORT_PIN_IN
          PortPinDirectionChangeable = false
          PortPinInitialMode = DIO_SUPP_PFC_PFCE_PFCAE_PFCEAE_PMCSR
          PortPinLevelValue = PORT_PIN_LEVEL_LOW
          PortPinModeChangeable = false
          PortPinSafeStateControl = false
          PortPinSafeStateTrigger = ERROROUTZ0
          PortPullDownOption = false
          PortPullUpOption = false
        PortPin9:
          PortBiDirectionControl = false
          PortDriveStrengthControl = DRIVE_STRENGTH_TYPE_1_SUPP_PDSC_PUCC
          PortInputBufferControl = false
          PortInputSelection = INPUT_BUFFER_TYPE_SCH1
          PortIpControl = false
          PortOpenDrainControl = OUTPUT_BUFFER_TYPE_PUSHPULL_SUPP_PODC_PODCE
          PortOutputLevelInversion = false
          PortPinDioAltModeChangeable = false
          PortPinDirection = PORT_PIN_IN
          PortPinDirectionChangeable = false
          PortPinInitialMode = DIO_SUPP_PFC_PFCE_PFCAE_PFCEAE_PMCSR
          PortPinLevelValue = PORT_PIN_LEVEL_LOW
          PortPinModeChangeable = false
          PortPinSafeStateControl = false
          PortPinSafeStateTrigger = ERROROUTZ0
          PortPullDownOption = false
          PortPullUpOption = false
      PortGroup21
        PortPin0:
          PortBiDirectionControl = false
          PortDriveStrengthControl = DRIVE_STRENGTH_TYPE_1_SUPP_PDSC_PUCC
          PortInputBufferControl = false
          PortInputSelection = INPUT_BUFFER_TYPE_SCH1
          PortIpControl = false
          PortOpenDrainControl = OUTPUT_BUFFER_TYPE_PUSHPULL_SUPP_PODC_PODCE
          PortOutputLevelInversion = false
          PortPinDioAltModeChangeable = false
          PortPinDirection = PORT_PIN_IN
          PortPinDirectionChangeable = false
          PortPinInitialMode = DIO_SUPP_PFC_PFCE_PFCAE_PFCEAE_PMCSR
          PortPinLevelValue = PORT_PIN_LEVEL_LOW
          PortPinModeChangeable = false
          PortPinSafeStateControl = false
          PortPinSafeStateTrigger = ERROROUTZ0
          PortPullDownOption = false
          PortPullUpOption = false
        PortPin1:
          PortBiDirectionControl = false
          PortDriveStrengthControl = DRIVE_STRENGTH_TYPE_1_SUPP_PDSC_PUCC
          PortInputBufferControl = false
          PortInputSelection = INPUT_BUFFER_TYPE_SCH1
          PortIpControl = false
          PortOpenDrainControl = OUTPUT_BUFFER_TYPE_PUSHPULL_SUPP_PODC_PODCE
          PortOutputLevelInversion = false
          PortPinDioAltModeChangeable = false
          PortPinDirection = PORT_PIN_IN
          PortPinDirectionChangeable = false
          PortPinInitialMode = DIO_SUPP_PFC_PFCE_PFCAE_PFCEAE_PMCSR
          PortPinLevelValue = PORT_PIN_LEVEL_LOW
          PortPinModeChangeable = false
          PortPinSafeStateControl = false
          PortPinSafeStateTrigger = ERROROUTZ0
          PortPullDownOption = false
          PortPullUpOption = false
        PortPin2:
          PortBiDirectionControl = false
          PortDriveStrengthControl = DRIVE_STRENGTH_TYPE_1_SUPP_PDSC_PUCC
          PortInputBufferControl = false
          PortInputSelection = INPUT_BUFFER_TYPE_SCH1
          PortIpControl = false
          PortOpenDrainControl = OUTPUT_BUFFER_TYPE_PUSHPULL_SUPP_PODC_PODCE
          PortOutputLevelInversion = false
          PortPinDioAltModeChangeable = false
          PortPinDirection = PORT_PIN_IN
          PortPinDirectionChangeable = false
          PortPinInitialMode = DIO_SUPP_PFC_PFCE_PFCAE_PFCEAE_PMCSR
          PortPinLevelValue = PORT_PIN_LEVEL_LOW
          PortPinModeChangeable = false
          PortPinSafeStateControl = false
          PortPinSafeStateTrigger = ERROROUTZ0
          PortPullDownOption = false
          PortPullUpOption = false
        PortPin3:
          PortBiDirectionControl = false
          PortDriveStrengthControl = DRIVE_STRENGTH_TYPE_1_SUPP_PDSC_PUCC
          PortInputBufferControl = false
          PortInputSelection = INPUT_BUFFER_TYPE_SCH1
          PortIpControl = false
          PortOpenDrainControl = OUTPUT_BUFFER_TYPE_PUSHPULL_SUPP_PODC_PODCE
          PortOutputLevelInversion = false
          PortPinDioAltModeChangeable = false
          PortPinDirection = PORT_PIN_IN
          PortPinDirectionChangeable = false
          PortPinInitialMode = DIO_SUPP_PFC_PFCE_PFCAE_PFCEAE_PMCSR
          PortPinLevelValue = PORT_PIN_LEVEL_LOW
          PortPinModeChangeable = false
          PortPinSafeStateControl = false
          PortPinSafeStateTrigger = ERROROUTZ0
          PortPullDownOption = false
          PortPullUpOption = false
        PortPin4:
          PortBiDirectionControl = false
          PortDriveStrengthControl = DRIVE_STRENGTH_TYPE_1_SUPP_PDSC_PUCC
          PortInputBufferControl = false
          PortInputSelection = INPUT_BUFFER_TYPE_SCH1
          PortIpControl = false
          PortOpenDrainControl = OUTPUT_BUFFER_TYPE_PUSHPULL_SUPP_PODC_PODCE
          PortOutputLevelInversion = false
          PortPinDioAltModeChangeable = false
          PortPinDirection = PORT_PIN_IN
          PortPinDirectionChangeable = false
          PortPinInitialMode = DIO_SUPP_PFC_PFCE_PFCAE_PFCEAE_PMCSR
          PortPinLevelValue = PORT_PIN_LEVEL_LOW
          PortPinModeChangeable = false
          PortPinSafeStateControl = false
          PortPinSafeStateTrigger = ERROROUTZ0
          PortPullDownOption = false
          PortPullUpOption = false
        PortPin5:
          PortBiDirectionControl = false
          PortDriveStrengthControl = DRIVE_STRENGTH_TYPE_1_SUPP_PDSC_PUCC
          PortInputBufferControl = false
          PortInputSelection = INPUT_BUFFER_TYPE_SCH1
          PortIpControl = false
          PortOpenDrainControl = OUTPUT_BUFFER_TYPE_PUSHPULL_SUPP_PODC_PODCE
          PortOutputLevelInversion = false
          PortPinDioAltModeChangeable = false
          PortPinDirection = PORT_PIN_IN
          PortPinDirectionChangeable = false
          PortPinInitialMode = DIO_SUPP_PFC_PFCE_PFCAE_PFCEAE_PMCSR
          PortPinLevelValue = PORT_PIN_LEVEL_LOW
          PortPinModeChangeable = false
          PortPinSafeStateControl = false
          PortPinSafeStateTrigger = ERROROUTZ0
          PortPullDownOption = false
          PortPullUpOption = false
        PortPin6:
          PortBiDirectionControl = false
          PortDriveStrengthControl = DRIVE_STRENGTH_TYPE_1_SUPP_PDSC_PUCC
          PortInputBufferControl = false
          PortInputSelection = INPUT_BUFFER_TYPE_SCH1
          PortIpControl = false
          PortOpenDrainControl = OUTPUT_BUFFER_TYPE_PUSHPULL_SUPP_PODC_PODCE
          PortOutputLevelInversion = false
          PortPinDioAltModeChangeable = false
          PortPinDirection = PORT_PIN_IN
          PortPinDirectionChangeable = false
          PortPinInitialMode = DIO_SUPP_PFC_PFCE_PFCAE_PFCEAE_PMCSR
          PortPinLevelValue = PORT_PIN_LEVEL_LOW
          PortPinModeChangeable = false
          PortPinSafeStateControl = false
          PortPinSafeStateTrigger = ERROROUTZ0
          PortPullDownOption = false
          PortPullUpOption = false
        PortPin7:
          PortBiDirectionControl = false
          PortDriveStrengthControl = DRIVE_STRENGTH_TYPE_1_SUPP_PDSC_PUCC
          PortInputBufferControl = false
          PortInputSelection = INPUT_BUFFER_TYPE_SCH1
          PortIpControl = false
          PortOpenDrainControl = OUTPUT_BUFFER_TYPE_PUSHPULL_SUPP_PODC_PODCE
          PortOutputLevelInversion = false
          PortPinDioAltModeChangeable = false
          PortPinDirection = PORT_PIN_IN
          PortPinDirectionChangeable = false
          PortPinInitialMode = DIO_SUPP_PFC_PFCE_PFCAE_PFCEAE_PMCSR
          PortPinLevelValue = PORT_PIN_LEVEL_LOW
          PortPinModeChangeable = false
          PortPinSafeStateControl = false
          PortPinSafeStateTrigger = ERROROUTZ0
          PortPullDownOption = false
          PortPullUpOption = false
      PortGroup22
        PortPin0:
          PortBiDirectionControl = false
          PortDriveStrengthControl = DRIVE_STRENGTH_TYPE_1_SUPP_PDSC_PUCC
          PortInputBufferControl = false
          PortInputSelection = INPUT_BUFFER_TYPE_SCH1
          PortIpControl = false
          PortOpenDrainControl = OUTPUT_BUFFER_TYPE_PUSHPULL_SUPP_PODC_PODCE
          PortOutputLevelInversion = false
          PortPinDioAltModeChangeable = false
          PortPinDirection = PORT_PIN_IN
          PortPinDirectionChangeable = false
          PortPinInitialMode = DIO_SUPP_PFC_PFCE_PFCAE_PFCEAE_PMCSR
          PortPinLevelValue = PORT_PIN_LEVEL_LOW
          PortPinModeChangeable = false
          PortPinSafeStateControl = false
          PortPinSafeStateTrigger = ERROROUTZ0
          PortPullDownOption = false
          PortPullUpOption = false
        PortPin1:
          PortBiDirectionControl = false
          PortDriveStrengthControl = DRIVE_STRENGTH_TYPE_1_SUPP_PDSC_PUCC
          PortInputBufferControl = false
          PortInputSelection = INPUT_BUFFER_TYPE_SCH1
          PortIpControl = false
          PortOpenDrainControl = OUTPUT_BUFFER_TYPE_PUSHPULL_SUPP_PODC_PODCE
          PortOutputLevelInversion = false
          PortPinDioAltModeChangeable = false
          PortPinDirection = PORT_PIN_IN
          PortPinDirectionChangeable = false
          PortPinInitialMode = DIO_SUPP_PFC_PFCE_PFCAE_PFCEAE_PMCSR
          PortPinLevelValue = PORT_PIN_LEVEL_LOW
          PortPinModeChangeable = false
          PortPinSafeStateControl = false
          PortPinSafeStateTrigger = ERROROUTZ0
          PortPullDownOption = false
          PortPullUpOption = false
        PortPin2:
          PortBiDirectionControl = false
          PortDriveStrengthControl = DRIVE_STRENGTH_TYPE_1_SUPP_PDSC_PUCC
          PortInputBufferControl = false
          PortInputSelection = INPUT_BUFFER_TYPE_SCH1
          PortIpControl = false
          PortOpenDrainControl = OUTPUT_BUFFER_TYPE_PUSHPULL_SUPP_PODC_PODCE
          PortOutputLevelInversion = false
          PortPinDioAltModeChangeable = false
          PortPinDirection = PORT_PIN_IN
          PortPinDirectionChangeable = false
          PortPinInitialMode = DIO_SUPP_PFC_PFCE_PFCAE_PFCEAE_PMCSR
          PortPinLevelValue = PORT_PIN_LEVEL_LOW
          PortPinModeChangeable = false
          PortPinSafeStateControl = false
          PortPinSafeStateTrigger = ERROROUTZ0
          PortPullDownOption = false
          PortPullUpOption = false
        PortPin3:
          PortBiDirectionControl = false
          PortDriveStrengthControl = DRIVE_STRENGTH_TYPE_1_SUPP_PDSC_PUCC
          PortInputBufferControl = false
          PortInputSelection = INPUT_BUFFER_TYPE_SCH1
          PortIpControl = false
          PortOpenDrainControl = OUTPUT_BUFFER_TYPE_PUSHPULL_SUPP_PODC_PODCE
          PortOutputLevelInversion = false
          PortPinDioAltModeChangeable = false
          PortPinDirection = PORT_PIN_IN
          PortPinDirectionChangeable = false
          PortPinInitialMode = DIO_SUPP_PFC_PFCE_PFCAE_PFCEAE_PMCSR
          PortPinLevelValue = PORT_PIN_LEVEL_LOW
          PortPinModeChangeable = false
          PortPinSafeStateControl = false
          PortPinSafeStateTrigger = ERROROUTZ0
          PortPullDownOption = false
          PortPullUpOption = false
        PortPin4:
          PortBiDirectionControl = false
          PortDriveStrengthControl = DRIVE_STRENGTH_TYPE_1_SUPP_PDSC_PUCC
          PortInputBufferControl = false
          PortInputSelection = INPUT_BUFFER_TYPE_SCH1
          PortIpControl = false
          PortOpenDrainControl = OUTPUT_BUFFER_TYPE_PUSHPULL_SUPP_PODC_PODCE
          PortOutputLevelInversion = false
          PortPinDioAltModeChangeable = false
          PortPinDirection = PORT_PIN_IN
          PortPinDirectionChangeable = false
          PortPinInitialMode = DIO_SUPP_PFC_PFCE_PFCAE_PFCEAE_PMCSR
          PortPinLevelValue = PORT_PIN_LEVEL_LOW
          PortPinModeChangeable = false
          PortPinSafeStateControl = false
          PortPinSafeStateTrigger = ERROROUTZ0
          PortPullDownOption = false
          PortPullUpOption = false
      PortGroup24
        PortPin10:
          PortBiDirectionControl = false
          PortDriveStrengthControl = DRIVE_STRENGTH_TYPE_1_SUPP_PDSC_PUCC
          PortInputBufferControl = false
          PortInputSelection = INPUT_BUFFER_TYPE_SCH1
          PortIpControl = false
          PortOpenDrainControl = OUTPUT_BUFFER_TYPE_PUSHPULL_SUPP_PODC_PODCE
          PortOutputLevelInversion = false
          PortPinDioAltModeChangeable = false
          PortPinDirection = PORT_PIN_IN
          PortPinDirectionChangeable = false
          PortPinInitialMode = DIO_SUPP_PFC_PFCE_PFCAE_PFCEAE_PMCSR
          PortPinLevelValue = PORT_PIN_LEVEL_LOW
          PortPinModeChangeable = false
          PortPinSafeStateControl = false
          PortPinSafeStateTrigger = ERROROUTZ0
          PortPullDownOption = false
          PortPullUpOption = false
        PortPin11:
          PortBiDirectionControl = false
          PortDriveStrengthControl = DRIVE_STRENGTH_TYPE_1_SUPP_PDSC_PUCC
          PortInputBufferControl = false
          PortInputSelection = INPUT_BUFFER_TYPE_SCH1
          PortIpControl = false
          PortOpenDrainControl = OUTPUT_BUFFER_TYPE_PUSHPULL_SUPP_PODC_PODCE
          PortOutputLevelInversion = false
          PortPinDioAltModeChangeable = false
          PortPinDirection = PORT_PIN_IN
          PortPinDirectionChangeable = false
          PortPinInitialMode = DIO_SUPP_PFC_PFCE_PFCAE_PFCEAE_PMCSR
          PortPinLevelValue = PORT_PIN_LEVEL_LOW
          PortPinModeChangeable = false
          PortPinSafeStateControl = false
          PortPinSafeStateTrigger = ERROROUTZ0
          PortPullDownOption = false
          PortPullUpOption = false
        PortPin12:
          PortBiDirectionControl = false
          PortDriveStrengthControl = DRIVE_STRENGTH_TYPE_1_SUPP_PDSC_PUCC
          PortInputBufferControl = false
          PortInputSelection = INPUT_BUFFER_TYPE_SCH1
          PortIpControl = false
          PortOpenDrainControl = OUTPUT_BUFFER_TYPE_PUSHPULL_SUPP_PODC_PODCE
          PortOutputLevelInversion = false
          PortPinDioAltModeChangeable = false
          PortPinDirection = PORT_PIN_IN
          PortPinDirectionChangeable = false
          PortPinInitialMode = DIO_SUPP_PFC_PFCE_PFCAE_PFCEAE_PMCSR
          PortPinLevelValue = PORT_PIN_LEVEL_LOW
          PortPinModeChangeable = false
          PortPinSafeStateControl = false
          PortPinSafeStateTrigger = ERROROUTZ0
          PortPullDownOption = false
          PortPullUpOption = false
        PortPin13:
          PortBiDirectionControl = false
          PortDriveStrengthControl = DRIVE_STRENGTH_TYPE_1_SUPP_PDSC_PUCC
          PortInputBufferControl = false
          PortInputSelection = INPUT_BUFFER_TYPE_SCH1
          PortIpControl = false
          PortOpenDrainControl = OUTPUT_BUFFER_TYPE_PUSHPULL_SUPP_PODC_PODCE
          PortOutputLevelInversion = false
          PortPinDioAltModeChangeable = false
          PortPinDirection = PORT_PIN_IN
          PortPinDirectionChangeable = false
          PortPinInitialMode = DIO_SUPP_PFC_PFCE_PFCAE_PFCEAE_PMCSR
          PortPinLevelValue = PORT_PIN_LEVEL_LOW
          PortPinModeChangeable = false
          PortPinSafeStateControl = false
          PortPinSafeStateTrigger = ERROROUTZ0
          PortPullDownOption = false
          PortPullUpOption = false
        PortPin4:
          PortBiDirectionControl = false
          PortDriveStrengthControl = DRIVE_STRENGTH_TYPE_1_SUPP_PDSC_PUCC
          PortInputBufferControl = false
          PortInputSelection = INPUT_BUFFER_TYPE_SCH1
          PortIpControl = false
          PortOpenDrainControl = OUTPUT_BUFFER_TYPE_PUSHPULL_SUPP_PODC_PODCE
          PortOutputLevelInversion = false
          PortPinDioAltModeChangeable = false
          PortPinDirection = PORT_PIN_IN
          PortPinDirectionChangeable = false
          PortPinInitialMode = DIO_SUPP_PFC_PFCE_PFCAE_PFCEAE_PMCSR
          PortPinLevelValue = PORT_PIN_LEVEL_LOW
          PortPinModeChangeable = false
          PortPinSafeStateControl = false
          PortPinSafeStateTrigger = ERROROUTZ0
          PortPullDownOption = false
          PortPullUpOption = false
        PortPin5:
          PortBiDirectionControl = false
          PortDriveStrengthControl = DRIVE_STRENGTH_TYPE_1_SUPP_PDSC_PUCC
          PortInputBufferControl = false
          PortInputSelection = INPUT_BUFFER_TYPE_SCH1
          PortIpControl = false
          PortOpenDrainControl = OUTPUT_BUFFER_TYPE_PUSHPULL_SUPP_PODC_PODCE
          PortOutputLevelInversion = false
          PortPinDioAltModeChangeable = false
          PortPinDirection = PORT_PIN_IN
          PortPinDirectionChangeable = false
          PortPinInitialMode = DIO_SUPP_PFC_PFCE_PFCAE_PFCEAE_PMCSR
          PortPinLevelValue = PORT_PIN_LEVEL_LOW
          PortPinModeChangeable = false
          PortPinSafeStateControl = false
          PortPinSafeStateTrigger = ERROROUTZ0
          PortPullDownOption = false
          PortPullUpOption = false
        PortPin6:
          PortBiDirectionControl = false
          PortDriveStrengthControl = DRIVE_STRENGTH_TYPE_1_SUPP_PDSC_PUCC
          PortInputBufferControl = false
          PortInputSelection = INPUT_BUFFER_TYPE_SCH1
          PortIpControl = false
          PortOpenDrainControl = OUTPUT_BUFFER_TYPE_PUSHPULL_SUPP_PODC_PODCE
          PortOutputLevelInversion = false
          PortPinDioAltModeChangeable = false
          PortPinDirection = PORT_PIN_IN
          PortPinDirectionChangeable = false
          PortPinInitialMode = DIO_SUPP_PFC_PFCE_PFCAE_PFCEAE_PMCSR
          PortPinLevelValue = PORT_PIN_LEVEL_LOW
          PortPinModeChangeable = false
          PortPinSafeStateControl = false
          PortPinSafeStateTrigger = ERROROUTZ0
          PortPullDownOption = false
          PortPullUpOption = false
        PortPin7:
          PortBiDirectionControl = false
          PortDriveStrengthControl = DRIVE_STRENGTH_TYPE_1_SUPP_PDSC_PUCC
          PortInputBufferControl = false
          PortInputSelection = INPUT_BUFFER_TYPE_SCH1
          PortIpControl = false
          PortOpenDrainControl = OUTPUT_BUFFER_TYPE_PUSHPULL_SUPP_PODC_PODCE
          PortOutputLevelInversion = false
          PortPinDioAltModeChangeable = false
          PortPinDirection = PORT_PIN_IN
          PortPinDirectionChangeable = false
          PortPinInitialMode = DIO_SUPP_PFC_PFCE_PFCAE_PFCEAE_PMCSR
          PortPinLevelValue = PORT_PIN_LEVEL_LOW
          PortPinModeChangeable = false
          PortPinSafeStateControl = false
          PortPinSafeStateTrigger = ERROROUTZ0
          PortPullDownOption = false
          PortPullUpOption = false
        PortPin8:
          PortBiDirectionControl = false
          PortDriveStrengthControl = DRIVE_STRENGTH_TYPE_1_SUPP_PDSC_PUCC
          PortInputBufferControl = false
          PortInputSelection = INPUT_BUFFER_TYPE_SCH1
          PortIpControl = false
          PortOpenDrainControl = OUTPUT_BUFFER_TYPE_PUSHPULL_SUPP_PODC_PODCE
          PortOutputLevelInversion = false
          PortPinDioAltModeChangeable = false
          PortPinDirection = PORT_PIN_IN
          PortPinDirectionChangeable = false
          PortPinInitialMode = DIO_SUPP_PFC_PFCE_PFCAE_PFCEAE_PMCSR
          PortPinLevelValue = PORT_PIN_LEVEL_LOW
          PortPinModeChangeable = false
          PortPinSafeStateControl = false
          PortPinSafeStateTrigger = ERROROUTZ0
          PortPullDownOption = false
          PortPullUpOption = false
        PortPin9:
          PortBiDirectionControl = false
          PortDriveStrengthControl = DRIVE_STRENGTH_TYPE_1_SUPP_PDSC_PUCC
          PortInputBufferControl = false
          PortInputSelection = INPUT_BUFFER_TYPE_SCH1
          PortIpControl = false
          PortOpenDrainControl = OUTPUT_BUFFER_TYPE_PUSHPULL_SUPP_PODC_PODCE
          PortOutputLevelInversion = false
          PortPinDioAltModeChangeable = false
          PortPinDirection = PORT_PIN_IN
          PortPinDirectionChangeable = false
          PortPinInitialMode = DIO_SUPP_PFC_PFCE_PFCAE_PFCEAE_PMCSR
          PortPinLevelValue = PORT_PIN_LEVEL_LOW
          PortPinModeChangeable = false
          PortPinSafeStateControl = false
          PortPinSafeStateTrigger = ERROROUTZ0
          PortPullDownOption = false
          PortPullUpOption = false
      PortGroupAnalog0
        PortPin0:
          PortBiDirectionControl = true
          PortDriveStrengthControl = DRIVE_STRENGTH_TYPE_1_SUPP_PDSC
          PortInputBufferControl = false
          PortOpenDrainControl = OUTPUT_BUFFER_TYPE_PUSHPULL_SUPP_PODC_PODCE
          PortOutputLevelInversion = false
          PortPinDirection = PORT_PIN_IN
          PortPinDirectionChangeable = false
          PortPinInitialMode = DIO_ALT_NOT_SUPPORTED
          PortPinLevelValue = PORT_PIN_LEVEL_LOW
          PortPinSafeStateControl = false
          PortPinSafeStateTrigger = ERROROUTZ0
        PortPin1:
          PortBiDirectionControl = false
          PortDriveStrengthControl = DRIVE_STRENGTH_TYPE_1_SUPP_PDSC
          PortInputBufferControl = false
          PortOpenDrainControl = OUTPUT_BUFFER_TYPE_PUSHPULL_SUPP_PODC_PODCE
          PortOutputLevelInversion = false
          PortPinDirection = PORT_PIN_IN
          PortPinDirectionChangeable = false
          PortPinInitialMode = DIO_ALT_NOT_SUPPORTED
          PortPinLevelValue = PORT_PIN_LEVEL_LOW
          PortPinSafeStateControl = false
          PortPinSafeStateTrigger = ERROROUTZ0
        PortPin10:
          PortBiDirectionControl = false
          PortDriveStrengthControl = DRIVE_STRENGTH_TYPE_1_SUPP_PDSC
          PortInputBufferControl = false
          PortOpenDrainControl = OUTPUT_BUFFER_TYPE_PUSHPULL_SUPP_PODC_PODCE
          PortOutputLevelInversion = false
          PortPinDirection = PORT_PIN_IN
          PortPinDirectionChangeable = false
          PortPinInitialMode = DIO_ALT_NOT_SUPPORTED
          PortPinLevelValue = PORT_PIN_LEVEL_LOW
          PortPinSafeStateControl = false
          PortPinSafeStateTrigger = ERROROUTZ0
        PortPin11:
          PortBiDirectionControl = false
          PortDriveStrengthControl = DRIVE_STRENGTH_TYPE_1_SUPP_PDSC
          PortInputBufferControl = false
          PortOpenDrainControl = OUTPUT_BUFFER_TYPE_PUSHPULL_SUPP_PODC_PODCE
          PortOutputLevelInversion = false
          PortPinDirection = PORT_PIN_IN
          PortPinDirectionChangeable = false
          PortPinInitialMode = DIO_ALT_NOT_SUPPORTED
          PortPinLevelValue = PORT_PIN_LEVEL_LOW
          PortPinSafeStateControl = false
          PortPinSafeStateTrigger = ERROROUTZ0
        PortPin12:
          PortBiDirectionControl = false
          PortDriveStrengthControl = DRIVE_STRENGTH_TYPE_1_SUPP_PDSC
          PortInputBufferControl = false
          PortOpenDrainControl = OUTPUT_BUFFER_TYPE_PUSHPULL_SUPP_PODC_PODCE
          PortOutputLevelInversion = false
          PortPinDirection = PORT_PIN_IN
          PortPinDirectionChangeable = false
          PortPinInitialMode = DIO_ALT_NOT_SUPPORTED
          PortPinLevelValue = PORT_PIN_LEVEL_LOW
          PortPinSafeStateControl = false
          PortPinSafeStateTrigger = ERROROUTZ0
        PortPin13:
          PortBiDirectionControl = false
          PortDriveStrengthControl = DRIVE_STRENGTH_TYPE_1_SUPP_PDSC
          PortInputBufferControl = false
          PortOpenDrainControl = OUTPUT_BUFFER_TYPE_PUSHPULL_SUPP_PODC_PODCE
          PortOutputLevelInversion = false
          PortPinDirection = PORT_PIN_IN
          PortPinDirectionChangeable = false
          PortPinInitialMode = DIO_ALT_NOT_SUPPORTED
          PortPinLevelValue = PORT_PIN_LEVEL_LOW
          PortPinSafeStateControl = false
          PortPinSafeStateTrigger = ERROROUTZ0
        PortPin14:
          PortBiDirectionControl = false
          PortDriveStrengthControl = DRIVE_STRENGTH_TYPE_1_SUPP_PDSC
          PortInputBufferControl = false
          PortOpenDrainControl = OUTPUT_BUFFER_TYPE_PUSHPULL_SUPP_PODC_PODCE
          PortOutputLevelInversion = false
          PortPinDirection = PORT_PIN_IN
          PortPinDirectionChangeable = false
          PortPinInitialMode = DIO_ALT_NOT_SUPPORTED
          PortPinLevelValue = PORT_PIN_LEVEL_LOW
          PortPinSafeStateControl = false
          PortPinSafeStateTrigger = ERROROUTZ0
        PortPin15:
          PortBiDirectionControl = false
          PortDriveStrengthControl = DRIVE_STRENGTH_TYPE_1_SUPP_PDSC
          PortInputBufferControl = false
          PortOpenDrainControl = OUTPUT_BUFFER_TYPE_PUSHPULL_SUPP_PODC_PODCE
          PortOutputLevelInversion = false
          PortPinDirection = PORT_PIN_IN
          PortPinDirectionChangeable = false
          PortPinInitialMode = DIO_ALT_NOT_SUPPORTED
          PortPinLevelValue = PORT_PIN_LEVEL_LOW
          PortPinSafeStateControl = false
          PortPinSafeStateTrigger = ERROROUTZ0
        PortPin2:
          PortBiDirectionControl = false
          PortDriveStrengthControl = DRIVE_STRENGTH_TYPE_1_SUPP_PDSC
          PortInputBufferControl = false
          PortOpenDrainControl = OUTPUT_BUFFER_TYPE_PUSHPULL_SUPP_PODC_PODCE
          PortOutputLevelInversion = false
          PortPinDirection = PORT_PIN_IN
          PortPinDirectionChangeable = false
          PortPinInitialMode = DIO_ALT_NOT_SUPPORTED
          PortPinLevelValue = PORT_PIN_LEVEL_LOW
          PortPinSafeStateControl = false
          PortPinSafeStateTrigger = ERROROUTZ0
        PortPin3:
          PortBiDirectionControl = false
          PortDriveStrengthControl = DRIVE_STRENGTH_TYPE_1_SUPP_PDSC
          PortInputBufferControl = false
          PortOpenDrainControl = OUTPUT_BUFFER_TYPE_PUSHPULL_SUPP_PODC_PODCE
          PortOutputLevelInversion = false
          PortPinDirection = PORT_PIN_IN
          PortPinDirectionChangeable = false
          PortPinInitialMode = DIO_ALT_NOT_SUPPORTED
          PortPinLevelValue = PORT_PIN_LEVEL_LOW
          PortPinSafeStateControl = false
          PortPinSafeStateTrigger = ERROROUTZ0
        PortPin4:
          PortBiDirectionControl = false
          PortDriveStrengthControl = DRIVE_STRENGTH_TYPE_1_SUPP_PDSC
          PortInputBufferControl = false
          PortOpenDrainControl = OUTPUT_BUFFER_TYPE_PUSHPULL_SUPP_PODC_PODCE
          PortOutputLevelInversion = false
          PortPinDirection = PORT_PIN_IN
          PortPinDirectionChangeable = false
          PortPinInitialMode = DIO_ALT_NOT_SUPPORTED
          PortPinLevelValue = PORT_PIN_LEVEL_LOW
          PortPinSafeStateControl = false
          PortPinSafeStateTrigger = ERROROUTZ0
        PortPin5:
          PortBiDirectionControl = false
          PortDriveStrengthControl = DRIVE_STRENGTH_TYPE_1_SUPP_PDSC
          PortInputBufferControl = false
          PortOpenDrainControl = OUTPUT_BUFFER_TYPE_PUSHPULL_SUPP_PODC_PODCE
          PortOutputLevelInversion = false
          PortPinDirection = PORT_PIN_IN
          PortPinDirectionChangeable = false
          PortPinInitialMode = DIO_ALT_NOT_SUPPORTED
          PortPinLevelValue = PORT_PIN_LEVEL_LOW
          PortPinSafeStateControl = false
          PortPinSafeStateTrigger = ERROROUTZ0
        PortPin6:
          PortBiDirectionControl = false
          PortDriveStrengthControl = DRIVE_STRENGTH_TYPE_1_SUPP_PDSC
          PortInputBufferControl = false
          PortOpenDrainControl = OUTPUT_BUFFER_TYPE_PUSHPULL_SUPP_PODC_PODCE
          PortOutputLevelInversion = false
          PortPinDirection = PORT_PIN_IN
          PortPinDirectionChangeable = false
          PortPinInitialMode = DIO_ALT_NOT_SUPPORTED
          PortPinLevelValue = PORT_PIN_LEVEL_LOW
          PortPinSafeStateControl = false
          PortPinSafeStateTrigger = ERROROUTZ0
        PortPin7:
          PortBiDirectionControl = false
          PortDriveStrengthControl = DRIVE_STRENGTH_TYPE_1_SUPP_PDSC
          PortInputBufferControl = false
          PortOpenDrainControl = OUTPUT_BUFFER_TYPE_PUSHPULL_SUPP_PODC_PODCE
          PortOutputLevelInversion = false
          PortPinDirection = PORT_PIN_IN
          PortPinDirectionChangeable = false
          PortPinInitialMode = DIO_ALT_NOT_SUPPORTED
          PortPinLevelValue = PORT_PIN_LEVEL_LOW
          PortPinSafeStateControl = false
          PortPinSafeStateTrigger = ERROROUTZ0
        PortPin8:
          PortBiDirectionControl = false
          PortDriveStrengthControl = DRIVE_STRENGTH_TYPE_1_SUPP_PDSC
          PortInputBufferControl = false
          PortOpenDrainControl = OUTPUT_BUFFER_TYPE_PUSHPULL_SUPP_PODC_PODCE
          PortOutputLevelInversion = false
          PortPinDirection = PORT_PIN_IN
          PortPinDirectionChangeable = false
          PortPinInitialMode = DIO_ALT_NOT_SUPPORTED
          PortPinLevelValue = PORT_PIN_LEVEL_LOW
          PortPinSafeStateControl = false
          PortPinSafeStateTrigger = ERROROUTZ0
        PortPin9:
          PortBiDirectionControl = false
          PortDriveStrengthControl = DRIVE_STRENGTH_TYPE_1_SUPP_PDSC
          PortInputBufferControl = false
          PortOpenDrainControl = OUTPUT_BUFFER_TYPE_PUSHPULL_SUPP_PODC_PODCE
          PortOutputLevelInversion = false
          PortPinDirection = PORT_PIN_IN
          PortPinDirectionChangeable = false
          PortPinInitialMode = DIO_ALT_NOT_SUPPORTED
          PortPinLevelValue = PORT_PIN_LEVEL_LOW
          PortPinSafeStateControl = false
          PortPinSafeStateTrigger = ERROROUTZ0
      PortGroupAnalog1
        PortPin0:
          PortBiDirectionControl = false
          PortDriveStrengthControl = DRIVE_STRENGTH_TYPE_1_SUPP_PDSC
          PortInputBufferControl = false
          PortOpenDrainControl = OUTPUT_BUFFER_TYPE_PUSHPULL_SUPP_PODC_PODCE
          PortOutputLevelInversion = false
          PortPinDirection = PORT_PIN_IN
          PortPinDirectionChangeable = false
          PortPinInitialMode = DIO_ALT_NOT_SUPPORTED
          PortPinLevelValue = PORT_PIN_LEVEL_LOW
          PortPinSafeStateControl = false
          PortPinSafeStateTrigger = ERROROUTZ0
        PortPin1:
          PortBiDirectionControl = false
          PortDriveStrengthControl = DRIVE_STRENGTH_TYPE_1_SUPP_PDSC
          PortInputBufferControl = false
          PortOpenDrainControl = OUTPUT_BUFFER_TYPE_PUSHPULL_SUPP_PODC_PODCE
          PortOutputLevelInversion = false
          PortPinDirection = PORT_PIN_IN
          PortPinDirectionChangeable = false
          PortPinInitialMode = DIO_ALT_NOT_SUPPORTED
          PortPinLevelValue = PORT_PIN_LEVEL_LOW
          PortPinSafeStateControl = false
          PortPinSafeStateTrigger = ERROROUTZ0
        PortPin2:
          PortBiDirectionControl = false
          PortDriveStrengthControl = DRIVE_STRENGTH_TYPE_1_SUPP_PDSC
          PortInputBufferControl = false
          PortOpenDrainControl = OUTPUT_BUFFER_TYPE_PUSHPULL_SUPP_PODC_PODCE
          PortOutputLevelInversion = false
          PortPinDirection = PORT_PIN_IN
          PortPinDirectionChangeable = false
          PortPinInitialMode = DIO_ALT_NOT_SUPPORTED
          PortPinLevelValue = PORT_PIN_LEVEL_LOW
          PortPinSafeStateControl = false
          PortPinSafeStateTrigger = ERROROUTZ0
        PortPin3:
          PortBiDirectionControl = false
          PortDriveStrengthControl = DRIVE_STRENGTH_TYPE_1_SUPP_PDSC
          PortInputBufferControl = false
          PortOpenDrainControl = OUTPUT_BUFFER_TYPE_PUSHPULL_SUPP_PODC_PODCE
          PortOutputLevelInversion = false
          PortPinDirection = PORT_PIN_IN
          PortPinDirectionChangeable = false
          PortPinInitialMode = DIO_ALT_NOT_SUPPORTED
          PortPinLevelValue = PORT_PIN_LEVEL_LOW
          PortPinSafeStateControl = false
          PortPinSafeStateTrigger = ERROROUTZ0
      PortGroupAnalog2
        PortPin0:
          PortBiDirectionControl = false
          PortDriveStrengthControl = DRIVE_STRENGTH_TYPE_1_SUPP_PDSC
          PortInputBufferControl = false
          PortOpenDrainControl = OUTPUT_BUFFER_TYPE_PUSHPULL_SUPP_PODC_PODCE
          PortOutputLevelInversion = false
          PortPinDirection = PORT_PIN_IN
          PortPinDirectionChangeable = false
          PortPinInitialMode = DIO_ALT_NOT_SUPPORTED
          PortPinLevelValue = PORT_PIN_LEVEL_LOW
          PortPinSafeStateControl = false
          PortPinSafeStateTrigger = ERROROUTZ0
        PortPin1:
          PortBiDirectionControl = false
          PortDriveStrengthControl = DRIVE_STRENGTH_TYPE_1_SUPP_PDSC
          PortInputBufferControl = false
          PortOpenDrainControl = OUTPUT_BUFFER_TYPE_PUSHPULL_SUPP_PODC_PODCE
          PortOutputLevelInversion = false
          PortPinDirection = PORT_PIN_IN
          PortPinDirectionChangeable = false
          PortPinInitialMode = DIO_ALT_NOT_SUPPORTED
          PortPinLevelValue = PORT_PIN_LEVEL_LOW
          PortPinSafeStateControl = false
          PortPinSafeStateTrigger = ERROROUTZ0
        PortPin10:
          PortBiDirectionControl = false
          PortDriveStrengthControl = DRIVE_STRENGTH_TYPE_1_SUPP_PDSC
          PortInputBufferControl = false
          PortOpenDrainControl = OUTPUT_BUFFER_TYPE_PUSHPULL_SUPP_PODC_PODCE
          PortOutputLevelInversion = false
          PortPinDirection = PORT_PIN_IN
          PortPinDirectionChangeable = false
          PortPinInitialMode = DIO_ALT_NOT_SUPPORTED
          PortPinLevelValue = PORT_PIN_LEVEL_LOW
          PortPinSafeStateControl = false
          PortPinSafeStateTrigger = ERROROUTZ0
        PortPin11:
          PortBiDirectionControl = false
          PortDriveStrengthControl = DRIVE_STRENGTH_TYPE_1_SUPP_PDSC
          PortInputBufferControl = false
          PortOpenDrainControl = OUTPUT_BUFFER_TYPE_PUSHPULL_SUPP_PODC_PODCE
          PortOutputLevelInversion = false
          PortPinDirection = PORT_PIN_IN
          PortPinDirectionChangeable = false
          PortPinInitialMode = DIO_ALT_NOT_SUPPORTED
          PortPinLevelValue = PORT_PIN_LEVEL_LOW
          PortPinSafeStateControl = false
          PortPinSafeStateTrigger = ERROROUTZ0
        PortPin12:
          PortBiDirectionControl = false
          PortDriveStrengthControl = DRIVE_STRENGTH_TYPE_1_SUPP_PDSC
          PortInputBufferControl = false
          PortOpenDrainControl = OUTPUT_BUFFER_TYPE_PUSHPULL_SUPP_PODC_PODCE
          PortOutputLevelInversion = false
          PortPinDirection = PORT_PIN_IN
          PortPinDirectionChangeable = false
          PortPinInitialMode = DIO_ALT_NOT_SUPPORTED
          PortPinLevelValue = PORT_PIN_LEVEL_LOW
          PortPinSafeStateControl = false
          PortPinSafeStateTrigger = ERROROUTZ0
        PortPin13:
          PortBiDirectionControl = false
          PortDriveStrengthControl = DRIVE_STRENGTH_TYPE_1_SUPP_PDSC
          PortInputBufferControl = false
          PortOpenDrainControl = OUTPUT_BUFFER_TYPE_PUSHPULL_SUPP_PODC_PODCE
          PortOutputLevelInversion = false
          PortPinDirection = PORT_PIN_IN
          PortPinDirectionChangeable = false
          PortPinInitialMode = DIO_ALT_NOT_SUPPORTED
          PortPinLevelValue = PORT_PIN_LEVEL_LOW
          PortPinSafeStateControl = false
          PortPinSafeStateTrigger = ERROROUTZ0
        PortPin14:
          PortBiDirectionControl = false
          PortDriveStrengthControl = DRIVE_STRENGTH_TYPE_1_SUPP_PDSC
          PortInputBufferControl = false
          PortOpenDrainControl = OUTPUT_BUFFER_TYPE_PUSHPULL_SUPP_PODC_PODCE
          PortOutputLevelInversion = false
          PortPinDirection = PORT_PIN_IN
          PortPinDirectionChangeable = false
          PortPinInitialMode = DIO_ALT_NOT_SUPPORTED
          PortPinLevelValue = PORT_PIN_LEVEL_LOW
          PortPinSafeStateControl = false
          PortPinSafeStateTrigger = ERROROUTZ0
        PortPin15:
          PortBiDirectionControl = false
          PortDriveStrengthControl = DRIVE_STRENGTH_TYPE_1_SUPP_PDSC
          PortInputBufferControl = false
          PortOpenDrainControl = OUTPUT_BUFFER_TYPE_PUSHPULL_SUPP_PODC_PODCE
          PortOutputLevelInversion = false
          PortPinDirection = PORT_PIN_IN
          PortPinDirectionChangeable = false
          PortPinInitialMode = DIO_ALT_NOT_SUPPORTED
          PortPinLevelValue = PORT_PIN_LEVEL_LOW
          PortPinSafeStateControl = false
          PortPinSafeStateTrigger = ERROROUTZ0
        PortPin2:
          PortBiDirectionControl = false
          PortDriveStrengthControl = DRIVE_STRENGTH_TYPE_1_SUPP_PDSC
          PortInputBufferControl = false
          PortOpenDrainControl = OUTPUT_BUFFER_TYPE_PUSHPULL_SUPP_PODC_PODCE
          PortOutputLevelInversion = false
          PortPinDirection = PORT_PIN_IN
          PortPinDirectionChangeable = false
          PortPinInitialMode = DIO_ALT_NOT_SUPPORTED
          PortPinLevelValue = PORT_PIN_LEVEL_LOW
          PortPinSafeStateControl = false
          PortPinSafeStateTrigger = ERROROUTZ0
        PortPin3:
          PortBiDirectionControl = false
          PortDriveStrengthControl = DRIVE_STRENGTH_TYPE_1_SUPP_PDSC
          PortInputBufferControl = false
          PortOpenDrainControl = OUTPUT_BUFFER_TYPE_PUSHPULL_SUPP_PODC_PODCE
          PortOutputLevelInversion = false
          PortPinDirection = PORT_PIN_IN
          PortPinDirectionChangeable = false
          PortPinInitialMode = DIO_ALT_NOT_SUPPORTED
          PortPinLevelValue = PORT_PIN_LEVEL_LOW
          PortPinSafeStateControl = false
          PortPinSafeStateTrigger = ERROROUTZ0
        PortPin4:
          PortBiDirectionControl = false
          PortDriveStrengthControl = DRIVE_STRENGTH_TYPE_1_SUPP_PDSC
          PortInputBufferControl = false
          PortOpenDrainControl = OUTPUT_BUFFER_TYPE_PUSHPULL_SUPP_PODC_PODCE
          PortOutputLevelInversion = false
          PortPinDirection = PORT_PIN_IN
          PortPinDirectionChangeable = false
          PortPinInitialMode = DIO_ALT_NOT_SUPPORTED
          PortPinLevelValue = PORT_PIN_LEVEL_LOW
          PortPinSafeStateControl = false
          PortPinSafeStateTrigger = ERROROUTZ0
        PortPin5:
          PortBiDirectionControl = false
          PortDriveStrengthControl = DRIVE_STRENGTH_TYPE_1_SUPP_PDSC
          PortInputBufferControl = false
          PortOpenDrainControl = OUTPUT_BUFFER_TYPE_PUSHPULL_SUPP_PODC_PODCE
          PortOutputLevelInversion = false
          PortPinDirection = PORT_PIN_IN
          PortPinDirectionChangeable = false
          PortPinInitialMode = DIO_ALT_NOT_SUPPORTED
          PortPinLevelValue = PORT_PIN_LEVEL_LOW
          PortPinSafeStateControl = false
          PortPinSafeStateTrigger = ERROROUTZ0
        PortPin6:
          PortBiDirectionControl = false
          PortDriveStrengthControl = DRIVE_STRENGTH_TYPE_1_SUPP_PDSC
          PortInputBufferControl = false
          PortOpenDrainControl = OUTPUT_BUFFER_TYPE_PUSHPULL_SUPP_PODC_PODCE
          PortOutputLevelInversion = false
          PortPinDirection = PORT_PIN_IN
          PortPinDirectionChangeable = false
          PortPinInitialMode = DIO_ALT_NOT_SUPPORTED
          PortPinLevelValue = PORT_PIN_LEVEL_LOW
          PortPinSafeStateControl = false
          PortPinSafeStateTrigger = ERROROUTZ0
        PortPin7:
          PortBiDirectionControl = false
          PortDriveStrengthControl = DRIVE_STRENGTH_TYPE_1_SUPP_PDSC
          PortInputBufferControl = false
          PortOpenDrainControl = OUTPUT_BUFFER_TYPE_PUSHPULL_SUPP_PODC_PODCE
          PortOutputLevelInversion = false
          PortPinDirection = PORT_PIN_IN
          PortPinDirectionChangeable = false
          PortPinInitialMode = DIO_ALT_NOT_SUPPORTED
          PortPinLevelValue = PORT_PIN_LEVEL_LOW
          PortPinSafeStateControl = false
          PortPinSafeStateTrigger = ERROROUTZ0
        PortPin8:
          PortBiDirectionControl = false
          PortDriveStrengthControl = DRIVE_STRENGTH_TYPE_1_SUPP_PDSC
          PortInputBufferControl = false
          PortOpenDrainControl = OUTPUT_BUFFER_TYPE_PUSHPULL_SUPP_PODC_PODCE
          PortOutputLevelInversion = false
          PortPinDirection = PORT_PIN_IN
          PortPinDirectionChangeable = false
          PortPinInitialMode = DIO_ALT_NOT_SUPPORTED
          PortPinLevelValue = PORT_PIN_LEVEL_LOW
          PortPinSafeStateControl = false
          PortPinSafeStateTrigger = ERROROUTZ0
        PortPin9:
          PortBiDirectionControl = false
          PortDriveStrengthControl = DRIVE_STRENGTH_TYPE_1_SUPP_PDSC
          PortInputBufferControl = false
          PortOpenDrainControl = OUTPUT_BUFFER_TYPE_PUSHPULL_SUPP_PODC_PODCE
          PortOutputLevelInversion = false
          PortPinDirection = PORT_PIN_IN
          PortPinDirectionChangeable = false
          PortPinInitialMode = DIO_ALT_NOT_SUPPORTED
          PortPinLevelValue = PORT_PIN_LEVEL_LOW
          PortPinSafeStateControl = false
          PortPinSafeStateTrigger = ERROROUTZ0
      PortGroupAnalog3
        PortPin0:
          PortBiDirectionControl = false
          PortDriveStrengthControl = DRIVE_STRENGTH_TYPE_1_SUPP_PDSC
          PortInputBufferControl = false
          PortOpenDrainControl = OUTPUT_BUFFER_TYPE_PUSHPULL_SUPP_PODC_PODCE
          PortOutputLevelInversion = false
          PortPinDirection = PORT_PIN_IN
          PortPinDirectionChangeable = false
          PortPinInitialMode = DIO_ALT_NOT_SUPPORTED
          PortPinLevelValue = PORT_PIN_LEVEL_LOW
          PortPinSafeStateControl = false
          PortPinSafeStateTrigger = ERROROUTZ0
        PortPin1:
          PortBiDirectionControl = false
          PortDriveStrengthControl = DRIVE_STRENGTH_TYPE_1_SUPP_PDSC
          PortInputBufferControl = false
          PortOpenDrainControl = OUTPUT_BUFFER_TYPE_PUSHPULL_SUPP_PODC_PODCE
          PortOutputLevelInversion = false
          PortPinDirection = PORT_PIN_IN
          PortPinDirectionChangeable = false
          PortPinInitialMode = DIO_ALT_NOT_SUPPORTED
          PortPinLevelValue = PORT_PIN_LEVEL_LOW
          PortPinSafeStateControl = false
          PortPinSafeStateTrigger = ERROROUTZ0
        PortPin2:
          PortBiDirectionControl = false
          PortDriveStrengthControl = DRIVE_STRENGTH_TYPE_1_SUPP_PDSC
          PortInputBufferControl = false
          PortOpenDrainControl = OUTPUT_BUFFER_TYPE_PUSHPULL_SUPP_PODC_PODCE
          PortOutputLevelInversion = false
          PortPinDirection = PORT_PIN_IN
          PortPinDirectionChangeable = false
          PortPinInitialMode = DIO_ALT_NOT_SUPPORTED
          PortPinLevelValue = PORT_PIN_LEVEL_LOW
          PortPinSafeStateControl = false
          PortPinSafeStateTrigger = ERROROUTZ0
        PortPin3:
          PortBiDirectionControl = false
          PortDriveStrengthControl = DRIVE_STRENGTH_TYPE_1_SUPP_PDSC
          PortInputBufferControl = false
          PortOpenDrainControl = OUTPUT_BUFFER_TYPE_PUSHPULL_SUPP_PODC_PODCE
          PortOutputLevelInversion = false
          PortPinDirection = PORT_PIN_IN
          PortPinDirectionChangeable = false
          PortPinInitialMode = DIO_ALT_NOT_SUPPORTED
          PortPinLevelValue = PORT_PIN_LEVEL_LOW
          PortPinSafeStateControl = false
          PortPinSafeStateTrigger = ERROROUTZ0
      PortGroupAnalog4
        PortPin0:
          PortBiDirectionControl = false
          PortDriveStrengthControl = DRIVE_STRENGTH_TYPE_1_SUPP_PDSC
          PortInputBufferControl = false
          PortOpenDrainControl = OUTPUT_BUFFER_TYPE_PUSHPULL_SUPP_PODC_PODCE
          PortOutputLevelInversion = false
          PortPinDirection = PORT_PIN_IN
          PortPinDirectionChangeable = false
          PortPinInitialMode = DIO_ALT_NOT_SUPPORTED
          PortPinLevelValue = PORT_PIN_LEVEL_LOW
          PortPinSafeStateControl = false
          PortPinSafeStateTrigger = ERROROUTZ0
        PortPin1:
          PortBiDirectionControl = false
          PortDriveStrengthControl = DRIVE_STRENGTH_TYPE_1_SUPP_PDSC
          PortInputBufferControl = false
          PortOpenDrainControl = OUTPUT_BUFFER_TYPE_PUSHPULL_SUPP_PODC_PODCE
          PortOutputLevelInversion = false
          PortPinDirection = PORT_PIN_IN
          PortPinDirectionChangeable = false
          PortPinInitialMode = DIO_ALT_NOT_SUPPORTED
          PortPinLevelValue = PORT_PIN_LEVEL_LOW
          PortPinSafeStateControl = false
          PortPinSafeStateTrigger = ERROROUTZ0
        PortPin2:
          PortBiDirectionControl = false
          PortDriveStrengthControl = DRIVE_STRENGTH_TYPE_1_SUPP_PDSC
          PortInputBufferControl = false
          PortOpenDrainControl = OUTPUT_BUFFER_TYPE_PUSHPULL_SUPP_PODC_PODCE
          PortOutputLevelInversion = false
          PortPinDirection = PORT_PIN_IN
          PortPinDirectionChangeable = false
          PortPinInitialMode = DIO_ALT_NOT_SUPPORTED
          PortPinLevelValue = PORT_PIN_LEVEL_LOW
          PortPinSafeStateControl = false
          PortPinSafeStateTrigger = ERROROUTZ0
        PortPin3:
          PortBiDirectionControl = false
          PortDriveStrengthControl = DRIVE_STRENGTH_TYPE_1_SUPP_PDSC
          PortInputBufferControl = false
          PortOpenDrainControl = OUTPUT_BUFFER_TYPE_PUSHPULL_SUPP_PODC_PODCE
          PortOutputLevelInversion = false
          PortPinDirection = PORT_PIN_IN
          PortPinDirectionChangeable = false
          PortPinInitialMode = DIO_ALT_NOT_SUPPORTED
          PortPinLevelValue = PORT_PIN_LEVEL_LOW
          PortPinSafeStateControl = false
          PortPinSafeStateTrigger = ERROROUTZ0
        PortPin4:
          PortBiDirectionControl = false
          PortDriveStrengthControl = DRIVE_STRENGTH_TYPE_1_SUPP_PDSC
          PortInputBufferControl = false
          PortOpenDrainControl = OUTPUT_BUFFER_TYPE_PUSHPULL_SUPP_PODC_PODCE
          PortOutputLevelInversion = false
          PortPinDirection = PORT_PIN_IN
          PortPinDirectionChangeable = false
          PortPinInitialMode = DIO_ALT_NOT_SUPPORTED
          PortPinLevelValue = PORT_PIN_LEVEL_LOW
          PortPinSafeStateControl = false
          PortPinSafeStateTrigger = ERROROUTZ0
